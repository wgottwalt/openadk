## target/sh/Config.in
```kconfig
choice
depends on ADK_LINUX_SH && !ADK_CHOOSE_TARGET_ARCH
prompt "Target system"

config ADK_CHOOSE_TARGET_SYSTEM_SH
        boolean "Choose target system"

source "target/sh/Config.in.systems"
endchoice
```

## target/sparc/Config.in
```kconfig
choice
depends on ADK_LINUX_SPARC || ADK_LINUX_NATIVE && !ADK_CHOOSE_TARGET_ARCH
prompt "Target system"

config ADK_CHOOSE_TARGET_SYSTEM_SPARC
        boolean "Choose target system"

source "target/sparc/Config.in.systems"
endchoice
```

## target/sparc64/Config.in
```kconfig
choice
depends on ADK_LINUX_SPARC64 || ADK_LINUX_NATIVE && ADK_CHOOSE_TARGET_ARCH
prompt "Target system"

config ADK_CHOOSE_TARGET_SYSTEM_SPARC64
        boolean "Choose target system"

source "target/sparc64/Config.in.systems"
endchoice
```

## target/waldux/Config.in
```kconfig
# This file is part of the OpenADK project. OpenADK is copyrighted
# material, please see the LICENCE file in the top-level directory.

source target/waldux/config/Config.in.kernel
source target/waldux/config/Config.in.cpu
source target/waldux/config/Config.in.bus
source target/waldux/config/Config.in.block
source target/waldux/config/Config.in.flash
source target/waldux/config/Config.in.fs
source target/waldux/config/Config.in.netdevice
source target/waldux/config/Config.in.usb
source target/waldux/config/Config.in.serial
source target/waldux/config/Config.in.graphics
source target/waldux/config/Config.in.input
source target/waldux/config/Config.in.pcmcia
source target/waldux/config/Config.in.network
source target/waldux/config/Config.in.netfilter
source target/waldux/config/Config.in.audio
source target/waldux/config/Config.in.multimedia
source target/waldux/config/Config.in.crypto
source target/waldux/config/Config.in.misc
source target/waldux/config/Config.in.arm
source target/waldux/config/Config.in.mips
source target/waldux/config/Config.in.xtensa
source target/waldux/config/Config.in.pm
source target/waldux/config/Config.in.kvm
source target/waldux/config/Config.in.virtio
source target/waldux/config/Config.in.debug
```

## target/x86/Config.in
```kconfig
choice
depends on ADK_LINUX_X86 && !ADK_CHOOSE_TARGET_ARCH
prompt "Target system"

config ADK_CHOOSE_TARGET_SYSTEM_X86
        boolean "Choose target system"

source "target/x86/Config.in.systems"
endchoice
```

## target/x86_64/Config.in
```kconfig
choice
depends on ADK_LINUX_X86_64 || ADK_LINUX_NATIVE && !ADK_CHOOSE_TARGET_ARCH
prompt "Target system"

config ADK_CHOOSE_TARGET_SYSTEM_X86_64
        boolean "Choose target system"

source "target/x86_64/Config.in.systems"
endchoice
```

## target/xtensa/Config.in
```kconfig
choice
depends on ADK_LINUX_XTENSA && !ADK_CHOOSE_TARGET_ARCH
prompt "Target system"

config ADK_CHOOSE_TARGET_SYSTEM_XTENSA
        boolean "Choose target system"

source "target/xtensa/Config.in.systems"
endchoice
```

## toolchain/Config.in
```kconfig
menu "Toolchain settings"

config ADK_TOOLCHAIN_GDB
	prompt "Enable building of the GNU debugger"
	boolean
	default y

config ADK_TOOLCHAIN_GCC_CXX
	prompt "Enable building of G++ (C++ language support in GCC)"
	boolean
	default y

config ADK_TOOLCHAIN_SSP
	prompt "Enable Stack Smashing Protection"
	boolean
	default y

config ADK_TOOLCHAIN_USE_SSP
	prompt "Use SSP for all packages"
 	boolean	
	depends on ADK_TOOLCHAIN_SSP
	default n

config ADK_TOOLCHAIN_LTO
	prompt "Enable Link Time Optimization"
	boolean
	default y

config ADK_TOOLCHAIN_USE_LTO
	prompt "Use Link Time Optimization for all packages"
	boolean
	depends on ADK_TOOLCHAIN_LTO
	default n

config ADK_TOOLCHAIN_GOLD
	prompt "Enable GOLD as linker"
	boolean
	depends on !ADK_LINUX_MIPS
	default n

config ADK_TOOLCHAIN_USE_GOLD
	prompt "Use GOLD as linker for all packages"
	boolean
	depends on ADK_TOOLCHAIN_GOLD
	default n

config ADK_LINUX_ARM_WITH_THUMB
	prompt "Use THUMB2 ARM mode"
	boolean
	depends on ADK_CPU_CORTEX_A9 && ADK_TARGET_LIB_GLIBC
	select ADK_KERNEL_THUMB2_KERNEL
	default n

endmenu
```
