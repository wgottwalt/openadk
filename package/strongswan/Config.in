## package/strongswan/Config.in
```kconfig
config ADK_PACKAGE_STRONGSWAN
	prompt "strongswan........................ VPN solution using IPsec"
	tristate
	default n
	select ADK_PACKAGE_IP
	select ADK_PACKAGE_LIBGMP
	help
	  StrongSwan is an implementation of IPsec for Linux.
	  
	  http://www.strongswan.org/
```

## package/subversion/Config.in
```kconfig
config ADK_PACKAGE_SUBVERSION
	prompt "subversion........................ revision control program"
	tristate
	default n
	select ADK_PACKAGE_ZLIB
	select ADK_PACKAGE_APR_UTIL
	select ADK_PACKAGE_LIBICONV
	select ADK_PACKAGE_LIBEXPAT
	help
	  Subversion is an open source application for revision control.

	  http://subversion.tigris.org

config ADK_PACKAGE_SUBVERSION_NEON
	prompt "  Enable interaction with remote repositories over WebDAV"
	bool
	default n
	depends ADK_PACKAGE_SUBVERSION
	select ADK_PACKAGE_NEON
	help
	 Allows a Subversion client to interact with remote
	 repositories over the Internet via a WebDAV based protocol.
```

## package/swconfig/Config.in
```kconfig
config ADK_PACKAGE_SWCONFIG
	prompt "swconfig........................... Switch configuration utility"
	tristate
	depends on ADK_LINUX_MIPS_RB433
	select ADK_PACKAGE_LIBNL
	default y
	help
	  Switch configuration utility (Adopted from OpenWrt).
```

## package/sysstat/Config.in
```kconfig
config ADK_PACKAGE_SYSSTAT
	prompt "sysstat........................... System monitoring and performance analysis utilities"
	tristate
	default n
	help
	  The sysstat package contains utilities to monitor system performance and 
	  usage activity. Sysstat contains various utilities, common to many commercial 
	  Unixes, and tools you can schedule via cron to collect and historize 
	  performance and activity data. 

	  http://perso.wanadoo.fr/sebastien.godard/
```

## package/tar/Config.in
```kconfig
config ADK_PACKAGE_TAR
	prompt "gtar.............................. gnu tar"
	tristate
	default n
	help
	  The GNU implementation of tar.
	  
	  http://www.gnu.org/software/tar/
```

## package/tcl/Config.in
```kconfig
config ADK_PACKAGE_TCL
	prompt "tcl............................... TCL"
	tristate
	default n
	help
	  The TCL scripting language.

	  http://www.tcl.tk/
```

## package/tcp_wrappers/Config.in
```kconfig
config ADK_COMPILE_TCP_WRAPPERS
	bool
	default n
	depends ADK_PACKAGE_LIBWRAP

config ADK_PACKAGE_LIBWRAP
	prompt "libwrap........................... Security wrapper library for TCP services"
	tristate
	default n
	select ADK_COMPILE_TCP_WRAPPERS
	help
	  Security wrapper library for TCP services.
	  
	  ftp://ftp.porcupine.org/pub/security/index.html
```

## package/tcpdump/Config.in
```kconfig
config ADK_PACKAGE_TCPDUMP
	prompt "tcpdump........................... Network monitoring and data acquisition tool"
	tristate
	default n
	select ADK_PACKAGE_LIBPCAP
	help
	  A tool for network monitoring and data acquisition.
	  
	  http://www.tcpdump.org/
```

## package/tinc/Config.in
```kconfig
config ADK_PACKAGE_TINC
	prompt "tinc.............................. VPN tunneling daemon"
	tristate
	default n
	select ADK_KPACKAGE_KMOD_TUN
	select ADK_PACKAGE_LIBLZO
	select ADK_PACKAGE_LIBOPENSSL
	select ADK_PACKAGE_ZLIB
	help
	  A VPN tunneling daemon
	  
	  http://www.tinc-vpn.org/
```

## package/tinyproxy/Config.in
```kconfig
#menu "tinyproxy......................... Tinyproxy is a lightweight HTTP and HTTPS proxy."

config ADK_PACKAGE_TINYPROXY
	prompt "tinyproxy......................... Tinyproxy is a lightweight HTTP and HTTPS proxy"
	tristate
	default n
	help
		Tinyproxy is a lightweight HTTP and HTTPS proxy.

		http://tinyproxy.sourceforge.net

config ADK_COMPILE_TINYPROXY_WITH_TRANSPARENT_PROXY
	prompt "  Enable transparent proxying"
	bool
	default y
	depends ADK_PACKAGE_TINYPROXY

config ADK_COMPILE_TINYPROXY_WITH_FILTER
	prompt "  Enable filtering support"
	bool
	default y
	depends ADK_PACKAGE_TINYPROXY

config ADK_COMPILE_TINYPROXY_WITH_UPSTREAM
	prompt "  Enable upstream support"
	bool
	default y
	depends ADK_PACKAGE_TINYPROXY

#endmenu
```

## package/tmsnc/Config.in
```kconfig
config ADK_PACKAGE_TMSNC
	tristate "tmsnc............................. text-based MSN client"
	default n
	help
		TMSNC is a textbased (console) MSN client written in C.

		http://tmsnc.sourceforge.net
```

## package/tntnet/Config.in
```kconfig
config ADK_PACKAGE_TNTNET
	prompt "tntnet............................ a modular, multithreaded webapplicationserver"
	tristate
	default n
	select ADK_PACKAGE_CXXTOOLS
	select ADK_PACKAGE_LIBICONV
	select ADK_PACKAGE_LIBPTHREAD
	select ADK_PACKAGE_ZLIB
	help
	  Tntnet is a modular, multithreaded webapplicationserver
	  written from scratch for C++.
	  
	  http://www.tntnet.org

choice
prompt "SSL/TLS Configuration"
depends on ADK_PACKAGE_TNTNET
default ADK_COMPILE_TNTNET_WITH_OPENSSL

config ADK_COMPILE_TNTNET_WITHOUT_OPENSSL
	bool "no ssl encryption support"
	help

config ADK_COMPILE_TNTNET_WITH_OPENSSL
	bool "enable openssl encryption support"
	depends on ADK_PACKAGE_TNTNET
	select ADK_PACKAGE_LIBOPENSSL
	help

config ADK_COMPILE_TNTNET_WITH_GNUTLS
	bool "enable gnutls encryption support"
	depends on ADK_PACKAGE_TNTNET
	select ADK_PACKAGE_LIBGNUTLS
	help

endchoice

choice
prompt "C++ library to use"
depends on ADK_PACKAGE_TNTNET
default ADK_COMPILE_TNTNET_WITH_STDCXX if ADK_TARGET_LIB_GLIBC || ADK_TARGET_LIB_EGLIBC
default ADK_COMPILE_TNTNET_WITH_UCLIBCXX if ADK_TARGET_LIB_UCLIBC

config ADK_COMPILE_TNTNET_WITH_STDCXX
	bool "Standard C++ library"
	select ADK_PACKAGE_LIBSTDCXX
	help

config ADK_COMPILE_TNTNET_WITH_UCLIBCXX
	bool "Embedded uClibc++ library"
	select ADK_PACKAGE_UCLIBCXX
	depends on ADK_BROKEN
	help

endchoice
```

## package/trafshow/Config.in
```kconfig
config ADK_PACKAGE_TRAFSHOW
	prompt "trafshow.......................... network traffic monitor"
	tristate
	select ADK_PACKAGE_LIBPCAP
	select ADK_PACKAGE_LIBNCURSES
	select ADK_PACKAGE_LIBPTHREAD
	default n
	help
```

## package/ttcp/Config.in
```kconfig
config ADK_PACKAGE_TTCP
	prompt "ttcp.............................. A TCP connection performance tester"
	tristate
	default n
	help
	  A small utility to test TCP connection performance
```

## package/uclibc++/Config.in
```kconfig
config ADK_PACKAGE_UCLIBCXX
	prompt "uClibc++.......................... C++ library for embedded systems"
	tristate
	default n
	help
	  A standard C++ library for embedded systems
```

## package/uclibc/Config.in
```kconfig
config ADK_PACKAGE_UCLIBC
	prompt "uClibc............................... embedded C library"
	tristate
	default y if ADK_TARGET_LIB_UCLIBC
	default n
	depends on ADK_TARGET_LIB_UCLIBC
	help
	  Embedded C library.
```

## package/udev/Config.in
```kconfig
config ADK_PACKAGE_UDEV
	prompt "udev.............................. Dynamic device management subsystem"
	tristate
	default n
	select ADK_COMPILE_UTIL_LINUX_NG
	help
	  udev provides a dynamic device directory containing only the files for 
	  actually present devices. It creates or removes device node files in 
	  the /dev directory, or it renames network interfaces.
	  
	  http://www.kernel.org/pub/linux/utils/kernel/hotplug/udev.html
```

## package/ulogd/Config.in
```kconfig
#menu "ulogd............................. Netfilter userspace logging daemon"

config ADK_PACKAGE_ULOGD
	prompt "ulogd............................. Netfilter userspace logging daemon"
	tristate
	default n
	select ADK_PACKAGE_IPTABLES
	help
	  The netfilter userspace logging daemon
	  
	  http://gnumonks.org/projects/ulogd

config ADK_PACKAGE_ULOGD_MOD_MYSQL
	prompt   "ulogd-mod-mysql............... Output plugin for logging into a MySQL database"
	tristate
	default n
	depends on ADK_PACKAGE_ULOGD
	select ADK_PACKAGE_LIBMYSQLCLIENT

config ADK_PACKAGE_ULOGD_MOD_PCAP
        prompt  "ulogd-mod-pcap................. Output plugin for logging into pcap format"
	tristate
	default n
	depends on ADK_PACKAGE_ULOGD
	select ADK_PACKAGE_LIBPCAP

config ADK_PACKAGE_ULOGD_MOD_PGSQL
	prompt   "ulogd-mod-pgsql............... Output plugin for logging into a PostgreSQL database"
	tristate
	default n
	depends on ADK_PACKAGE_ULOGD
	select ADK_PACKAGE_LIBPQ

config ADK_PACKAGE_ULOGD_MOD_SQLITE
	prompt   "ulogd-mod-sqlite.............. Output plugin for logging into an SQLite database"
	tristate
	default n
	depends on ADK_PACKAGE_ULOGD
	select ADK_PACKAGE_LIBSQLITE

config ADK_PACKAGE_ULOGD_MOD_EXTRA
	prompt   "ulogd-mod-extra............... All other plugins"
	tristate
	default n
	depends on ADK_PACKAGE_ULOGD

#endmenu
```

## package/updatedd/Config.in
```kconfig
config ADK_PACKAGE_UPDATEDD
	prompt "updatedd.......................... A tool to update dynamic DNS services"
	tristate
	default n
	help
	  Updatedd is a small tool that will update one of many dynamic
	  dns services on boot.
	  
	  Please look at the /etc/init.d/S50ddns script for more info.
	  
	  http://www.philipp-benner.de/updatedd/

config ADK_PACKAGE_UPDATEDD_MOD_CHANGEIP
	prompt "updatedd-mod-changeip........... changeip.com"
	tristate
	depends on ADK_PACKAGE_UPDATEDD
	default n

config ADK_PACKAGE_UPDATEDD_MOD_DYNDNS
	prompt "updatedd-mod-dyndns............. dyndns.org"
	tristate
	depends on ADK_PACKAGE_UPDATEDD
	default n

config ADK_PACKAGE_UPDATEDD_MOD_EURODYNDNS
	prompt "updatedd-mod-eurodyndns......... eurodyndns.org"
	tristate
	depends on ADK_PACKAGE_UPDATEDD
	default n

config ADK_PACKAGE_UPDATEDD_MOD_HN
	prompt "updatedd-mod-hn................. hn.org"
	tristate
	depends on ADK_PACKAGE_UPDATEDD
	default n

config ADK_PACKAGE_UPDATEDD_MOD_NOIP
	prompt "updatedd-mod-noip............... no-ip.com"
	tristate
	depends on ADK_PACKAGE_UPDATEDD
	default n

config ADK_PACKAGE_UPDATEDD_MOD_ODS
	prompt "updatedd-mod-ods................ ods.org"
	tristate
	depends on ADK_PACKAGE_UPDATEDD
	default n

config ADK_PACKAGE_UPDATEDD_MOD_OVH
	prompt "updatedd-mod-ovh................ ovh.com"
	tristate
	depends on ADK_PACKAGE_UPDATEDD
	default n

config ADK_PACKAGE_UPDATEDD_MOD_REGFISH
	prompt "updatedd-mod-regfish............ regfish.com"
	tristate
	depends on ADK_PACKAGE_UPDATEDD
	default n

config ADK_PACKAGE_UPDATEDD_MOD_TZO
	prompt "updatedd-mod-tzo................ tzo.com"
	tristate
	depends on ADK_PACKAGE_UPDATEDD
	default n
```

## package/usbutils/Config.in
```kconfig
config ADK_COMPILE_USBUTILS
	tristate
	depends ADK_PACKAGE_LSUSB

config ADK_PACKAGE_LSUSB
	prompt "lsusb............................. USB devices listing program"
	tristate
	default n
	select ADK_COMPILE_USBUTILS
	select ADK_PACKAGE_LIBUSB
	help
	  A program to list Linux USB devices
	  
	  http://linux-usb.sourceforge.net/
```

## package/ussp-push/Config.in
```kconfig
config ADK_PACKAGE_USSP_PUSH
	prompt "ussp-push......................... obex push application"
	tristate
	default n
	help
	  ussp-push is a OBEX object pusher for Linux, using the 
	  BlueZ BlueTooth stack.

	  http://xmailserver.org/ussp-push.html
```

## package/ustl/Config.in
```kconfig
config ADK_PACKAGE_USTL
	prompt "ustl.............................. C++ Standard Template Library for embedded systems"
	tristate
	default n
	depends on ADK_CXX
	help
	  uSTL is a partial implementation of the STL (Standard Template 
	  Library) that reduces code size by factoring memory management 
	  code into a non-template base class and deriving containers 
	  from it.
	  
	  http://ustl.sourceforge.net/
```

## package/util-linux-ng/Config.in
```kconfig
config ADK_COMPILE_UTIL_LINUX_NG
	tristate
	default n
	depends on ADK_PACKAGE_FDISK || ADK_PACKAGE_SWAP_UTILS

config ADK_PACKAGE_FDISK
	prompt "fdisk............................. Partition table manipulation utility"
	tristate
	default n
	select ADK_COMPILE_UTIL_LINUX_NG
	help
	  A partition table manipulation utility
	  
config ADK_PACKAGE_LOSETUP
	prompt "losetup........................... Loop devices setup and control utility"
	tristate
	default n
	select ADK_COMPILE_UTIL_LINUX_NG
	select ADK_KPACKAGE_KMOD_BLK_DEV_LOOP
	help
	  A loop devices setup and control utility
	  
config ADK_PACKAGE_SWAP_UTILS
	prompt "swap-utils........................ Swap space management utilities"
	tristate
	default n
	select ADK_COMPILE_UTIL_LINUX_NG
	select ADK_PACKAGE_LIBBLKID
	help
	  A collection of tools to manage swap space :
	    * mkswap
	    * swapon
	    * swapoff
```

## package/util-linux/Config.in
```kconfig
config ADK_COMPILE_UTIL_LINUX
	tristate
	default n
	depends ADK_PACKAGE_FDISK || ADK_PACKAGE_SWAP_UTILS

config ADK_PACKAGE_FDISK
	prompt "fdisk............................. Partition table manipulation utility"
	tristate
	default n
	select ADK_COMPILE_UTIL_LINUX
	help
	  A partition table manipulation utility
	  
	  http://www.kernel.org/pub/linux/utils/util-linux/

config ADK_PACKAGE_LOSETUP
	prompt "losetup........................... Loop devices setup and control utility"
	tristate
	default n
	select ADK_COMPILE_UTIL_LINUX
	select ADK_KPACKAGE_KMOD_BLK_DEV_LOOP
	help
	  A loop devices setup and control utility
	  
	  http://www.kernel.org/pub/linux/utils/util-linux/

config ADK_PACKAGE_SWAP_UTILS
	prompt "swap-utils........................ Swap space management utilities"
	tristate
	default n
	select ADK_COMPILE_UTIL_LINUX
	help
	  A collection of tools to manage swap space :
	    * mkswap
	    * swapon
	    * swapoff
	  
	  http://www.kernel.org/pub/linux/utils/util-linux/
```

## package/valgrind/Config.in
```kconfig
config ADK_PACKAGE_VALGRIND
	prompt "valgrind.......................... a memory error detector and more"
	tristate
	default n
	depends on ADK_LINUX_X86_ALIX1C || \
		   ADK_LINUX_X86_QEMU
	help
	  http://valgrind.org/
```
