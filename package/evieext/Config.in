## package/evieext/Config.in
```kconfig
config ADK_PACKAGE_XPROTO
	prompt "xproto................................. X protocol library"
	tristate
	default n
	help
         http://www.x.org
```

## package/exmap/Config.in
```kconfig
config ADK_COMPILE_EXMAP
	tristate
	default n

config ADK_PACKAGE_EXMAP
	prompt "exmap............................. exmap-console utility"
	tristate
	select ADK_COMPILE_EXMAP
	select ADK_PACKAGE_GLIB2
	select ADK_PACKAGE_LIBREADLINE
	select ADK_PACKAGE_KMOD_EXMAP
	default n
	help
	  http://labs.o-hand.com/exmap-console/

config ADK_PACKAGE_EXMAPD
	prompt "exmapd............................ exmap daemon"
	tristate
	select ADK_COMPILE_EXMAP
	select ADK_PACKAGE_GLIB2
	select ADK_PACKAGE_LIBREADLINE
	select ADK_PACKAGE_KMOD_EXMAP
	default n
	help
	  http://labs.o-hand.com/exmap-console/

config ADK_PACKAGE_EXMAPSERVER
	prompt "exmapserver....................... exmap server"
	tristate
	select ADK_COMPILE_EXMAP
	select ADK_PACKAGE_GLIB2
	select ADK_PACKAGE_LIBREADLINE
	select ADK_PACKAGE_KMOD_EXMAP
	default n
	help
	  http://labs.o-hand.com/exmap-console/

config ADK_PACKAGE_KMOD_EXMAP
	tristate
	default n
	help
```

## package/expat/Config.in
```kconfig
config ADK_COMPILE_EXPAT
	tristate
	default n
	depends ADK_PACKAGE_LIBEXPAT

config ADK_PACKAGE_LIBEXPAT
	prompt "libexpat.......................... A fast, non-validating, stream-oriented XML parsing library"
	tristate
	default n
	select ADK_COMPILE_EXPAT
	help
	  A fast, non-validating, stream-oriented XML parsing library

	  http://expat.sourceforge.net/
```

## package/ez-ipupdate/Config.in
```kconfig
config ADK_PACKAGE_EZIPUPDATE
	prompt "ez-ipupdate....................... Client for most dynamic DNS services"
	tristate
	default n
	help
	  A client for many Dynamic DNS services.

	  http://ez-ipupdate.com/
```

## package/faad2/Config.in
```kconfig
config ADK_COMPILE_FAAD2
	tristate
	default n
	depends on ADK_PACKAGE_LIBFAAD2

config ADK_PACKAGE_LIBFAAD2
	prompt "libfaad2.......................... MP4 decoding library"
	tristate
	select ADK_COMPILE_FAAD2
	default n
	help
          FAAD2 is the fastest ISO AAC audio decoder available.
          FAAD2 correctly decodes all MPEG-4 and MPEG-2 MAIN,
          LOW, LTP, LD and ER object type AAC files.
	  http://www.audiocoding.com/faad2.html
```

## package/fakeidentd/Config.in
```kconfig
config ADK_PACKAGE_FAKEIDENTD
	prompt "fakeidentd........................ A static, secure identd."
	tristate
	default n
	help
	  A static secure identd, only one source file.

	  http://www.guru-group.fi/~too/sw/releases/
```

## package/fbset/Config.in
```kconfig
config ADK_PACKAGE_FBSET
	prompt "fbset............................. framebuffer utility"
	tristate
	default n
	help
	  http://users.telenet.be/geertu/Linux/fbdev/
```

## package/fetchmail/Config.in
```kconfig
config ADK_PACKAGE_FETCHMAIL
	prompt "fetchmail......................... Remote mail retriever"
	tristate
	default n
	help
		Retrieves remote mail via POP/IMAP

		Very useful in conjunction with mutt or pine.
		Known to be full of security holes, beware.

config ADK_PACKAGE_FETCHMAIL_SSL
	bool "Enable SSL/TLS support"
	depends on ADK_PACKAGE_FETCHMAIL
	select ADK_PACKAGE_LIBOPENSSL
	default n
	help
	  Enable this to be able to retrieve mails more securely.
```

## package/ffmpeg/Config.in
```kconfig
config ADK_PACKAGE_FFMPEG
	tristate "ffmpeg............................ audio/video multimedia library"
	default n
	help
	  cross-platform solution to record, convert and stream audio and video.
	  http://www.ffmpeg.org
```

## package/fixesproto/Config.in
```kconfig
config ADK_PACKAGE_FIXESPROTO
	prompt "fixesproto............................. X protocol library"
	tristate
	default n
	help
         http://www.x.org
```

## package/flac/Config.in
```kconfig
config ADK_COMPILE_FLAC
	tristate
	default n
	depends ADK_PACKAGE_LIBFLAC

config ADK_PACKAGE_LIBFLAC
	prompt "libflac........................... Free Lossless Audio Codec library"
	tristate
	default n
	select ADK_COMPILE_FLAC
	help
	  Free Lossless Audio Codec library

	  http://flac.sourceforge.net/
```

## package/flex/Config.in
```kconfig
config ADK_PACKAGE_FLEX
	prompt "flex.............................. Fast lexical analyzer"
	tristate
	default n
	help
	  http://www.gnu.org/software/flex/
```

## package/fontconfig/Config.in
```kconfig
config ADK_PACKAGE_FONTCONFIG
	prompt "fontconfig........................ fontconfig library"
	tristate
	default n
	help
```

## package/fontsproto/Config.in
```kconfig
config ADK_PACKAGE_FONTSPROTO
	prompt "fontsproto.............................. X protocol library"
	tristate
	default n
	help
         http://www.x.org
```

## package/fprobe-ulog/Config.in
```kconfig
config ADK_PACKAGE_FPROBE_ULOG
	prompt "fprobe-ulog....................... NetFlow probe (ulog-based)"
	tristate
	default n
	select ADK_PACKAGE_LIBPTHREAD
	help
	  A NetFlow probe obtaining packets through linux netfilter code
	  (iptables ULOG target).

	  http://fprobe.sourceforge.net/
```

## package/fprobe/Config.in
```kconfig
config ADK_PACKAGE_FPROBE
	prompt "fprobe............................ NetFlow probe (libpcap-based)"
	tristate
	default n
	select ADK_PACKAGE_LIBPCAP
	select ADK_PACKAGE_LIBPTHREAD
	help
	  A NetFlow probe using libpcap

	  http://fprobe.sourceforge.net/
```

## package/freeradius-client/Config.in
```kconfig
config ADK_COMPILE_FREERADIUS_CLIENT
	tristate
	default n
	depends ADK_PACKAGE_LIBFREERADIUS_CLIENT

config ADK_PACKAGE_FREERADIUS_CLIENT
	prompt "freeradius-client................. RADIUS client"
	tristate
	default n
	select ADK_PACKAGE_LIBOPENSSL
	select ADK_PACKAGE_LIBFREERADIUS_CLIENT
	help
	  http://freeradius.org/freeradius-client/	

config ADK_PACKAGE_LIBFREERADIUS_CLIENT
	prompt "libfreeradius-client.............. RADIUS client library"
	tristate
	default n
	select ADK_COMPILE_FREERADIUS_CLIENT
	help
	  http://freeradius.org/freeradius-client/
```

## package/freeradius-server/Config.in
```kconfig
config ADK_PACKAGE_FREERADIUS_SERVER
	prompt "freeradius-server................. Flexible RADIUS server"
	tristate
	default n
	select ADK_PACKAGE_LIBLTDL
	select ADK_PACKAGE_LIBOPENSSL
	select ADK_PACKAGE_LIBPTHREAD
	help
	  A flexible RADIUS server
	  http://www.freeradius.org/

config ADK_PACKAGE_FREERADIUS_DEMOCERTS
	prompt   "freeradius-democerts.......... Demo certificates to test the server"
	tristate
	default n
	depends on ADK_PACKAGE_FREERADIUS_SERVER

config ADK_PACKAGE_FREERADIUS_MOD_CHAP
	prompt   "freeradius-mod-chap........... CHAP module"
	tristate
	default n
	depends on ADK_PACKAGE_FREERADIUS_SERVER

config ADK_PACKAGE_FREERADIUS_MOD_DETAIL
	prompt   "freeradius-mod-detail......... Detailed accounting module"
	tristate
	default n
	depends on ADK_PACKAGE_FREERADIUS_SERVER

config ADK_PACKAGE_FREERADIUS_MOD_DIGEST
	prompt   "freeradius-mod-digest......... Digest authentication"
	tristate
	default n
	depends on ADK_PACKAGE_FREERADIUS_SERVER

config ADK_PACKAGE_FREERADIUS_MOD_FILES
	prompt   "freeradius-mod-files.......... Module using local files for authorization"
	tristate
	default y
	depends on ADK_PACKAGE_FREERADIUS_SERVER

config ADK_PACKAGE_FREERADIUS_MOD_LDAP
	prompt   "freeradius-mod-ldap........... LDAP module"
	tristate
	default n
	select ADK_PACKAGE_LIBOPENLDAP
	depends on ADK_PACKAGE_FREERADIUS_SERVER

config ADK_PACKAGE_FREERADIUS_MOD_MSCHAP
	prompt   "freeradius-mod-mschap......... MS-CHAP and MS-CHAPv2 module"
	tristate
	default n
	depends on ADK_PACKAGE_FREERADIUS_SERVER

config ADK_PACKAGE_FREERADIUS_MOD_PAP
	prompt   "freeradius-mod-pap............ PAP module"
	tristate
	default n
	depends on ADK_PACKAGE_FREERADIUS_SERVER

config ADK_PACKAGE_FREERADIUS_MOD_PREPROCESS
	prompt   "freeradius-mod-preprocess..... Request pre-processing module"
	tristate
	default n
	depends on ADK_PACKAGE_FREERADIUS_SERVER

config ADK_PACKAGE_FREERADIUS_MOD_REALM
	prompt   "freeradius-mod-realm.......... Realms handling module"
	tristate
	default n
	depends on ADK_PACKAGE_FREERADIUS_SERVER

config ADK_PACKAGE_FREERADIUS_MOD_SQL
	prompt   "freeradius-mod-sql............ Base SQL module"
	tristate
	default n
	depends on ADK_PACKAGE_FREERADIUS_SERVER

config ADK_PACKAGE_FREERADIUS_MOD_SQL_MYSQL
	prompt     "freeradius-mod-sql-mysql.... MySQL module"
	tristate
	default n
	depends on ADK_CXX
	depends on ADK_PACKAGE_FREERADIUS_MOD_SQL
	select ADK_PACKAGE_LIBMYSQLCLIENT

config ADK_PACKAGE_FREERADIUS_MOD_SQL_PGSQL
	prompt     "freeradius-mod-sql-pgsql.... PostgreSQL module"
	tristate
	default n
	depends on ADK_PACKAGE_FREERADIUS_MOD_SQL
	select ADK_PACKAGE_LIBPQ

config ADK_PACKAGE_FREERADIUS_UTILS
	prompt   "freeradius-utils.............. Misc. client utilities"
	tristate
	default n
	depends on ADK_PACKAGE_FREERADIUS_SERVER
```

## package/freeradius/Config.in
```kconfig
#menu "freeradius........................ A Flexible RADIUS server implementation"

config ADK_PACKAGE_FREERADIUS
	prompt "freeradius........................ Flexible RADIUS server"
	tristate
	default n
	select ADK_PACKAGE_LIBLTDL
	select ADK_PACKAGE_LIBOPENSSL
	select ADK_PACKAGE_LIBPTHREAD
	help
	  A flexible RADIUS server

	  http://www.freeradius.org/

	  Depends:
	    - libltdl
	    - libopenssl
	    - libpthread
	    - libmysqlclient (for MySQL support)
	    - libopenldap (for LDAP support)
	    - libpq (for PostgreSQL support)

config ADK_PACKAGE_FREERADIUS_DEMOCERTS
	prompt   "  freeradius-democerts.......... Demo certificates to test the server"
	tristate
	default n
	depends ADK_PACKAGE_FREERADIUS

config ADK_PACKAGE_FREERADIUS_MOD_CHAP
	prompt   "  freeradius-mod-chap........... CHAP module"
	tristate
	default n
	depends ADK_PACKAGE_FREERADIUS

config ADK_PACKAGE_FREERADIUS_MOD_DETAIL
	prompt   "  freeradius-mod-detail......... Detailed accounting module"
	tristate
	default n
	depends ADK_PACKAGE_FREERADIUS

config ADK_PACKAGE_FREERADIUS_MOD_DIGEST
	prompt   "  freeradius-mod-digest......... Digest authentication"
	tristate
	default n
	depends ADK_PACKAGE_FREERADIUS

config ADK_PACKAGE_FREERADIUS_MOD_EAP
	prompt   "  freeradius-mod-eap............ Base EAP module"
	tristate
	default n
	depends ADK_PACKAGE_FREERADIUS

config ADK_PACKAGE_FREERADIUS_MOD_EAP_GTC
	prompt     "  freeradius-mod-eap-gtc...... EAP/GTC module"
	tristate
	default n
	depends ADK_PACKAGE_FREERADIUS_MOD_EAP

config ADK_PACKAGE_FREERADIUS_MOD_EAP_MD5
	prompt     "  freeradius-mod-eap-md5...... EAP/MD5 module"
	tristate
	default n
	depends ADK_PACKAGE_FREERADIUS_MOD_EAP

config ADK_PACKAGE_FREERADIUS_MOD_EAP_MSCHAPV2
	prompt     "  freeradius-mod-eap-mschapv2. EAP/MS-CHAPv2 module"
	tristate
	default n
	depends ADK_PACKAGE_FREERADIUS_MOD_EAP

config ADK_PACKAGE_FREERADIUS_MOD_EAP_PEAP
	prompt     "  freeradius-mod-eap-peap..... EAP/PEAP module"
	tristate
	default n
	depends ADK_PACKAGE_FREERADIUS_MOD_EAP

config ADK_PACKAGE_FREERADIUS_MOD_EAP_TLS
	prompt     "  freeradius-mod-eap-tls...... EAP/TLS module"
	tristate
	default n
	depends ADK_PACKAGE_FREERADIUS_MOD_EAP

config ADK_PACKAGE_FREERADIUS_MOD_EAP_TTLS
	prompt       "  freeradius-mod-eap-ttls... EAP/TTLS module"
	tristate
	default n
	depends ADK_PACKAGE_FREERADIUS_MOD_EAP_TLS

config ADK_PACKAGE_FREERADIUS_MOD_FILES
	prompt   "  freeradius-mod-files.......... Module using local files for authorization"
	tristate
	default y
	depends ADK_PACKAGE_FREERADIUS

config ADK_PACKAGE_FREERADIUS_MOD_LDAP
	prompt   "  freeradius-mod-ldap........... LDAP module"
	tristate
	default n
	select ADK_PACKAGE_LIBOPENLDAP
	depends ADK_PACKAGE_FREERADIUS

config ADK_PACKAGE_FREERADIUS_MOD_MSCHAP
	prompt   "  freeradius-mod-mschap......... MS-CHAP and MS-CHAPv2 module"
	tristate
	default n
	depends ADK_PACKAGE_FREERADIUS

config ADK_PACKAGE_FREERADIUS_MOD_PAP
	prompt   "  freeradius-mod-pap............ PAP module"
	tristate
	default n
	depends ADK_PACKAGE_FREERADIUS

config ADK_PACKAGE_FREERADIUS_MOD_PREPROCESS
	prompt   "  freeradius-mod-preprocess..... Request pre-processing module"
	tristate
	default n
	depends ADK_PACKAGE_FREERADIUS

config ADK_PACKAGE_FREERADIUS_MOD_REALM
	prompt   "  freeradius-mod-realm.......... Realms handling module"
	tristate
	default n
	depends ADK_PACKAGE_FREERADIUS

config ADK_PACKAGE_FREERADIUS_MOD_SQL
	prompt   "  freeradius-mod-sql............ Base SQL module"
	tristate
	default n
	depends ADK_PACKAGE_FREERADIUS

config ADK_PACKAGE_FREERADIUS_MOD_SQL_MYSQL
	prompt     "  freeradius-mod-sql-mysql.... MySQL module"
	tristate
	default n
	depends on ADK_CXX
	depends ADK_PACKAGE_FREERADIUS_MOD_SQL
	select ADK_PACKAGE_LIBMYSQLCLIENT

config ADK_PACKAGE_FREERADIUS_MOD_SQL_PGSQL
	prompt     "  freeradius-mod-sql-pgsql.... PostgreSQL module"
	tristate
	default n
	depends ADK_PACKAGE_FREERADIUS_MOD_SQL
	select ADK_PACKAGE_LIBPQ

config ADK_PACKAGE_FREERADIUS_UTILS
	prompt   "  freeradius-utils.............. Misc. client utilities"
	tristate
	default n
	depends ADK_PACKAGE_FREERADIUS

#endmenu
```

## package/freetype/Config.in
```kconfig
config ADK_COMPILE_FREETYPE
	tristate
	default n
	depends on ADK_PACKAGE_LIBFREETYPE

config ADK_PACKAGE_LIBFREETYPE
	tristate "libfreetype....................... A free, high-quality and portable font engine"
	default n
	select ADK_COMPILE_FREETYPE
	select ADK_PACKAGE_ZLIB
	help
	  The FreeType project is a team of volunteers who develop free,
	  portable and high-quality software solutions for digital typography.
	  They specifically target embedded systems and focus on bringing small,
	  efficient and ubiquitous products.

	  The FreeType 2 library is their new software font engine.  It has been
	  designed to provide the following important features:
	   * A universal and simple API to manage font files
	   * Support for several font formats through loadable modules
	   * High-quality anti-aliasing
	   * High portability & performance

	  http://www.freetype.org/
```

## package/fuse/Config.in
```kconfig
config ADK_COMPILE_FUSE
	tristate
	default n

config ADK_PACKAGE_FUSE_UTILS
	prompt   "fuse-utils........................ FUSE utilities"
	tristate
	default n
	select ADK_COMPILE_FUSE
	select ADK_KPACKAGE_KMOD_FUSE_FS
	help
	  With FUSE it is possible to implement a fully functional 
	  filesystem in a userspace program.
	  
	  Features include:
	  
	   * Simple library API
	   * Simple installation (no need to patch or recompile the kernel)
	   * Secure implementation
	   * Userspace - kernel interface is very efficient
	   * Usable by non privileged users
	   * Runs on Linux kernels 2.4.X and 2.6.X
	   * Has proven very stable over time
	  
	  http://fuse.sourceforge.net/
	  
	  This package contains the fusermount userland utility.
```

## package/gatling/Config.in
```kconfig
config ADK_PACKAGE_GATLING
	prompt "gatling........................... non-forking FAST webserver"
	tristate
	default n
	select ADK_COMPILE_LIBOWFAT
	select ADK_PACKAGE_LIBICONV
	help
	  gatling is a high-performance non-forking small webserver.
	  
	  http://www.fefe.de/gatling/
```

## package/gawk/Config.in
```kconfig
config ADK_PACKAGE_GAWK
	prompt "gawk.............................. GNU awk"
	tristate
	default n
	help
	  http://www.gnu.org/software/gawk/
```

## package/gcc/Config.in
```kconfig
config ADK_PACKAGE_GCC
	prompt "gcc............................... GNU Compiler Collection"
	tristate
	default n
	select ADK_PACKAGE_LIBGMP
	select ADK_PACKAGE_MPFR
	depends on !ADK_HOST_FREEBSD
	help
	  GCC
	  http://www.gnu.org/gcc
```

## package/gdb/Config.in
```kconfig
config ADK_PACKAGE_GDB
	prompt "gdb............................... GNU debugger"
	tristate
	default n
	select ADK_PACKAGE_LIBNCURSES
	select ADK_PACKAGE_LIBTHREAD_DB
	depends on !ADK_LINUX_CRIS_FOXBOARD
	help
	 GDB is a program for debugging applications.
```
