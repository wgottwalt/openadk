## target/Config.in
```kconfig
# This file is part of the OpenADK project. OpenADK is copyrighted
# material, please see the LICENCE file in the top-level directory.

# mark broken devices
config ADK_BROKEN
	bool

config ADK_TARGET_WITH_USB
	bool

config ADK_TARGET_WITH_PCI
	bool

config ADK_TARGET_WITH_SSB
	bool

config ADK_TARGET_WITH_MINIPCI
	bool

config ADK_TARGET_WITH_VGA
	bool

config ADK_TARGET_WITH_HDD
	bool

config ADK_TARGET_WITH_SATA
	bool

config ADK_TARGET_WITH_INPUT
	bool

config ADK_TARGET_WITH_LEDS
	bool

config ADK_TARGET_WITH_PP
	bool

config ADK_TARGET_WITH_CARDBUS
	bool

config ADK_TARGET_WITH_RTC
	bool

config ADK_TARGET_WITH_WATCHDOG
	bool

config ADK_TARGET_WITH_DSL
	bool

config ADK_TARGET_CPU_WITH_VT
	bool

config ADK_TOOLCHAIN_ONLY
	bool

config ADK_TARGET_NO_FPU
	bool

config ADK_EABI
	bool

config ADK_LINUX_64
	bool

config ADK_NATIVE
	tristate

config ADK_alix
	tristate

config ADK_wrap
	tristate

config ADK_arm
	tristate

config ADK_armel
	tristate

config ADK_mips
	tristate

config ADK_mipsel
	tristate

config ADK_mips64
	tristate

config ADK_mips64el
	tristate

config ADK_ppc
	tristate

config ADK_sparc
	tristate

config ADK_sparc64
	tristate

config ADK_rb532
	tristate

config ADK_rb4xx
	tristate

config ADK_zaurus
	tristate

config ADK_foxg20
	tristate

config ADK_foxboard
	tristate

config ADK_brcm
	tristate

config ADK_ag241
	tristate

config ADK_x86_64
	tristate

config ADK_x86
	tristate

config ADK_qemu
	boolean

config ADK_ibm_x40
	boolean

config ADK_lemote_yeelong
	boolean

config ADK_shuttle_sa76g2
	boolean

config ADK_HW
	string
	default "qemu" if ADK_qemu
	default "ibm-x40" if ADK_ibm_x40
	default "shuttle-sa76g2" if ADK_shuttle_sa76g2
	default "lemote-yeelong" if ADK_lemote_yeelong

config ADK_TARGET
	string
	default "arm"  if ADK_arm
	default "armel"  if ADK_armel
	default "mips"  if ADK_mips
	default "mipsel"  if ADK_mipsel
	default "mips64"  if ADK_mips64
	default "mips64el"  if ADK_mips64el
	default "ppc"  if ADK_ppc
	default "sparc"  if ADK_sparc
	default "sparc64"  if ADK_sparc64
	default "x86"  if ADK_x86
	default "x86_64"  if ADK_x86_64
	default "alix"  if ADK_alix
	default "wrap"  if ADK_wrap
	default "brcm"  if ADK_brcm
	default "foxboard"  if ADK_foxboard
	default "foxg20"  if ADK_foxg20
	default "rb532"  if ADK_rb532
	default "rb4xx"  if ADK_rb4xx
	default "ag241"  if ADK_ag241
	default "native"  if ADK_NATIVE

config ADK_HARDWARE_QEMU
	boolean

config ADK_CPU_SPARC_V8
	boolean

config ADK_CPU_SPARC_V9
	boolean

config ADK_CPU_I686
	boolean

config ADK_CPU_PENTIUM_M
	boolean

config ADK_CPU_AMDFAM10
	select ADK_TARGET_CPU_WITH_VT
	boolean

config ADK_CPU_LOONGSON2F
	boolean

config ADK_TARGET_CFLAGS
	string
	default "-march=i686" if ADK_CPU_I686
	default "-march=pentium-m" if ADK_CPU_PENTIUM_M
	default "-march=amdfam10" if ADK_CPU_AMDFAM10
	default "-mcpu=v8" if ADK_CPU_SPARC_V8
	default "-mcpu=v9" if ADK_CPU_SPARC_V9
	default "-march=loongson2f" if ADK_CPU_LOONGSON2F

# c library
config ADK_uclibc
	tristate

config ADK_eglibc
	tristate

config ADK_glibc
	tristate

config ADK_libc
	tristate

config ADK_LIBC
	string
	default "uclibc"  if ADK_uclibc
	default "eglibc"  if ADK_eglibc
	default "glibc"  if ADK_glibc
	default "libc"  if ADK_libc

menu "Target system"
choice
prompt "Embedded devices or architecture"

config ADK_TARGET_CHOICE
	bool "embedded devices"
	help
	  choose between specific embedded devices.

config ADK_ARCH_CHOICE
	bool "architectures"
	help
	  choose between architectures and hardware profiles.

endchoice

choice
prompt "Architectures and hardware profiles"
depends on ADK_ARCH_CHOICE
default ADK_LINUX_X86

config ADK_LINUX_NATIVE
	bool "native build"
	select ADK_libc
	select ADK_NATIVE
	select ADK_TARGET_WITH_VGA
	select ADK_TARGET_WITH_USB
	depends on ADK_HOST_LINUX
	help
	  Make a native build. Use host tools.
	  No toolchain will be created.

config ADK_LINUX_ARM
	bool "arm system (big endian)"
	select ADK_arm
	help
	  Support for arm big endian systems.


config ADK_LINUX_ARMEL
	bool "arm system (little endian)"
	select ADK_armel
	help
	  Support for arm little endian systems.


config ADK_LINUX_MIPS
	bool "mips system (big endian)"
	select ADK_mips
	help
	  Support for mips big endian systems.

config ADK_LINUX_MIPSEL
	bool "mips system (little endian)"
	select ADK_mipsel
	help
	  Support for mips little endian systems.

config ADK_LINUX_MIPS64
	bool "mips64 system (big endian)"
	select ADK_mips64
	help
	  Support for mips64 big endian systems.

config ADK_LINUX_MIPS64EL
	bool "mips64 system (little endian)"
	select ADK_mips64el
	help
	  Support for mips64 little endian systems.

config ADK_LINUX_PPC
	bool "ppc system"
	select ADK_ppc
	help
	  Support for powerpc systems.

config ADK_LINUX_SPARC
	bool "sparc system"
	select ADK_sparc
	help
	  Support for sparc systems.

config ADK_LINUX_SPARC64
	bool "sparc64 system"
	select ADK_sparc64
	help
	  Support for sparc64 systems.

config ADK_LINUX_X86
	bool "x86 system"
	select ADK_x86
	help
	  Support for x86 systems.

config ADK_LINUX_X86_64
	bool "x86_64 system"
	select ADK_x86_64
	help
	  Support for x86_64/amd64 systems.

endchoice

choice
prompt "Embedded Devices"
depends on ADK_TARGET_CHOICE

config ADK_LINUX_X86_ALIX
	bool "PC Engines ALIX boards"
	select ADK_alix
	help
	  Support for Alix boards.
	  http://www.pcengines.ch
	  Status: stable

config ADK_LINUX_X86_WRAP
	bool "PC Engines WRAP boards"
	select ADK_wrap
	select ADK_KERNEL_SCSI
	select ADK_KERNEL_ATA
	select ADK_KERNEL_BLK_DEV_SD
	select ADK_KERNEL_EXT2_FS
	select ADK_KERNEL_NET_PCI
	select ADK_KERNEL_NETDEVICES
	select ADK_KERNEL_NET_ETHERNET
	select ADK_KERNEL_MII
	select ADK_TARGET_WITH_WATCHDOG
	select ADK_TARGET_WITH_RTC
	help
	  End of life.
	  http://www.pcengines.ch/
	  Status: stable

config ADK_LINUX_ARM_FOXG20
	bool "Foxboard (FOXG20)"
	select ADK_foxg20
	select ADK_EABI
	select ADK_KERNEL_NLS
	select ADK_KERNEL_EXT2_FS
	select ADK_KERNEL_USB
	select ADK_KPACKAGE_KMOD_VFAT_FS
	select ADK_PACKAGE_KMOD_USB_CONTROLLER
	select ADK_KERNEL_NETDEVICES
	select ADK_KERNEL_NET_PCI
	select ADK_KERNEL_NET_ETHERNET
	select ADK_KERNEL_MII
	select ADK_TARGET_WITH_USB
	help
	  Support for Foxboard target (foxg20).
	  http://foxg20.acmesystems.it/doku.php
	  Status: stable

config ADK_LINUX_CRIS_FOXBOARD
	bool "Foxboard (ETRAX LX100)"
	select ADK_foxboard
	select ADK_PACKAGE_KMOD_USB_CONTROLLER
	select ADK_KERNEL_USB
	select ADK_KERNEL_NLS
	select ADK_KERNEL_NETDEVICES
	select ADK_TARGET_WITH_USB
	help
	  Support for Foxboard targets.
	  http://foxlx.acmesystems.it/
	  Status: stable

config ADK_LINUX_MIKROTIK
	bool "Mikrotik Routerboards"
	help
	  Support for Mikrotik Routerboards
	  http://www.mikrotik.com
	  http://www.routerboards.com

config ADK_LINUX_MIPS_AG241
	bool "Linksys AG241v2"
	select ADK_KERNEL_NETDEVICES
	select ADK_KERNEL_NET_PCI
	select ADK_KERNEL_NET_ETHERNET
	select ADK_KERNEL_MII
	select ADK_PACKAGE_KMOD_SANGAM_ATM
	select ADK_KPACKAGE_KMOD_ATM_BR2684
	select ADK_PACKAGE_BR2684CTL
	select ADK_TARGET_WITH_DSL
	select ADK_TARGET_WITH_WATCHDOG
	select ADK_ag241
	help
	  Linksys AG241 DSL router.
	  (Texas Instruments AR7 platform)
	  Status: stable

config ADK_LINUX_MIPS_BRCM
	bool "Broadcom BCM47xx based routers"
	select ADK_brcm
	select ADK_TARGET_WITH_SSB
	select ADK_KERNEL_NETDEVICES
	select ADK_KERNEL_NET_PCI
	select ADK_KERNEL_NET_ETHERNET
	select ADK_KERNEL_MII
	help
	  Broadcom bcm47xx based router.
	  Status: development

endchoice

source "target/Config.in.alix"
source "target/Config.in.mikrotik"
source "target/Config.in.arm"
source "target/Config.in.armel"
source "target/Config.in.mips"
source "target/Config.in.mipsel"
source "target/Config.in.mips64"
source "target/Config.in.mips64el"
source "target/Config.in.ppc"
source "target/Config.in.ppc64"
source "target/Config.in.sparc"
source "target/Config.in.sparc64"
source "target/Config.in.x86"
source "target/Config.in.x86_64"

choice
prompt "Device model"
default ADK_LINUX_CRIS_FOXBOARD_CLASSIC
depends on ADK_LINUX_CRIS_FOXBOARD

config ADK_LINUX_CRIS_FOXBOARD_CLASSIC
	bool "Foxboard classic (4x16)"
	help
	  Foxboard classic with red board.
	  (4 MB flash size and 16 MB RAM)

config ADK_LINUX_CRIS_FOXBOARD_LX
	bool "Foxboard LX (8x32)"
	help
	  Latest Foxboard with green board.
	  (8 MB flash size and 32 MB RAM)

endchoice

source "target/linux/config/Config.in.kernel"

choice 
prompt "Target C library"
depends on ! ADK_NATIVE
config ADK_TARGET_LIB_UCLIBC
	bool "uClibc embedded C library"
	depends on \
		   !ADK_HARDWARE_LEMOTE_YEELONG && \
		   !ADK_LINUX_SPARC64
	select ADK_uclibc
	help
 	 http://uclibc.org

config ADK_TARGET_LIB_EGLIBC
	bool "Embedded GNU C library"
	select ADK_eglibc
	depends on ADK_LINUX_QEMU || \
		ADK_LINUX_ARM || \
		ADK_LINUX_ARMEL || \
		ADK_LINUX_MIPS || \
		ADK_LINUX_MIPSEL || \
		ADK_LINUX_MIPS64 || \
		ADK_LINUX_MIPS64EL || \
		ADK_LINUX_PPC || \
		ADK_LINUX_SPARC || \
		ADK_LINUX_SPARC64 || \
		ADK_LINUX_X86 || \
		ADK_LINUX_X86_64 || \
		ADK_LINUX_ARM_FOXG20 || \
		ADK_LINUX_X86_ALIX || \
		ADK_LINUX_X86_WRAP || \
		ADK_LINUX_MIPS_RB4XX || \
		ADK_LINUX_MIPS_RB532
	help
	 http://www.eglibc.org

config ADK_TARGET_LIB_GLIBC
	bool "GNU C library"
	select ADK_glibc
	depends on ADK_LINUX_QEMU || \
		ADK_LINUX_ARM || \
		ADK_LINUX_ARMEL || \
		ADK_LINUX_MIPS || \
		ADK_LINUX_MIPSEL || \
		ADK_LINUX_MIPS64 || \
		ADK_LINUX_MIPS64EL || \
		ADK_LINUX_PPC || \
		ADK_LINUX_SPARC || \
		ADK_LINUX_SPARC64 || \
		ADK_LINUX_X86 || \
		ADK_LINUX_X86_64 || \
		ADK_LINUX_X86_ALIX || \
		ADK_LINUX_X86_WRAP || \
		ADK_LINUX_MIPS_RB532 || \
		ADK_LINUX_MIPS_RB4XX
	help
	 http://www.gnu.org/libc

endchoice

config ADK_TARGET_SUFFIX
	string
	default "gnueabi" if (ADK_TARGET_LIB_GLIBC || ADK_TARGET_LIB_EGLIBC) && ADK_EABI
	default "gnu" if (ADK_TARGET_LIB_GLIBC || ADK_TARGET_LIB_EGLIBC) && !ADK_EABI
	default "uclibcgnueabi" if ADK_TARGET_LIB_UCLIBC && ADK_EABI
	default "uclibc" if ADK_TARGET_LIB_UCLIBC && !ADK_EABI

choice
prompt "Target Firmware type"
	depends on !ADK_TOOLCHAIN_ONLY
	default ADK_TARGET_ROOTFS_ARCHIVE

config ADK_TARGET_ROOTFS_INITRAMFS
	bool "initramfs filesystem"
	depends on \
		ADK_LINUX_X86 || \
		ADK_LINUX_X86_64 || \
		ADK_LINUX_PPC || \
		ADK_LINUX_SPARC || \
		ADK_LINUX_X86_ALIX || \
		ADK_HARDWARE_QEMU || \
		ADK_LINUX_NATIVE
	select ADK_KERNEL_BLK_DEV_INITRD
	help
	  create an read-only initramfs system.

config ADK_TARGET_ROOTFS_INITRAMFS_PIGGYBACK
	bool "initramfs filesystem included into kernel image"
	select ADK_LINUX_INITRAMFS_BUILTIN
	depends on \
		ADK_LINUX_X86_ALIX || \
		ADK_LINUX_PPC || \
		ADK_LINUX_SPARC || \
		ADK_HARDWARE_QEMU || \
		ADK_LINUX_X86 || \
		ADK_LINUX_X86_64 || \
		ADK_LINUX_NATIVE
	help
	  create an read-only initramfs system.

config ADK_TARGET_ROOTFS_SQUASHFS
	bool "Compressed read-only root filesystem (squashfs)"
	select ADK_KERNEL_SQUASHFS
	depends on \
		ADK_LINUX_CRIS_FOXBOARD || \
		ADK_LINUX_MIPS_AG241
	help
	  highly compressed read-only filesystem for flash.

config ADK_TARGET_ROOTFS_YAFFS
	bool "YAFFS2 rootfilesystem (NAND)"
	select ADK_KERNEL_MISC_FILESYSTEMS
	select ADK_KERNEL_YAFFS_FS
	select ADK_KERNEL_YAFFS_YAFFS2
	depends on \
		ADK_LINUX_MIPS_RB532 || \
		ADK_LINUX_MIPS_RB4XX
	help
	  Root filesystem on NAND.

config ADK_TARGET_ROOTFS_NFSROOT
	bool "NFS root"
	depends on \
		ADK_LINUX_CRIS_FOXBOARD || \
		ADK_LINUX_ARM_FOXG20 || \
		ADK_LINUX_X86_ALIX || \
		ADK_LINUX_X86_WRAP || \
		ADK_LINUX_MIPS_BRCM || \
		ADK_LINUX_MIPS_RB532 || \
		ADK_LINUX_MIPS_RB4XX || \
		ADK_LINUX_MIPS_AG241 || \
		ADK_LINUX_NATIVE
	select ADK_KERNEL_SUNRPC
	select ADK_KERNEL_NFS_FS
	select ADK_KERNEL_NFS_V3
	select ADK_KERNEL_ROOT_NFS
	select ADK_KERNEL_NFS_COMMON
	select ADK_KERNEL_IP_PNP
	select ADK_KERNEL_IP_PNP_DHCP
	help
	  Root filesystem mounted via NFS. (DHCP)

config ADK_TARGET_ROOTFS_USB
	bool "Boot from USB stick"
	select ADK_KERNEL_NLS
	select ADK_KERNEL_SCSI
	select ADK_KERNEL_BLK_DEV_SD
	select ADK_KERNEL_USB
	select ADK_KERNEL_USB_EHCI_HCD
	select ADK_KERNEL_USB_UHCI_HCD
	select ADK_KERNEL_USB_STORAGE
	select ADK_KERNEL_EXT2_FS
	depends on ADK_LINUX_X86 || ADK_LINUX_X86_64
	depends on !ADK_HARDWARE_QEMU
	help
	  Boot system from USB stick.

config ADK_TARGET_ROOTFS_EXT2_BLOCK
	bool "read-write filesystem for block devices with ext2"
	depends on ADK_LINUX_X86_ALIX || \
		ADK_LINUX_X86_WRAP || \
		ADK_LINUX_ARM_FOXG20 || \
		ADK_LINUX_MIPS_RB532
	select ADK_KERNEL_EXT2_FS
	select ADK_KERNEL_SCSI
	help
	  Use this option if you have a compact flash or mmc/sd card 
	  reader inside your hardware and want to boot from it.

config ADK_TARGET_ROOTFS_ARCHIVE
	bool "Archive usable for different filesystems"
	depends on \
		ADK_LINUX_NATIVE || \
		ADK_LINUX_ARM || \
		ADK_LINUX_ARMEL || \
		ADK_LINUX_MIPS || \
		ADK_LINUX_MIPSEL || \
		ADK_LINUX_MIPS64 || \
		ADK_LINUX_MIPS64EL || \
		ADK_LINUX_PPC || \
		ADK_LINUX_PPC64 || \
		ADK_LINUX_SPARC || \
		ADK_LINUX_SPARC64 || \
		ADK_LINUX_QEMU || \
		ADK_LINUX_X86 || \
		ADK_LINUX_X86_64
	help
	  Use this option if your root filesystem is ext2/ext3/ext4/xfs.

config ADK_TARGET_ROOTFS_ENCRYPTED
	bool "Encrypted read-write root filesystem"
	select ADK_LINUX_INITRAMFS_BUILTIN
	select ADK_PACKAGE_CRYPTINIT
	select ADK_KERNEL_BLK_DEV_DM
	select ADK_KERNEL_DM_CRYPT
	select ADK_KERNEL_CRYPTO_AES
	select ADK_KERNEL_CRYPTO_CBC
	select ADK_KERNEL_CRYPTO_SHA256
	select ADK_KERNEL_XFS_FS
	depends on ADK_LINUX_X86 || ADK_LINUX_X86_64
	depends on !ADK_HARDWARE_QEMU
	help
	  Use this option if you want an encrypted rootfs.
	  Default is XFS filesystem. Use following commands to setup 
	  your hard disk, after booting via NFS or USB.
	  Create at least three partitions with fdisk
	  /dev/sda1 (ext2)
          /dev/sda2 (encrypted root)
          /dev/sda3 (swap)

	  mkdir /mnt/{boot,root}
	  cryptsetup luksFormat /dev/sda2 
	  cryptsetup luksOpen /dev/sda2 root
	  cryptsetup luksFormat /dev/sda3
	  cryptsetup luksOpen /dev/sda3 swap
	  mkswap /dev/mapper/swap
          mkfs.xfs /dev/mapper/root
          mount /dev/mapper/root /mnt/root
          tar xzvf lemote-mips-encryptedroot.tar.gz -C /mnt/root
          mount /dev/sda1 /mnt/boot
	  mkdir /mnt/boot/boot
	  cp lemote-mips-kernel /mnt/boot/boot
	  mv /mnt/root/boot/boot.cfg /mnt/boot/boot
	  cd /mnt/root ; mknod -m 644 console c 5 1

endchoice

choice
prompt "Compression method for initramfs and kernel"
	depends on ADK_TARGET_ROOTFS_INITRAMFS || ADK_TARGET_ROOTFS_INITRAMFS_PIGGYBACK
	
config ADK_TARGET_INITRAMFS_COMPRESSION_LZMA
	boolean
	prompt "lzma"
	select ADK_KERNEL_RD_LZMA
	select ADK_KERNEL_KERNEL_LZMA
	help
	  Select LZMA compression.

config ADK_TARGET_INITRAMFS_COMPRESSION_GZIP
	boolean
	prompt "gzip"
	select ADK_KERNEL_RD_GZIP
	select ADK_KERNEL_KERNEL_GZIP
	help
	  Select gzip compression.

config ADK_TARGET_INITRAMFS_COMPRESSION_BZIP2
	boolean
	prompt "bzip2"
	select ADK_KERNEL_RD_BZIP2
	select ADK_KERNEL_KERNEL_BZIP2
	help
	  Select BZIP2 compression.

#config ADK_TARGET_INITRAMFS_COMPRESSION_LZO
#	boolean
#	prompt "lzo"
#	select ADK_KERNEL_RD_LZO
#	select ADK_KERNEL_KERNEL_LZO
#	help
#	  Select LZO compression.

endchoice

choice
prompt "Compression method for Kernel"
	depends on !(ADK_TARGET_ROOTFS_INITRAMFS || ADK_TARGET_ROOTFS_INITRAMFS_PIGGYBACK || ADK_TOOLCHAIN_ONLY || ADK_LINUX_ARM_FOXG20 )
	
config ADK_TARGET_KERNEL_COMPRESSION_LZMA
	boolean
	prompt "lzma"
	select ADK_KERNEL_KERNEL_LZMA
	help
	  Select LZMA compression for Kernel.

config ADK_TARGET_KERNEL_COMPRESSION_GZIP
	boolean
	prompt "gzip"
	select ADK_KERNEL_KERNEL_GZIP
	help
	  Select gzip compression for Kernel.

config ADK_TARGET_KERNEL_COMPRESSION_BZIP2
	boolean
	prompt "bzip2"
	select ADK_KERNEL_KERNEL_BZIP2
	help
	  Select BZIP2 compression for Kernel.

config ADK_TARGET_KERNEL_COMPRESSION_LZO
	boolean
	prompt "lzo"
	select ADK_KERNEL_KERNEL_LZO
	help
	  Select LZO compression for Kernel.

endchoice

config ADK_COMPRESSION_TOOL
	string
	default "gzip -n9" if ADK_TARGET_INITRAMFS_COMPRESSION_GZIP
	default "bzip2" if ADK_TARGET_INITRAMFS_COMPRESSION_BZIP2
	default "lzma -9" if ADK_TARGET_INITRAMFS_COMPRESSION_LZMA
	default "lzop" if ADK_TARGET_INITRAMFS_COMPRESSION_LZO
	help

choice
prompt "Root filesystem type"
depends on ADK_TARGET_ROOTFS_ARCHIVE
default ADK_TARGET_ROOT_EXT2_FS

config ADK_TARGET_ROOT_EXT2
	boolean
	prompt "EXT2 filesystem"
	select ADK_KERNEL_EXT2_FS
	help
	  Compile EXT2 filesystem into kernel and use it as root filesystem.

config ADK_TARGET_ROOT_EXT3
	boolean
	prompt "EXT3 filesystem"
	select ADK_KERNEL_EXT3_FS
	help
	  Compile EXT3 filesystem into kernel and use it as root filesystem.

config ADK_TARGET_ROOT_EXT4
	boolean
	prompt "EXT4 filesystem"
	select ADK_KERNEL_EXT4_FS
	help
	  Compile EXT4 filesystem into kernel and use it as root filesystem.

config ADK_TARGET_ROOT_XFS
	boolean
	prompt "XFS filesystem"
	select ADK_KERNEL_XFS_FS
	help
	  Compile XFS filesystem into kernel and use it as root filesystem.


endchoice

config ADK_TARGET_ROOTFS
	string
	default "xfs" if ADK_TARGET_ROOT_XFS
	default "ext2" if ADK_TARGET_ROOT_EXT2
	default "ext3" if ADK_TARGET_ROOT_EXT3
	default "ext4" if ADK_TARGET_ROOT_EXT4
	help

config ADK_PACKAGE_SUFFIX
	string
	default "ipk" if ADK_TARGET_PACKAGE_IPKG
	default "tar.gz" if ADK_TARGET_PACKAGE_TGZ
	help

choice
prompt "Package backend format"
	default ADK_TARGET_PACKAGE_IPKG

config ADK_TARGET_PACKAGE_IPKG
	boolean
	prompt "ipkg package format"
	select BUSYBOX_IPKG
	help
	  Create ipkg packages and use ipkg package management on
          the target.

config ADK_TARGET_PACKAGE_TGZ
	boolean
	prompt "tar archive (no package manager)"
	help
	  Create compressed tar archives of packages.
	  Pre- and post install scripts will be executed in the target
	  directory. There will be no package manager installed onto the target.
	  
endchoice
endmenu
```
