## target/linux/Config.in
```kconfig
source target/linux/config/Config.in.cpu
source target/linux/config/Config.in.block
source target/linux/config/Config.in.flash
source target/linux/config/Config.in.fs
source target/linux/config/Config.in.netdevice
source target/linux/config/Config.in.usb
source target/linux/config/Config.in.graphics
source target/linux/config/Config.in.input
source target/linux/config/Config.in.pcmcia
source target/linux/config/Config.in.network
source target/linux/config/Config.in.netfilter
source target/linux/config/Config.in.audio
source target/linux/config/Config.in.video
source target/linux/config/Config.in.crypto
source target/linux/config/Config.in.bluetooth
source target/linux/config/Config.in.rtc
source target/linux/config/Config.in.watchdog
source target/linux/config/Config.in.leds
source target/linux/config/Config.in.misc
source target/linux/config/Config.in.mips
source target/linux/config/Config.in.lib
source target/linux/config/Config.in.pm
source target/linux/config/Config.in.spi
source target/linux/config/Config.in.kvm
source target/linux/config/Config.in.virtio
source target/linux/config/Config.in.regulator
source target/linux/config/Config.in.gpio
source target/linux/config/Config.in.i2c
source target/linux/config/Config.in.dma
source target/linux/config/Config.in.debug
```

## target/m68k/Config.in
```kconfig
choice
depends on ADK_LINUX_M68K && !ADK_CHOOSE_TARGET_ARCH
prompt "Target system"

config ADK_CHOOSE_TARGET_SYSTEM_M68K
	boolean "Choose target system"

source "target/m68k/Config.in.systems"
endchoice
```

## target/microblaze/Config.in
```kconfig
choice
depends on ADK_LINUX_MICROBLAZE && !ADK_CHOOSE_TARGET_ARCH
prompt "Target system"

config ADK_CHOOSE_TARGET_SYSTEM_MICROBLAZE
        boolean "Choose target system"

source "target/microblaze/Config.in.systems"
endchoice
```

## target/mips/Config.in
```kconfig
choice
depends on ADK_LINUX_MIPS && !ADK_CHOOSE_TARGET_ARCH
prompt "Target system"

config ADK_CHOOSE_TARGET_SYSTEM_MIPS
        boolean "Choose target system"

source "target/mips/Config.in.systems"
endchoice
```

## target/mips64/Config.in
```kconfig
choice
depends on ADK_LINUX_MIPS64 && !ADK_CHOOSE_TARGET_ARCH
prompt "Target system"

config ADK_CHOOSE_TARGET_SYSTEM_MIPS64
        boolean "Choose target system"

source "target/mips64/Config.in.systems"
endchoice
```

## target/mips64el/Config.in
```kconfig
choice
depends on ADK_LINUX_MIPS64EL && !ADK_CHOOSE_TARGET_ARCH
prompt "Target system"

config ADK_CHOOSE_TARGET_SYSTEM_MIPS64EL
        boolean "Choose target system"

source "target/mips64el/Config.in.systems"
endchoice
```

## target/mipsel/Config.in
```kconfig
choice
depends on ADK_LINUX_MIPSEL && !ADK_CHOOSE_TARGET_ARCH
prompt "Target system"

config ADK_CHOOSE_TARGET_SYSTEM_MIPSEL
        boolean "Choose target system"

source "target/mipsel/Config.in.systems"
endchoice
```

## target/ppc/Config.in
```kconfig
choice
depends on ADK_LINUX_PPC || ADK_LINUX_NATIVE && !ADK_CHOOSE_TARGET_ARCH
prompt "Target system"

config ADK_CHOOSE_TARGET_SYSTEM_PPC
        boolean "Choose target system"

source "target/ppc/Config.in.systems"
endchoice
```

## target/ppc64/Config.in
```kconfig
choice
depends on ADK_LINUX_PPC64 || ADK_LINUX_NATIVE && !ADK_CHOOSE_TARGET_ARCH
prompt "Target system"

config ADK_CHOOSE_TARGET_SYSTEM_PPC64
        boolean "Choose target system"

source "target/ppc64/Config.in.systems"
endchoice
```
