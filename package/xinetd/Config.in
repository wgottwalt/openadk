## package/xinetd/Config.in
```kconfig
config ADK_PACKAGE_XINETD
	prompt "xinetd............................ Powerful and secure superserver"
	tristate
	default n
	help
	  A powerful and secure superserver
	  
	  http://www.xinetd.org/
```

## package/xkbcomp/Config.in
```kconfig
config ADK_PACKAGE_XKBCOMP
	prompt "xkbcomp........................... X11 keyboard compiler"
	tristate
	default n
	help
         http://www.x.org
```

## package/xkeyboard-config/Config.in
```kconfig
config ADK_PACKAGE_XKEYBOARD_CONFIG
	prompt "xkeyboard-config............................ X keyboard config"
	tristate
	default n
	help
         http://www.x.org
```

## package/xorg-server/Config.in
```kconfig
config ADK_PACKAGE_XORG_SERVER
	prompt "xorg-server............................... X server"
	tristate
	default n
	select ADK_PACKAGE_XKBCOMP
	select ADK_PACKAGE_XKEYBOARD_CONFIG
	select ADK_PACKAGE_LIBOPENSSL
	select ADK_PACKAGE_LIBXKBFILE
	select ADK_PACKAGE_LIBX11
	select ADK_PACKAGE_LIBICE
	select ADK_PACKAGE_LIBSM
	select ADK_PACKAGE_LIBXEXT
	select ADK_PACKAGE_LIBXFONT
	select ADK_PACKAGE_LIBFONTENC
	select ADK_PACKAGE_LIBPCIACCESS
	select ADK_PACKAGE_LIBXAU
	select ADK_PACKAGE_LIBXAW
	select ADK_PACKAGE_LIBXMU
	select ADK_PACKAGE_LIBXPM
	select ADK_PACKAGE_LIBXT
	select ADK_PACKAGE_PIXMAN
	select ADK_PACKAGE_XF86DGA
	help
         http://www.x.org
```

## package/xtrans/Config.in
```kconfig
config ADK_PACKAGE_XTRANS
	prompt "xtrans.................................. X library"
	tristate
	default n
	help
         http://www.x.org
```

## package/xz/Config.in
```kconfig
config ADK_PACKAGE_XZ
	prompt "xz............................... lzma compression utility"
	tristate
	default n
	help
 	  http://tukaani.org/xz/
```

## package/zlib/Config.in
```kconfig
config ADK_PACKAGE_ZLIB
	prompt "zlib.............................. Library implementing the deflate compression method"
	tristate
	default n
	help
	  A library implementing the 'deflate' compression method
	  
	  http://www.zlib.net/

config ADK_PACKAGE_ZLIB_DEV
	prompt "zlib-dev........................ Zlib development files"
	tristate
	depends on ADK_PACKAGE_ZLIB
	default n
	help
	  A library implementing the 'deflate' compression method
	  http://www.zlib.net/
```

## package/zsh/Config.in
```kconfig
config ADK_PACKAGE_ZSH
	prompt "zsh............................... Z shell"
	tristate
	default n
	help
	 Zsh a shell designed for interactive use, although it is also a 
	 powerful scripting language. Many of the useful features of 
         bash, ksh, and tcsh were incorporated into zsh; many original 
         features were added. 
```
