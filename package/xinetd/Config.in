## target/aarch64/Config.in
```kconfig
choice
depends on ADK_LINUX_AARCH64 && !ADK_CHOOSE_TARGET_ARCH
prompt "Target system"

config ADK_CHOOSE_TARGET_SYSTEM_AARCH64
	boolean "Choose target system"

source "target/aarch64/Config.in.systems"
endchoice
```

## target/arm/Config.in
```kconfig
choice
depends on ADK_LINUX_ARM && !ADK_CHOOSE_TARGET_ARCH
prompt "Target system"

config ADK_CHOOSE_TARGET_SYSTEM_ARM
	boolean "Choose target system"

source "target/arm/Config.in.systems"
endchoice
```

## target/armeb/Config.in
```kconfig
choice
depends on ADK_LINUX_ARMEB && !ADK_CHOOSE_TARGET_ARCH
prompt "Target system"

config ADK_CHOOSE_TARGET_SYSTEM_ARMEB
	boolean "Choose target system"

source "target/armeb/Config.in.systems"
endchoice
```

## target/avr32/Config.in
```kconfig
choice
depends on ADK_LINUX_AVR32 && !ADK_CHOOSE_TARGET_ARCH
prompt "Target system"

config ADK_CHOOSE_TARGET_SYSTEM_AVR32
        boolean "Choose target system"

source "target/avr32/Config.in.systems"
endchoice
```

## target/config/Config.in
```kconfig
# This file is part of the OpenADK project. OpenADK is copyrighted
# material, please see the LICENCE file in the top-level directory.

# global symbols
config ADK_LINUX_64
	bool

config ADK_TARGET_KERNEL_64
	bool

config ADK_TOOLCHAIN_ONLY
	bool

config ADK_TARGET_TOOLCHAIN
	bool

config ADK_TARGET_UCLINUX
	bool
	select ADK_TARGET_WITHOUT_CXX

config ADK_TARGET_SIM
	bool

config ADK_TARGET_QEMU
	bool

config ADK_TARGET_VBOX
	bool

config ADK_TARGET_ARCH_ARM_WITH_THUMB
	bool
	select ADK_KERNEL_ARM_THUMB
	select ADK_KERNEL_THUMB2_KERNEL
	depends on ADK_TARGET_ARCH_ARM

# the inverse of ADK_TARGET_KERNEL_CUSTOMISING,
# allows for selecting it off (i.e., to disable it)
config ADK_TARGET_FIXED_KERNEL
	bool

config ADK_TARGET_KERNEL_CUSTOMISING
	bool
	depends on !ADK_TARGET_FIXED_KERNEL
	default y

source "target/config/Config.in.tools"
```

## target/cris/Config.in
```kconfig
choice
depends on ADK_LINUX_CRIS && !ADK_CHOOSE_TARGET_ARCH
prompt "Target system"

config ADK_CHOOSE_TARGET_SYSTEM_CRIS
	boolean "Choose target system"

source "target/cris/Config.in.systems"
endchoice
```
