## package/rrs/Config.in
```kconfig
config ADK_COMPILE_RRS
	tristate
	default n
	depends on ADK_PACKAGE_RRS || ADK_PACKAGE_RRS_NOSSL

config ADK_PACKAGE_RRS
	prompt "rrs............................... A reverse (connecting) remote shell, with SSL support"
	tristate
	default n
	select ADK_COMPILE_RRS
	select ADK_PACKAGE_ZLIB
	select ADK_PACKAGE_LIBOPENSSL
	help
	  A reverse (connecting) remote shell, built with SSL support.
	  
	  http://www.cycom.se/dl/rrs/

config ADK_PACKAGE_RRS_NOSSL
	prompt "rrs-nossl......................... A reverse (connecting) remote shell, without SSL support"
	tristate
	default n
	select ADK_COMPILE_RRS
	select ADK_PACKAGE_ZLIB
	help
	  A reverse (connecting) remote shell, built without SSL support.
	  
	  http://www.cycom.se/dl/rrs/

choice
prompt "C++ library to use"
depends on ADK_PACKAGE_RRS
default ADK_COMPILE_RRS_WITH_STDCXX if ADK_TARGET_LIB_GLIBC || ADK_TARGET_LIB_EGLIBC
default ADK_COMPILE_RRS_WITH_UCLIBCXX if ADK_TARGET_LIB_UCLIBC

config ADK_COMPILE_RRS_WITH_STDCXX
	bool "Standard C++ library"
	select ADK_PACKAGE_LIBSTDCXX
	help

config ADK_COMPILE_RRS_WITH_UCLIBCXX
	bool "Embedded uClibc++ library"
	select ADK_PACKAGE_UCLIBCXX
	help

endchoice
```

## package/rsync/Config.in
```kconfig
config ADK_PACKAGE_RSYNC
	prompt "rsync............................. file transfer utility"
	tristate
	select ADK_PACKAGE_LIBPOPT
	default n
	help
	  An utility that provides fast incremental file transfer
	  
	  http://rsync.samba.org
```

## package/rtorrent/Config.in
```kconfig
config ADK_PACKAGE_RTORRENT
	prompt "rtorrent........................... console bittorrent client"
	tristate
	select ADK_PACKAGE_LIBNCURSES
	select ADK_PACKAGE_LIBTORRENT
	select ADK_PACKAGE_LIBCURL
	default n
	help
	  http://libtorrent.rakshasa.no/

choice
prompt "C++ library to use"
depends on ADK_PACKAGE_RTORRENT
default ADK_COMPILE_RTORRENT_WITH_STDCXX if ADK_TARGET_LIB_GLIBC || ADK_TARGET_LIB_EGLIBC
default ADK_COMPILE_RTORRENT_WITH_UCLIBCXX if ADK_TARGET_LIB_UCLIBC

config ADK_COMPILE_RTORRENT_WITH_STDCXX
	bool "Standard C++ library"
	select ADK_PACKAGE_LIBSTDCXX
	help

config ADK_COMPILE_RTORRENT_WITH_UCLIBCXX
	bool "Embedded uClibc++ library"
	select ADK_PACKAGE_UCLIBCXX
	depends on ADK_BROKEN
	help

endchoice
```

## package/ruby/Config.in
```kconfig
config ADK_PACKAGE_RUBY
	prompt "ruby.............................. Object-Oriented scripting language"
	tristate
	default n
	help
	  Ruby is the interpreter for the ruby language.
```
