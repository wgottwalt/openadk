## package/portsentry/Config.in
```kconfig
config ADK_PACKAGE_PORTSENTRY
	prompt "portsentry........................ Portscan protection utility"
	tristate
	default n
	help
	  Software for protection against port scans
	  
	  http://sourceforge.net/projects/sentrytools
```

## package/postgresql/Config.in
```kconfig
config ADK_COMPILE_POSTGRESQL
	tristate
	default n
	depends on ADK_PACKAGE_LIBPQ

config ADK_PACKAGE_LIBPQ
	prompt "libpq............................. PostgreSQL client library"
	tristate
	default n
	select ADK_COMPILE_POSTGRESQL
	help
	  PostgreSQL is an object-relational database management system (ORDBMS) 
	  based on POSTGRES, Version 4.2, developed at the University of 
	  California at Berkeley Computer Science Department. POSTGRES pioneered 
	  many concepts that only became available in some commercial database 
	  systems much later.

	  PostgreSQL is an open-source descendant of this original Berkeley code. 
	  It supports SQL92 and SQL99 and offers many modern features:

	    * complex queries
	    * foreign keys
	    * triggers
	    * views
	    * transactional integrity
	    * multiversion concurrency control
	  
	  http://www.postgresql.org/
	  
	  This package contains the shared client library, needed by other programs.
```

## package/ppp/Config.in
```kconfig
config ADK_PACKAGE_PPP
	prompt "ppp............................... PPP (Point-to-Point Protocol) daemon"
	tristate
	default n
	select ADK_KPACKAGE_KMOD_PPP

config ADK_PACKAGE_PPP_MOD_PPPOA
	prompt "ppp-mod-pppoa................... PPPoA (PPP over ATM) plugin"
	tristate
	default n
	select ADK_KPACKAGE_KMOD_PPPOATM
	depends on ADK_PACKAGE_PPP

config ADK_PACKAGE_PPP_MOD_PPPOE
	prompt "ppp-mod-pppoe................... PPPoE (PPP over Ethernet) plugin"
	tristate
	default n
	select ADK_KPACKAGE_KMOD_PPPOE
	depends on ADK_PACKAGE_PPP

config ADK_PACKAGE_PPP_MOD_RADIUS
	prompt "ppp-mod-radius.................. RADIUS (Remote Authentication Dial-In User Service) plugin"
	tristate
	default n
	depends on ADK_PACKAGE_PPP

config ADK_PACKAGE_PPP_MOD_CHAT
	prompt "chat............................ Utility to establish conversation with other PPP servers (via a modem)"
	tristate
	default n
	depends on ADK_PACKAGE_PPP

config ADK_PACKAGE_PPP_MOD_PPPDUMP
	prompt "pppdump......................... Utility to read PPP record file"
	tristate
	default n
	depends on ADK_PACKAGE_PPP

config ADK_PACKAGE_PPP_MOD_PPPSTATS
	prompt "pppstats........................ Utility to report PPP statistics"
	tristate
	default n
	depends on ADK_PACKAGE_PPP

config ADK_PACKAGE_PPP_MOD_PPPUMTS
	prompt "GPRS/UMTS support............... Package with scripts and dependencies to run UMTS/GRPS"
	tristate
	default n
	select ADK_PACKAGE_COMGT
	select ADK_KPACKAGE_KMOD_USB_SERIAL
	depends on ADK_PACKAGE_PPP
```

## package/pptp/Config.in
```kconfig
config ADK_PACKAGE_PPTP
	prompt "pptp.............................. PPTP (Point-to-Point Tunneling Protocol) client"
	tristate
	default n
	select ADK_KPACKAGE_KMOD_NET_IPGRE
	select ADK_PACKAGE_PPP
	help
	  A Point-to-Point Tunneling Protocol Client 
	  
	  http://pptpclient.sourceforge.net/
```

## package/pptpd/Config.in
```kconfig
config ADK_PACKAGE_PPTPD
	prompt "pptpd............................. PPTP (Point-to-Point Tunneling Protocol) server"
	tristate
	default n
	select ADK_KPACKAGE_KMOD_NET_IPGRE
	select ADK_PACKAGE_PPP
	help
	  A Point-to-Point Tunneling Protocol server
	  
	  http://poptop.sourceforge.net/
```

## package/privoxy/Config.in
```kconfig
config ADK_PACKAGE_PRIVOXY
	prompt "privoxy........................... web proxy with advanced filtering capabilities"
	tristate
	select ADK_PACKAGE_LIBPTHREAD
	default n
	help
	  Privoxy is a web proxy with advanced filtering capabilities for
	  protecting privacy, modifying web page content, managing cookies,
	  controlling access, and removing ads, banners, pop-ups and other
	  obnoxious Internet junk. Privoxy has a very flexible configuration
	  and can be customized to suit individual needs and tastes. Privoxy
	  has application for both stand-alone systems and multi-user networks.
	  
	  http://www.privoxy.org/
```

## package/procps/Config.in
```kconfig
config ADK_PACKAGE_PROCPS_META
	bool
	default n

config ADK_PACKAGE_PROCPS
	prompt "procps............................ The /proc file system utilities"
	tristate
	default n
	select ADK_PACKAGE_PROCPS_META
	select ADK_PACKAGE_LIBNCURSES
	help
	  procps is the package that has a bunch of small useful utilities 
	  that give information about processes using the /proc filesystem. 
	  The package includes the programs ps, top, vmstat, w, kill, free, 
	  slabtop, and skill.
	  
	  http://procps.sourceforge.net/
```

## package/python/Config.in
```kconfig
config ADK_PACKAGE_PYTHON
	prompt "python............................ Python scripting language"
	tristate
	default n
	help
	  http://www.python.org
```

## package/quagga/Config.in
```kconfig
#menu "quagga............................ The Quagga Software Routing Suite"

config ADK_PACKAGE_QUAGGA
	prompt "quagga............................ The Quagga Software Routing Suite"
	tristate
	depends on ADK_IPV6
	default n
	help
	  A routing software package that provides TCP/IP based routing services
	  with routing protocols support such as RIPv1, RIPv2, RIPng, OSPFv2, 
	  OSPFv3, BGP-4, and BGP-4+
	  
	  http://www.quagga.net/

config ADK_PACKAGE_QUAGGA_BGPD
	prompt   "quagga-bgpd................... BGPv4, BGPv4+, BGPv4- routing engine"
	tristate
	default n
	depends on ADK_PACKAGE_QUAGGA
	help
	  A BGPv4, BGPv4+, BGPv4- routing engine for use with Quagga routing
	  software.

config ADK_PACKAGE_QUAGGA_OSPFD
	prompt   "quagga-ospfd.................. OSPFv2 routing engine"
	tristate
	default n
	depends on ADK_PACKAGE_QUAGGA
	help
	  An OSPFv2 (IPv4) routing engine for use with Quagga routing software.

config ADK_PACKAGE_QUAGGA_OSPF6D
	prompt   "quagga-ospf6d................. OSPFv3 routing engine"
	tristate
	default n
	depends on ADK_PACKAGE_QUAGGA
	depends on ADK_IPV6
	help
	  An OSPFv3 (IPv6) routing engine for use with Quagga routing software.

config ADK_PACKAGE_QUAGGA_RIPD
	prompt   "quagga-ripd................... RIP routing engine"
	tristate
	default n
	depends on ADK_PACKAGE_QUAGGA
	help
	  A RIP (IPv4) routing engine for use with Quagga routing software.

config ADK_PACKAGE_QUAGGA_RIPNGD
	prompt   "quagga-ripngd................. RIPNG routing engine"
	tristate
	default n
	depends on ADK_PACKAGE_QUAGGA
	depends on ADK_IPV6
	help
	  A RIPNG (IPv6) routing engine for use with Quagga routing software.

config ADK_PACKAGE_QUAGGA_VTYSH
	prompt   "quagga-vtysh.................. integrated shell for Quagga routing software"
	tristate
	default n
	depends on ADK_PACKAGE_QUAGGA
	select ADK_PACKAGE_LIBREADLINE
	select ADK_PACKAGE_LIBNCURSES
	help
	  vtysh lets you interact with all the Quagga routing daemons
	  at once in an integrated shell.

#endmenu
```

## package/raddump/Config.in
```kconfig
config ADK_PACKAGE_RADDUMP
        prompt "raddump........................... raddump interprets captured RADIUS packets."
	tristate
	default n
	select ADK_PACKAGE_LIBOPENSSL
	select ADK_PACKAGE_LIBPCAP
	help
		raddump interprets captured RADIUS packets to print a
		timestamp, packet length, RADIUS packet type, source and
		destination hosts and ports, and included attribute names and
		values for each packet.
```

## package/radiusclient-ng/Config.in
```kconfig
config ADK_COMPILE_RADIUSCLIENT_NG
	tristate
	default n
	depends ADK_PACKAGE_LIBRADIUSCLIENT_NG

config ADK_PACKAGE_RADIUSCLIENT_NG
	prompt "radiusclient-ng................... RADIUS client"
	tristate
	default n
	select ADK_PACKAGE_LIBOPENSSL
	select ADK_PACKAGE_LIBRADIUSCLIENT_NG
	help
	  Purpose of this project is to build portable, easy-to-use and standard compliant 
	  library suitable for developing free and commercial software that need support 
	  for a RADIUS protocol (RFCs 2128 and 2139).

	  http://developer.berlios.de/projects/radiusclient-ng/

	  Depends: libopenssl

config ADK_PACKAGE_LIBRADIUSCLIENT_NG
	prompt "libradiusclient-ng................ RADIUS client library"
	tristate
	default n
	select ADK_COMPILE_RADIUSCLIENT_NG
	help
	  Developpment library from radiusclient-ng
```

## package/radvd/Config.in
```kconfig
config ADK_PACKAGE_RADVD
	prompt "radvd............................. IPv6 Routing Advertisement Daemon"
	tristate
	default n
	select ADK_KPACKAGE_KMOD_IPV6
	depends on !ADK_HOST_FREEBSD # flex problem
	help
	  Routing Advertisement Daemon for IPv6
	  http://v6web.litech.org/radvd/
```

## package/randrproto/Config.in
```kconfig
config ADK_PACKAGE_RANDRPROTO
	prompt "randrproto.............................. X protocol library"
	tristate
	default n
	help
         http://www.x.org
```

## package/rdate/Config.in
```kconfig
config ADK_PACKAGE_RDATE
	prompt "rdate............................. very small rdate and ntp client"
	tristate
	default n
	help
	  A very small but secure rdate and ntp time synchronisation
	  client from MirBSD.
```

## package/readline/Config.in
```kconfig
config ADK_COMPILE_READLINE
	tristate
	default n
	depends on ADK_PACKAGE_LIBREADLINE

config ADK_PACKAGE_LIBREADLINE
	prompt "libreadline....................... Command lines edition library"
	tristate
	default n
	select ADK_COMPILE_READLINE
	select ADK_PACKAGE_LIBNCURSES
	help
	  The Readline library provides a set of functions for use by applications 
	  that allow users to edit command lines as they are typed in. Both Emacs 
	  and vi editing modes are available. The Readline library includes 
	  additional functions to maintain a list of previously-entered command 
	  lines, to recall and perhaps reedit those lines, and perform csh-like 
	  history expansion on previous commands.
	  
	  http://cnswww.cns.cwru.edu/php/chet/readline/rltop.html
```

## package/reaim/Config.in
```kconfig
config ADK_PACKAGE_REAIM
	prompt "reaim............................. A transparent AIM / MSN proxy"
	tristate
	default n
	help
	  ReAIM is a proxy for file transfers with MSN/AIM.
	  
	  http://reaim.sourceforge.net/
```

## package/renderproto/Config.in
```kconfig
config ADK_PACKAGE_RENDERPROTO
	prompt "renderproto............................. X protocol library"
	tristate
	default n
	help
         http://www.x.org
```

## package/resourceproto/Config.in
```kconfig
config ADK_PACKAGE_RESOURCEPROTO
	prompt "resourceproto............................. X protocol library"
	tristate
	default n
	help
         http://www.x.org
```

## package/rp-pppoe/Config.in
```kconfig
#menu "rp-pppoe.......................... Roaring Penguin PPPoE (PPP over Ethernet) implementation"

config ADK_COMPILE_RP_PPPOE
	tristate
	default n
	depends on ADK_PACKAGE_PPPOE_CLIENT || ADK_PACKAGE_PPPOE_RELAY || ADK_PACKAGE_PPPOE_SERVER || ADK_PACKAGE_PPPOE_SNIFF

config ADK_PACKAGE_PPPOE_CLIENT
	prompt "pppoe-client...................... PPPoE (PPP over Ethernet) client"
	tristate
	default n
	select ADK_COMPILE_RP_PPPOE
	select ADK_PACKAGE_PPP
	help
	  PPPoE (PPP over Ethernet) client
	  
	  http://roaringpenguin.com/penguin/open_source_rp-pppoe.php

config ADK_PACKAGE_PPPOE_RELAY
	prompt "pppoe-relay....................... PPPoE (PPP over Ethernet) relay"
	tristate
	default n
	select ADK_COMPILE_RP_PPPOE
	help
	  PPPoE (PPP over Ethernet) relay
	  
	  http://roaringpenguin.com/penguin/open_source_rp-pppoe.php

config ADK_PACKAGE_PPPOE_SERVER
	prompt "pppoe-server...................... PPPoE (PPP over Ethernet) server"
	tristate
	default n
	select ADK_COMPILE_RP_PPPOE
	select ADK_PACKAGE_PPP
	help
	  PPPoE (PPP over Ethernet) server
	  
	  http://roaringpenguin.com/penguin/open_source_rp-pppoe.php

config ADK_PACKAGE_PPPOE_SNIFF
	prompt "pppoe-sniff....................... PPPoE (PPP over Ethernet) frame sniffer"
	tristate
	default n
	select ADK_COMPILE_RP_PPPOE
	help
	  PPPoE (PPP over Ethernet) frame sniffer
	  
	  http://roaringpenguin.com/penguin/open_source_rp-pppoe.php

#endmenu
```

## package/rpm/Config.in
```kconfig
config ADK_PACKAGE_RPM
	prompt "rpm.................................. Red Hat package manager"
	tristate
	select ADK_PACKAGE_NSS
	select ADK_PACKAGE_NSPR
	select ADK_PACKAGE_ZLIB
	select ADK_PACKAGE_LIBDB
	default n
	help
	  Red Hat package manager
```

## package/rrdtool/Config.in
```kconfig
config ADK_COMPILE_RRDTOOL
	bool
	default n

config ADK_PACKAGE_LIBRRD
	prompt   "librrd............................ Round Robin Database (RRD) management library (v1.2.x)"
	tristate
	default n
	select ADK_COMPILE_RRDTOOL
	select ADK_PACKAGE_LIBART
	select ADK_PACKAGE_LIBFREETYPE
	select ADK_PACKAGE_LIBPNG
	select ADK_PACKAGE_LIBXML2
	select ADK_PACKAGE_ZLIB
	help
	  RRD is the Acronym for Round Robin Database. RRD is a system to store and
	  display time-series data (i.e. network bandwidth, machine-room temperature,
	  server load average). It stores the data in a very compact way that will
	  not expand over time, and it presents useful graphs by processing the data
	  to enforce a certain data density. It can be used either via simple wrapper
	  scripts (from shell or Perl) or via frontends that poll network devices and
	  put friendly user interface on it.
	  
	  http://people.ee.ethz.ch/~oetiker/webtools/rrdtool/
	  
	  This package contains command line tools used to manage RRDs.

config ADK_PACKAGE_RRDCGI
	prompt   "rrdcgi............................ Round Robin Database (RRD) CGI graphing tool (v1.2.x)"
	tristate
	default n
	select ADK_COMPILE_RRDTOOL
	select ADK_PACKAGE_LIBRRD
	select ADK_PACKAGE_CGILIB
	help
	  RRD is the Acronym for Round Robin Database. RRD is a system to store and
	  display time-series data (i.e. network bandwidth, machine-room temperature,
	  server load average). It stores the data in a very compact way that will
	  not expand over time, and it presents useful graphs by processing the data
	  to enforce a certain data density. It can be used either via simple wrapper
	  scripts (from shell or Perl) or via frontends that poll network devices and
	  put friendly user interface on it.
	  
	  http://people.ee.ethz.ch/~oetiker/webtools/rrdtool/
	  
	  This package contains the rrdcgi tool used to create web pages containing
	  RRD graphs based on templates.

config ADK_PACKAGE_RRDTOOL
	prompt   "rrdtool........................... Round Robin Database (RRD) management tools (v1.2.x)"
	tristate
	default n
	select ADK_COMPILE_RRDTOOL
	select ADK_PACKAGE_LIBRRD
	help
	  RRD is the Acronym for Round Robin Database. RRD is a system to store and
	  display time-series data (i.e. network bandwidth, machine-room temperature,
	  server load average). It stores the data in a very compact way that will
	  not expand over time, and it presents useful graphs by processing the data
	  to enforce a certain data density. It can be used either via simple wrapper
	  scripts (from shell or Perl) or via frontends that poll network devices and
	  put friendly user interface on it.
	  
	  http://people.ee.ethz.ch/~oetiker/webtools/rrdtool/
	  
	  This package contains command line tools used to manage RRDs.
```
