## package/mpd/Config.in
```kconfig
menu "mpd............................... Music Player Daemon"

config ADK_PACKAGE_MPD
	prompt "mpd............................... Music Player Daemon"
	tristate
	default n
	select ADK_PACKAGE_GLIB
	help
	  MPD is a music player supporting flac, mp3 and ogg files.
	  It is typically controlled over a network using one of it's many
	  clients including mpc(console), gmpc(gnome), phpmp(php) etc.
	  http://www.musicpd.org/

config ADK_COMPILE_MPD_WITH_ALSA
	prompt   "ALSA playback support"
	bool
	default y
	depends on ADK_PACKAGE_MPD
	select ADK_PACKAGE_ALSA_LIB
	help
	  Enable ALSA playback support.

config ADK_COMPILE_MPD_WITH_SHOUT
	prompt   "Shoutcast playback support"
	bool
	default y
	depends on ADK_PACKAGE_MPD
	select ADK_PACKAGE_LIBSHOUT
	select ADK_PACKAGE_LIBVORBISENC
	select ADK_PACKAGE_LIBLAME
	help
	  Enable shout support (libshout).

config ADK_COMPILE_MPD_WITH_MP3
	prompt   "MP3 support"
	bool
	default y
	depends on ADK_PACKAGE_MPD
	select ADK_PACKAGE_LIBMAD
	select ADK_PACKAGE_LIBID3TAG
	help
	  Enable mp3 support (libmad).

config ADK_COMPILE_MPD_WITH_MP4
	prompt   "MP4/AAC support"
	bool
	default y
	depends on ADK_PACKAGE_MPD
	select ADK_PACKAGE_LIBFAAD2
	help
	  Enable mp4/aac support (libfaad2).

config ADK_COMPILE_MPD_OGG
	prompt   "Ogg/Vorbis Support"
	bool
	depends on ADK_PACKAGE_MPD
	select ADK_COMPILE_MPD_WITH_OGG if ADK_COMPILE_MPD_OGG_FLOAT
	select ADK_COMPILE_MPD_WITH_TREMOR if ADK_COMPILE_MPD_OGG_FIXED
	default y
	help
		Ogg/Vorbis support.

choice
prompt "Ogg type"
depends on ADK_COMPILE_MPD_OGG
config ADK_COMPILE_MPD_OGG_FLOAT
	bool "Ogg/Vorbis (floating point implementation)"
config ADK_COMPILE_MPD_OGG_FIXED
	bool "Ogg/Vorbis (fixed point implementation)"
endchoice

config ADK_COMPILE_MPD_WITH_OGG
	bool
	default n
	depends on ADK_PACKAGE_MPD
	depends on ADK_COMPILE_MPD_OGG_FLOAT
	select ADK_PACKAGE_LIBOGG
	select ADK_PACKAGE_LIBVORBIS
	help
	  Enable ogg vorbis support.

config ADK_COMPILE_MPD_WITH_TREMOR
	bool
	default n
	depends on ADK_PACKAGE_MPD
	depends on ADK_COMPILE_MPD_OGG_FIXED
	select ADK_PACKAGE_LIBVORBISIDEC
	help
	  Enable ogg support (tremor).
          Can not be used with shout plugin.

config ADK_COMPILE_MPD_WITH_FLAC
	prompt   "FLAC Support"
	bool
	default y
	depends on ADK_PACKAGE_MPD
	select ADK_PACKAGE_LIBFLAC
	help
	  Enable flac support (libflac).

config ADK_COMPILE_MPD_WITH_WAV
	prompt   "WAVE/AU Support"
	bool
	default y
	depends on ADK_PACKAGE_MPD
	select ADK_PACKAGE_LIBAUDIOFILE
	help
	  Enable wave support (libaudiofile).

config ADK_COMPILE_MPD_WITH_CURL
	prompt   "HTTP streaming support"
	bool
	default y
	depends on ADK_PACKAGE_MPD
	select ADK_PACKAGE_LIBCURL
	help
	  Enable http streaming support (libcurl).

config ADK_COMPILE_MPD_WITH_MMS
	prompt   "MMS streaming support"
	bool
	default n
	depends on ADK_PACKAGE_MPD
	select ADK_PACKAGE_LIBMMS
	help
	  Enable mms streaming support (libmms).

config ADK_COMPILE_MPD_WITH_FFMPEG
	prompt   "FFMPEG support"
	bool
	default n
	depends on ADK_PACKAGE_MPD
	select ADK_PACKAGE_FFMPEG
	help
	  Enable FFMPEG support (ffmpeg).


endmenu
```

## package/mpfr/Config.in
```kconfig
config ADK_PACKAGE_MPFR
	prompt "mpfr......................... multiprecision floatingpoint library"
	tristate
	default n
	help
	  http://www.mpfr.org
```

## package/mplayer/Config.in
```kconfig
config ADK_PACKAGE_MPLAYER
	prompt "mplayer........................... popular movie player"
	tristate
	default n
	select ADK_PACKAGE_ALSA_LIB
	select ADK_PACKAGE_LIBJPEG
	select ADK_PACKAGE_LIBPNG
	select ADK_PACKAGE_LIBPTHREAD
	select ADK_PACKAGE_LIBOGG
	select ADK_PACKAGE_LIBMAD
	select ADK_PACKAGE_LIBNCURSES
	select ADK_PACKAGE_LIBFAAD2
	select ADK_PACKAGE_LIBVORBIS
	select ADK_PACKAGE_ZLIB
	depends on ADK_LINUX_X86_ALIX1C || \
		ADK_LINUX_X86_QEMU
	help
          http://www.mplayerhq.hu
```

## package/mrd6/Config.in
```kconfig
config ADK_PACKAGE_MRD6
	prompt "mrd6.............................. IPv6 multicast routing daemon"
	depends on ADK_IPV6
	tristate
	default n
	help
		Multicast is becoming a major component in next generation 
		networks, used in several scenarios, from video broadcasting 
		to multimedia conferencing. In order to be implemented, new 
		technology needs supporting hardware and software across a set 
		of devices and systems. MRD6 is an implementation of a modular 
		IPv6 Multicast Routing Framework for the Linux operating system 
		and provides MLDv2 (as well as MLDv1), PIM-SM and MBGP support.

		http://artemis.av.it.pt/mrd6/

choice
prompt "C++ library to use"
depends on ADK_PACKAGE_MRD6
default ADK_COMPILE_MRD6_WITH_STDCXX if ADK_TARGET_LIB_GLIBC
default ADK_COMPILE_MRD6_WITH_UCLIBCXX if ADK_TARGET_LIB_UCLIBC

config ADK_COMPILE_MRD6_WITH_STDCXX
	bool "Standard C++ library"
	select ADK_PACKAGE_LIBSTDCXX
	help

config ADK_COMPILE_MRD6_WITH_UCLIBCXX
	bool "Embedded uClibc++ library"
	select ADK_PACKAGE_UCLIBCXX
	help

endchoice
```

## package/mtd/Config.in
```kconfig
config ADK_PACKAGE_MTD
	prompt "mtd................................ mtd utility"
	tristate
	depends on \
		ADK_LINUX_CRIS_FOXBOARD || \
		ADK_LINUX_MIPS_AG241
	default n
	help
	  MTD utility.
```

## package/mutt/Config.in
```kconfig
config ADK_PACKAGE_MUTT
	prompt "mutt.............................. console mail client"
	tristate
	default n
	select ADK_PACKAGE_LIBNCURSES
	select ADK_PACKAGE_LIBOPENSSL
	help
	  Mail client for the text console
	  
	  http://www.mutt.org
```

## package/mysql/Config.in
```kconfig
config ADK_COMPILE_MYSQL
	tristate
	default n
	depends on ADK_PACKAGE_LIBMYSQLCLIENT
	select ADK_PACKAGE_LIBNCURSES
	select ADK_PACKAGE_ZLIB
	select ADK_PACKAGE_LIBREADLINE

config ADK_PACKAGE_LIBMYSQLCLIENT
	prompt "libmysqlclient.................... MySQL client library"
	tristate
	default n
	select ADK_COMPILE_MYSQL
	help
	  MySQL client library.
	  http://dev.mysql.com/
```

## package/nano/Config.in
```kconfig
config ADK_PACKAGE_NANO
	prompt "nano.............................. An enhanced clone of the Pico text editor"
	tristate
	default n
	select ADK_PACKAGE_LIBNCURSES
	help
	  GNU nano (Nano's ANOther editor, or Not ANOther editor) is an enhanced clone of the Pico text editor.
	  
	  http://www.nano-editor.org/

config ADK_PACKAGE_NANO_TINY
	prompt "only compile a minimal nano (using --enable-tiny)"
	bool
	default y
	depends on ADK_PACKAGE_NANO
	help
	  If not selected, nano will support justify, line wrapping, tab completion and multiple open file buffers.
```

## package/ncurses/Config.in
```kconfig
config ADK_COMPILE_NCURSES
	tristate
	depends on ADK_PACKAGE_LIBNCURSES

config ADK_PACKAGE_LIBNCURSES
	prompt "libncurses........................ Terminal handling library"
	tristate
	default n
	select ADK_COMPILE_NCURSES
	help
	  A terminal handling library
	  
	  Comes with: libcurses libform libmenu libncurses libpanel
	  
	  http://www.gnu.org/software/ncurses/
```

## package/ndisc/Config.in
```kconfig
#menu "ndisc6............................ IPv6 discovery tools"

config ADK_COMPILE_NDISC6
	tristate
	default n
	depends ADK_IPV6
	depends ADK_PACKAGE_NDISC6 || ADK_PACKAGE_RDISC6 || ADK_PACKAGE_TCPTRACEROUTE6

config ADK_PACKAGE_NDISC6
	prompt "ndisc6............................ An ICMPv6 neighbour discovery tool"
	tristate
	default n
	depends ADK_IPV6
	select ADK_COMPILE_NDISC6
	help
	  
	  An ICMPv6 neighbour discovery tools
	  
	  http://people.via.ecp.fr/~rem/ndisc6/

config ADK_PACKAGE_RDISC6
	prompt "rdisc6............................ An ICMPv6 router discovery tool"
	tristate
	default n
	depends ADK_IPV6
	select ADK_COMPILE_NDISC6
	help
	  
	  An ICMPv6 router discovery tool
	  
	  http://people.via.ecp.fr/~rem/ndisc6/

config ADK_PACKAGE_TCPTRACEROUTE6
	prompt "tcptraceroute6.................... A TCP/IPv6-based traceroute implementation"
	tristate
	default n
	depends ADK_IPV6
	select ADK_COMPILE_NDISC6
	help
	  
	  A TCP/IPv6-based traceroute implementation
	  
	  http://people.via.ecp.fr/~rem/ndisc6/

#endmenu
```

## package/net-snmp/Config.in
```kconfig
config ADK_COMPILE_NET_SNMP
	bool
	default n

config ADK_PACKAGE_LIBNETSNMP
	prompt "net-snmp-libs..................... SNMP shared libraries"
	tristate
	default n
	select ADK_COMPILE_NET_SNMP
	select ADK_PACKAGE_LIBELF
	help
	  Simple Network Management Protocol (SNMP) is a widely used
	  protocol for monitoring the health and welfare of network
	  equipment (eg. routers), computer equipment and even devices
	  like UPSs. Net-SNMP is a suite of applications used to implement
	  SNMP v1, SNMP v2c and SNMP v3 using both IPv4 and IPv6.
	  
	  http://www.net-snmp.org/
	  
	  This package contains shared libraries, needed by other programs.

config ADK_PACKAGE_SNMP_UTILS
	prompt "net-snmp-utils.................... SNMP client utilities"
	tristate
	default n
	select ADK_PACKAGE_LIBNETSNMP
	help
	  Simple Network Management Protocol (SNMP) is a widely used
	  protocol for monitoring the health and welfare of network
	  equipment (eg. routers), computer equipment and even devices
	  like UPSs. Net-SNMP is a suite of applications used to implement
	  SNMP v1, SNMP v2c and SNMP v3 using both IPv4 and IPv6.
	  
	  http://www.net-snmp.org/
	  
	  This package contains the SNMP client utilities.

config ADK_PACKAGE_SNMPD
	prompt "net-snmp-daemon................... SNMP agent"
	tristate
	default n
	select ADK_PACKAGE_LIBNETSNMP
	help
	  Simple Network Management Protocol (SNMP) is a widely used
	  protocol for monitoring the health and welfare of network
	  equipment (eg. routers), computer equipment and even devices
	  like UPSs. Net-SNMP is a suite of applications used to implement
	  SNMP v1, SNMP v2c and SNMP v3 using both IPv4 and IPv6.
	  
	  http://www.net-snmp.org/
	  
	  This package contains the SNMP agent, dynamically linked.
```

## package/netperf/Config.in
```kconfig
config ADK_PACKAGE_NETPERF
	prompt "netperf........................... network performance measurement tool"
	tristate
	default n
	help
	  Program and service to do network performance measurement.
```

## package/nfs-utils/Config.in
```kconfig
config ADK_PACKAGE_NFS_UTILS
	prompt "nfs-utils......................... NFS server utilities"
	tristate
	default n
	select ADK_PACKAGE_PORTMAP
	select ADK_KPACKAGE_KMOD_NFSD
	select ADK_KPACKAGE_KMOD_NFS_FS
	select ADK_PACKAGE_LIBTIRPC if ADK_IPV6
	depends on !ADK_TARGET_ROOTFS_NFSROOT
	help
	  NFS server utilities (namely, exportfs), and an NFS server.

config ADK_COMPILE_NFS_UTILS_WITH_KERBEROS
	prompt "Enable Kerberos and NFSv4"
	bool
	select ADK_PACKAGE_LIBEVENT
	select ADK_PACKAGE_LIBNFSIDMAP
	select ADK_PACKAGE_LIBRPCSECGSS
	select ADK_PACKAGE_LIBCOM_ERR
	select ADK_KERNEL_NFSD_V4
	default n
	depends on ADK_PACKAGE_NFS_UTILS

choice
prompt "Kerberos implementation"
depends on ADK_COMPILE_NFS_UTILS_WITH_KERBEROS
config ADK_COMPILE_NFS_UTILS_WITH_KRB5
	prompt "MIT"
	bool
	select ADK_COMPILE_KRB5
	select ADK_PACKAGE_KRB5_LIBS
	select ADK_PACKAGE_LIBGSSGLUE
	help
	  use MIT kerberos libraries

config ADK_COMPILE_NFS_UTILS_WITH_HEIMDAL
	prompt "Heimdal"
	bool
	select ADK_PACKAGE_HEIMDAL_LIBS
	help 
	  Use heimdal kerberos libraries (experimental)

endchoice
```

## package/nmap/Config.in
```kconfig
config ADK_PACKAGE_NMAP
	prompt "nmap.............................. Network exploration and/or security auditing utility"
	tristate
	default n
	depends on ADK_CXX
	select ADK_PACKAGE_LIBDNET
	select ADK_PACKAGE_LIBPCAP
	select ADK_PACKAGE_LIBPCRE
	help
	  A free open source utility for network exploration or security auditing. 
	  
	  http://www.insecure.org/nmap/

choice
prompt "C++ library to use"
depends on ADK_PACKAGE_NMAP
default ADK_COMPILE_NMAP_WITH_STDCXX if ADK_TARGET_LIB_GLIBC
default ADK_COMPILE_NMAP_WITH_UCLIBCXX if ADK_TARGET_LIB_UCLIBC

config ADK_COMPILE_NMAP_WITH_STDCXX
	bool "Standard C++ library"
	select ADK_PACKAGE_LIBSTDCXX
	help

config ADK_COMPILE_NMAP_WITH_UCLIBCXX
	bool "Embedded uClibc++ library"
	select ADK_PACKAGE_UCLIBCXX
	help

endchoice
```

## package/nspr/Config.in
```kconfig
config ADK_PACKAGE_NSPR
	prompt "nspr.............................. Netscape Portable Runtime library"
	tristate
	default n
	help
	http://www.mozilla.org/projects/nspr/
```

## package/nss/Config.in
```kconfig
config ADK_PACKAGE_NSS
	prompt "nss............................... NSS library"
	tristate
	default n
	help
```

## package/ntfs-3g/Config.in
```kconfig
config ADK_PACKAGE_NTFS_3G
	prompt "ntfs-3g................... NTFS filesystem driver with read-write support"
	tristate
	select ADK_KPACKAGE_KMOD_FUSE_FS
	default n
	help
	  http://www.ntfs-3g.org
```

## package/ntpclient/Config.in
```kconfig
config ADK_PACKAGE_NTPCLIENT
	prompt "ntpclient......................... NTP (Network Time Protocol) client"
	tristate
	default n
	help
	  NTP client for setting system time from NTP servers.
	  It is recommended to use the rdate package instead.
	  
	  http://doolittle.faludi.com/ntpclient/
```
