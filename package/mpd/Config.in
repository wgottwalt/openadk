## package/nut/Config.in
```kconfig
config ADK_PACKAGE_NUT
	prompt "nut............................... Network UPS Tools"
	tristate
	default n
	help
	  Network UPS Tools is a collection of programs which provide a common
	  interface for monitoring and administering UPS hardware.  It uses a
	  layered approach to connect all of the parts.

	  http://www.networkupstools.org

config ADK_PACKAGE_NUT_SSL
	prompt "nut-ssl........................... Build Nut with SSL support"
	boolean
	default n
	depends on ADK_PACKAGE_NUT
	select ADK_PACKAGE_LIBOPENSSL

config ADK_PACKAGE_NUT_USB
	prompt "nut-usb........................... Build Nut with USB drivers"
	boolean
	default n
	depends on ADK_PACKAGE_NUT
	select ADK_PACKAGE_LIBUSB
	help
	  This option enables two drivers, namely hidups and energizerups.

config ADK_PACKAGE_NUT_SNMP
	prompt "nut-snmp.......................... Build Nut with SNMP UPS driver"
	boolean
	default n
	depends on ADK_PACKAGE_NUT
	select ADK_PACKAGE_LIBNETSNMP
	help
	  This option enables the snmp-ups driver.

config ADK_PACKAGE_NUT_VARDESC
	prompt "command descriptions.............. Include variable and command descriptions"
	boolean
	default y
	depends on ADK_PACKAGE_NUT
	help
	  With this option enabled, an optional file will be added to the package
	  containing a description of the commands and variables to clients.
	  If you leave this out, clients will receive "Unavailable" for any description
	  requests.

menu "UPS Drivers to include"
depends on ADK_PACKAGE_NUT

config ADK_PACKAGE_NUT_DRIVER_APCSMART
	prompt "apcsmart.......................... Driver for APC smart protocol (newapc)"
	boolean
	default n
	
config ADK_PACKAGE_NUT_DRIVER_BELKIN
	prompt "belkin............................ Driver for Belkin Smart-UPS"
	boolean
	default n
	
config ADK_PACKAGE_NUT_DRIVER_BELKINUNV
	prompt "belkinunv......................... Driver for Belkin Universal UPS"
	boolean
	default n
	
config ADK_PACKAGE_NUT_DRIVER_BESTUPS
	prompt "bestups........................... Driver for Best-UPS"
	boolean
	default n
	
config ADK_PACKAGE_NUT_DRIVER_BESTFCOM
	prompt "bestfcom.......................... Driver for Best Power F-Command UPS"
	boolean
	default n
	
config ADK_PACKAGE_NUT_DRIVER_BESTUFERRUPS
	prompt "bestuferrups...................... Driver for Best Power Micro-Ferrups"
	boolean
	default n
	
config ADK_PACKAGE_NUT_DRIVER_BLAZER
	prompt "blazer............................ Driver for Blazer UPS models"
	boolean
	default n
	
config ADK_PACKAGE_NUT_DRIVER_CPSUPS
	prompt "cpsups............................ Driver for CyberPower text protocol UPS"
	boolean
	default n
	
config ADK_PACKAGE_NUT_DRIVER_CYBERPOWER
	prompt "cyberpower........................ Driver for Cyber Power Systems"
	boolean
	default n
	
config ADK_PACKAGE_NUT_DRIVER_ESUPSSMART
	prompt "esupssmart........................ Driver for ES UPS"
	boolean
	default n
	
config ADK_PACKAGE_NUT_DRIVER_ETAPRO
	prompt "etapro............................ Driver for ETA UPS"
	boolean
	default n
	
config ADK_PACKAGE_NUT_DRIVER_EVERUPS
	prompt "everups........................... Driver for Ever UPS models"
	boolean
	default n
	
config ADK_PACKAGE_NUT_DRIVER_FENTONUPS
	prompt "fentonups......................... Driver for Fenton Technologies units"
	boolean
	default n
	
config ADK_PACKAGE_NUT_DRIVER_GAMATRONIC
	prompt "gamatronic........................ Driver for Gamatronic UPS"
	boolean
	default n
	
config ADK_PACKAGE_NUT_DRIVER_GENERICUPS
	prompt "genericups........................ Driver for generic contact-closure UPS models"
	boolean
	default n
	
config ADK_PACKAGE_NUT_DRIVER_IPPON
	prompt "ippon............................. Driver for Ippon UPS devices"
	boolean
	default n
	
config ADK_PACKAGE_NUT_DRIVER_ISBMEX
	prompt "isbmex............................ Driver for SOLA/BASIC Mexico models"
	boolean
	default n
	
config ADK_PACKAGE_NUT_DRIVER_LIEBERT
	prompt "liebert........................... Driver for Liebert UPS via MultiLink cable"
	boolean
	default n
	
config ADK_PACKAGE_NUT_DRIVER_MASTERGUARD
	prompt "masterguard....................... Driver for Masterguard units"
	boolean
	default n
	
config ADK_PACKAGE_NUT_DRIVER_MEGATEC
	prompt "megatec........................... Driver for Megatec protocol based UPS"
	boolean
	default n
	
config ADK_PACKAGE_NUT_DRIVER_METASYS
	prompt "metasys........................... Driver for Meta System UPS"
	boolean
	default n
	
config ADK_PACKAGE_NUT_DRIVER_MGE_UTALK
	prompt "mge-utalk......................... Driver for MGE UPS"
	boolean
	default n
	
config ADK_PACKAGE_NUT_DRIVER_MUSTEK
	prompt "mustek............................ Driver for Mustek UPS models"
	boolean
	default n
	
config ADK_PACKAGE_NUT_DRIVER_ONEAC
	prompt "oneac............................. Driver for UPS using the Oneac Advanced Interface"
	boolean
	default n
	
config ADK_PACKAGE_NUT_DRIVER_POWERCOM
	prompt "powercom.......................... Driver for Powercom units (see help)"
	boolean
	default n
	help
	  This driver supports the following units:
	  *  -Trust 425/625
	  *  -Powercom
	  *  -Advice Partner/King PR750
	  *    See http://www.advice.co.il/product/inter/ups.html for its specifications.
	  *    This model is based on PowerCom (www.powercom.com) models.
	  *  -Socomec Sicon Egys 420
	
config ADK_PACKAGE_NUT_DRIVER_POWERMUST
	prompt "powermust......................... Driver for Powermust"
	boolean
	default n
	
config ADK_PACKAGE_NUT_DRIVER_RHINO
	prompt "rhino............................. Driver for Microsol Rhino UPS"
	boolean
	default n
	
config ADK_PACKAGE_NUT_DRIVER_SAFENET
	prompt "safenet........................... Driver for SafeNet UPS (see help)"
	boolean
	default n
	help
	  Supports the following units:
	  * - Fairstone L525/-625/-750
	  * - Fenton P400/-600/-800
	  * - Gemini  UPS625/-1000
	  * - Powerwell PM525A/-625A/-800A/-1000A/-1250A
	  * - Repotec RPF525/-625/-800/-1000
	  * - Soltec Winmate 525/625/800/1000
	  * - Sweex 500/1000
	  * - others using SafeNet software and serial interface

config ADK_PACKAGE_NUT_DRIVER_SMS
	prompt "sms............................... Driver for SMS UPS hardware"
	boolean
	default n
	
config ADK_PACKAGE_NUT_DRIVER_SOLIS
	prompt "solis............................. Driver for Microsol Solis UPS"
	boolean
	default n
	
config ADK_PACKAGE_NUT_DRIVER_TRIPPLITE
	prompt "tripplite......................... Driver for Tripp Lite SmartUPS models"
	boolean
	default n
	
config ADK_PACKAGE_NUT_DRIVER_TRIPPLITESU
	prompt "tripplitesu....................... Driver for Tripp Lite SmartOnline (SU*) models"
	boolean
	default n
	
config ADK_PACKAGE_NUT_DRIVER_UPSCODE2
	prompt "upscode2.......................... Driver for UPS using UPScode II command set"
	boolean
	default n
	
config ADK_PACKAGE_NUT_DRIVER_VICTRONUPS
	prompt "victronups........................ Driver for GE/IMV/Victron units"
	boolean
	default n
	
endmenu
```

## package/obexftp/Config.in
```kconfig
config ADK_COMPILE_OBEXFTP
	tristate
	default n
	depends on ADK_PACKAGE_OBEXFTP

config ADK_PACKAGE_OBEXFTP
	prompt "obexftp........................... obexftp applications"
	tristate
	default n
	select ADK_COMPILE_OBEXFTP
	select ADK_PACKAGE_LIBICONV
	select ADK_PACKAGE_OPENOBEX
	help
	  http://openobex.triq.net/
```

## package/olsrd/Config.in
```kconfig
#menu "olsrd............................. OLSR (Optimized Link State Routing) daemon"

config ADK_PACKAGE_OLSRD
	prompt "olsrd............................. OLSR (Optimized Link State Routing) daemon"
	tristate
	default n
	help
	  The Optimized Link State Routing daemon
	  
	  http://www.olsr.org/

config ADK_PACKAGE_OLSRD_MOD_DYN_GW
	prompt   "  olsrd-mod-dyn-gw.............. Dynamic internet gateway plugin"
	tristate
	default n
	depends ADK_PACKAGE_OLSRD

config ADK_PACKAGE_OLSRD_MOD_HTTPINFO
	prompt   "  olsrd-mod-httpinfo............ Small informative web server plugin"
	tristate
	default n
	depends ADK_PACKAGE_OLSRD

config ADK_PACKAGE_OLSRD_MOD_NAMESERVICE
	prompt   "  olsrd-mod-nameservice......... Lightweight hostname resolver plugin"
	tristate
	default n
	depends ADK_PACKAGE_OLSRD

config ADK_PACKAGE_OLSRD_MOD_TAS
	prompt   "  olsrd-mod-tas................. Tiny Application Server (TAS) plugin for olsrd"
	tristate
	default n
	depends ADK_PACKAGE_OLSRD

#endmenu
```

## package/opencdk/Config.in
```kconfig
config ADK_PACKAGE_OPENCDK
	tristate
	default n
	depends on ADK_PACKAGE_LIBOPENCDK

config ADK_PACKAGE_LIBOPENCDK
	prompt "libopencdk........................ The Open Crypto Development Kit library"
	tristate
	default n
	select ADK_PACKAGE_OPENCDK
	select ADK_PACKAGE_LIBGCRYPT
	select ADK_PACKAGE_LIBGPG_ERROR
	select ADK_PACKAGE_ZLIB
	help
	  This library provides basic parts of the OpenPGP message format.
	  For reference, please read the rfc2440.txt in the doc/ directory.
	  Due to some possible security problems, the library also implements
	  parts of draft-ietf-openpgp-rfc2440bis-08.txt. If you want to exchange
	  messages with earlier PGP version < 7, you should use the compat mode.

	  ftp://ftp.gnutls.org/pub/gnutls/opencdk/
```

## package/openct/Config.in
```kconfig
config ADK_PACKAGE_OPENCT
	prompt "openct............................ openct"
	tristate
	default n
	select ADK_PACKAGE_LIBLTDL
	select ADK_PACKAGE_LIBUSB
	help
	 openct
```

## package/openldap/Config.in
```kconfig
config ADK_COMPILE_OPENLDAP
	prompt "openldap.......................... OpenSource LDAP software"
	boolean
	default n

config ADK_PACKAGE_OPENLDAP_SLAPD
	prompt "openldap-slapd.................. OpenLDAP server"
	tristate
	default n
	select ADK_PACKAGE_LIBOPENLDAP
	select ADK_PACKAGE_LIBPTHREAD
	select ADK_PACKAGE_LIBOPENSSL
	select ADK_PACKAGE_LIBDB
	select ADK_PACKAGE_LIBSASL2
	depends on ADK_COMPILE_OPENLDAP
	help
	  http://www.openldap.org/

config ADK_PACKAGE_OPENLDAP_UTILS
	prompt   "openldap-utils.................. OpenLDAP client utilities"
	tristate
	default n
	select ADK_PACKAGE_LIBOPENLDAP
	depends on ADK_COMPILE_OPENLDAP
	help
	  
	  OpenLDAP Software is an open source implementation of the 
	  Lightweight Directory Access Protocol (LDAP).
	  
	  http://www.openldap.org/
	  
	  This package contains client programs required to access LDAP servers.
```

## package/openntpd/Config.in
```kconfig
config ADK_PACKAGE_OPENNTPD
	prompt "openntpd.......................... A free and easy to use NTP (Network Time Protocol) implementation"
	tristate
	default n
	help
	  NTP server
	  
	  http://www.openntpd.org/
```
