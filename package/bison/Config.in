## package/bison/Config.in
```kconfig
config ADK_PACKAGE_BISON
	prompt "bison.............................. GNU parser generator"
	tristate
	default n
	help
	  http://www.gnu.org/software/bison/
```

## package/bitlbee/Config.in
```kconfig
config ADK_PACKAGE_BITLBEE
	prompt "bitlbee........................... IRC gateway to IM chat networks"
	tristate
	default n
	select ADK_PACKAGE_LIBOPENSSL
	select ADK_PACKAGE_GLIB2
	select ADK_PACKAGE_LIBICONV
	help

	  BitlBee is an IRC daemon that can talk to instant messaging
	  networks and acts as a gateway. Users can connect to the
	  server with any normal IRC client and see their 'buddy list'
	  in #bitlbee.

	  http://www.bitlbee.org/
```

## package/bluez-firmware/Config.in
```kconfig
config ADK_PACKAGE_BLUEZ_FIRMWARE
	prompt "bluez-firmware.................... Bluetooth firmware files"
	tristate
	default n
	select ADK_PACKAGE_BLUEZ
	help
	  Bluez firmware files for BCM2033 USB adapters. 
	  
	  http://www.bluez.org
```

## package/bluez/Config.in
```kconfig
config ADK_PACKAGE_BLUEZ
	prompt "bluez............................. Bluetooth library and tools"
	tristate
	default n
	select ADK_KPACKAGE_KMOD_BT
	select ADK_PACKAGE_GLIB
	select ADK_PACKAGE_DBUS
	select ADK_PACKAGE_LIBUSB
	help
	  Bluez libs and apps. 
	  
	  http://bluez.org
```

## package/bogofilter/Config.in
```kconfig
config ADK_PACKAGE_BOGOFILTER
	prompt "bogofilter........................ Mail (spam) filter utility"
	tristate
	default n
	select ADK_PACKAGE_LIBDB
	select ADK_PACKAGE_LIBICONV
	help
		Filters mail, must be trained.

		http://bogofilter.sourceforge.net


config ADK_PACKAGE_BOGOFILTER_BOGOUTIL
	prompt "include bogoutil in firmware image and package file"
	bool
	default n
	depends on ADK_PACKAGE_BOGOFILTER

config ADK_PACKAGE_BOGOFILTER_BOGOTUNE
	prompt "include bogotune in firmware image and package file"
	bool
	default n
	depends on ADK_PACKAGE_BOGOFILTER
```

## package/bridge-utils/Config.in
```kconfig
config ADK_PACKAGE_BRIDGE_UTILS
	prompt "bridge-utils...................... Ethernet bridging configuration utility"
	tristate
	default n
	select ADK_KPACKAGE_KMOD_BRIDGE
	help
	  Manage ethernet bridging; a way to connect networks together to 
	  form a larger network.
	  
	  http://bridge.sourceforge.net/
```

## package/busybox/Config.in
```kconfig
config ADK_PACKAGE_BUSYBOX
	prompt "busybox.............................. The Swiss Army Knife"
	bool
	default y if !ADK_TOOLCHAIN_ONLY
	help
	  The Swiss Army Knife of embedded Linux.  It slices, it dices, it
	  makes Julian Fries.
	  http://busybox.net/
	  

menu "Busybox Configuration"
source "package/busybox/config/Config.in"
endmenu
```

## package/bwm/Config.in
```kconfig
config ADK_PACKAGE_BWM
	prompt "bwm............................... A very tiny BandWidth Monitor"
	tristate
	default n
	help
	 Continually displays data transfer rates (received, transmitted, and
	 total) for each interface, measured in KiB/sec. Works by sampling
	 values from /proc/net/dev and calculating deltas.
```

## package/bzip2/Config.in
```kconfig
config ADK_PACKAGE_BZIP2
	prompt "bzip2.............................. bzip2 compression utility"
	tristate
	default n
	help
 	  http://www.bzip.org
```

## package/ca-certificates/Config.in
```kconfig
config ADK_PACKAGE_CA_CERTS
	prompt "ca-certificates................... Collection of common CA certificates"
	tristate
	default n
	select ADK_PACKAGE_LIBOPENSSL
	select ADK_PACKAGE_LIBOPENSSL_UTIL
	help
	  Collection of CA certificates to validate internet certificates against.
	  
	  http://packages.debian.org/sid/ca-certificates

config ADK_DO_MINIMAL_CA_CERTS
	prompt "save space........................ Install only a very minimal version"
	boolean
	default n
	depends on ADK_PACKAGE_CA_CERTS
```

## package/cairo/Config.in
```kconfig
config ADK_PACKAGE_CAIRO
	prompt "cairo............................. Cairo library"
	tristate
	select ADK_PACKAGE_LIBPNG
	select ADK_PACKAGE_LIBX11
	select ADK_PACKAGE_PIXMAN
	select ADK_PACKAGE_LIBFREETYPE
	select ADK_PACKAGE_FONTCONFIG
	default n
	help
```

## package/cbtt/Config.in
```kconfig
config ADK_PACKAGE_CBTT
	prompt "cbtt.............................. a C BitTorrent Tracker"
	tristate
	default n
	select ADK_PACKAGE_ZLIB
	help
	 A C BitTorrent Tracker

config ADK_PACKAGE_CBTT_MYSQL
	prompt "cbtt-mysql........................ a C BitTorrent Tracker (mysql)"
	tristate
	default n
	select ADK_PACKAGE_ZLIB
	select ADK_PACKAGE_LIBMYSQLCLIENT
	help
	 A C BitTorrent Tracker
```

## package/cfgfs/Config.in
```kconfig
config ADK_PACKAGE_CFGFS
	prompt "cfgfs................................ compressed config filesystem"
	tristate
	select BUSYBOX_COMM
	select BUSYBOX_MD5SUM
	select BUSYBOX_XARGS
	select BUSYBOX_FEATURE_SORT_BIG
	select ADK_PACKAGE_MTD
	depends on \
		ADK_LINUX_X86_ALIX1C || \
		ADK_LINUX_X86_ALIX2D || \
		ADK_LINUX_X86_WRAP || \
		ADK_LINUX_CRIS_FOXBOARD || \
		ADK_LINUX_MIPS_AG241 || \
		ADK_LINUX_MIPS_RB532
	default y
	help
	  Compressed config filesystem for /etc.
	  This makes smooth updates of your embedded device possible.
	  (Adopted from FreeWRT fwcf)
```

## package/cfinstall/Config.in
```kconfig
config ADK_PACKAGE_CFINSTALL
	prompt "cfinstall........................... compact flash installer"
	tristate
	select ADK_PACKAGE_SFDISK
	select ADK_PACKAGE_PARTED
	select ADK_PACKAGE_GRUB_BIN
	depends on ADK_LINUX_X86_ALIX1C || ADK_LINUX_MIPS_RB532
	default n
	help
	  Installs a rootfs tar archive onto a Compact Flash disk.
```

## package/cgilib/Config.in
```kconfig
config ADK_PACKAGE_CGILIB
	prompt "cgilib............................ Simple CGI Library"
	tristate
	default n
	help
	  This library provides a simple programming API to the Common Gateway
	  Interface (CGI).  It features HTTP Redirect, provides read access to
	  FORM variables, sets HTTP Cookies and reads them.

	  http://www.infodrom.org/projects/cgilib/
```

## package/chillispot/Config.in
```kconfig
config ADK_PACKAGE_CHILLISPOT
	prompt "chillispot........................ Wireless LAN access point controller"
	tristate
	default n
	select ADK_KPACKAGE_KMOD_TUN
	help
	  ChilliSpot is an open source captive portal or wireless LAN
	  access point controller. It is used for authenticating users
	  of a wireless LAN. It supports web based login which is today's
	  standard for public HotSpots and it supports Wireless Protected
	  Access (WPA) which is the standard of the future. Authentication,
	  authorization and accounting (AAA) is handled by your favorite
	  radius server.

	  http://www.chillispot.org/
```

## package/collectd/Config.in
```kconfig
config ADK_PACKAGE_COLLECTD
	prompt "collectd.......................... Lightweight system statistics collection daemon"
	tristate
	default n
	select ADK_PACKAGE_LIBPTHREAD
	help
		collectd is a small daemon which collects system information
		every 10 seconds. The values are then sent to a multicast group
		to be stored in RRD files by a server process.

		http://verplant.org/collectd/

config ADK_PACKAGE_COLLECTD_CPU
        prompt "Enable cpu support"
	bool
	default y
	depends on ADK_PACKAGE_COLLECTD

config ADK_PACKAGE_COLLECTD_LOAD
        prompt "Enable load support"
	bool
	default y
	depends on ADK_PACKAGE_COLLECTD

config ADK_PACKAGE_COLLECTD_MEMORY
	prompt "Enable memory support"
	bool
	default y
	depends on ADK_PACKAGE_COLLECTD

config ADK_PACKAGE_COLLECTD_PING
	prompt "Enable ping support"
	bool
	default y
	depends on ADK_PACKAGE_COLLECTD
```

## package/comgt/Config.in
```kconfig
config ADK_PACKAGE_COMGT
	prompt "comgt............................. Option/Vodafone 3G/GPRS control tool"
	tristate
	default n
	help
	  Option GlobeTrotter GPRS/EDGE/3G/HSDPA and Vodafone 3G/GPRS datacard control tool
	  
	  comgt is a scripting language interpreter useful for establishing communications
	  on serial lines and through PCMCIA modems as well as GPRS and 3G datacards.
	  
	  http://www.pharscape.org/content/view/46/70/
```

## package/cpio/Config.in
```kconfig
config ADK_PACKAGE_CPIO
	prompt "cpio............................... copies files into or out of a cpio archive"
	tristate
	default n
	help
	  http://www.gnu.org/software/cpio/
```

## package/cryptinit/Config.in
```kconfig
config ADK_PACKAGE_CRYPTINIT
	prompt "cryptinit............................. crypt initramfs application"
	tristate
	default n
	help
	  For encrypted root filesystems and fast bootup.
```

## package/cryptsetup/Config.in
```kconfig
config ADK_PACKAGE_CRYPTSETUP
	prompt "cryptsetup........................ LUKS cryptsetup tools"
	tristate
	select ADK_PACKAGE_LIBPOPT
	select ADK_PACKAGE_LIBUUID
	select ADK_PACKAGE_LIBGCRYPT
	select ADK_PACKAGE_LVM
	select ADK_KPACKAGE_KMOD_BLK_DEV_DM
	select ADK_KPACKAGE_KMOD_DM_CRYPT
	select ADK_KPACKAGE_KMOD_CRYPTO_SHA256
	select ADK_KPACKAGE_KMOD_CRYPTO_AES
	select ADK_KPACKAGE_KMOD_CRYPTO_CBC
	default n
	help
	 LUKS cryptsetup tools. You need to enable crypto kernel
	 modules to get a working setup (f.e. aes and sha256).
```

## package/ctorrent/Config.in
```kconfig
config ADK_PACKAGE_CTORRENT
	prompt "ctorrent.......................... console-based BitTorrent client"
	tristate
	default n
	depends on ADK_CXX
	help
	  CTorrent is a BitTorrent client written in the C programming language, known to
	  be a very robust and mature programming language, which produces fast and
	  optimized application.

	  http://www.rahul.net/dholmes/ctorrent/

choice
prompt "C++ library to use"
depends on ADK_PACKAGE_CTORRENT
default ADK_COMPILE_CTORRENT_WITH_STDCXX if ADK_TARGET_LIB_GLIBC
default ADK_COMPILE_CTORRENT_WITH_UCLIBCXX if ADK_TARGET_LIB_UCLIBC

config ADK_COMPILE_CTORRENT_WITH_STDCXX
	bool "Standard C++ library"
	select ADK_PACKAGE_LIBSTDCXX
	help

config ADK_COMPILE_CTORRENT_WITH_UCLIBCXX
	bool "Embedded uClibc++ library"
	select ADK_PACKAGE_UCLIBCXX
	help

endchoice
```

## package/cups/Config.in
```kconfig
config ADK_PACKAGE_CUPS
	prompt "cups.............................. Common UNIX Printing System"
	tristate
	select ADK_PACKAGE_ZLIB	
	select ADK_PACKAGE_LIBPTHREAD
	default n
	help
	  A printer spooling system for devices with USB or LP support
	  
	  http://www.cups.org/
```

## package/curl/Config.in
```kconfig
config ADK_COMPILE_CURL
	tristate
	default n
	depends on ADK_PACKAGE_LIBCURL

config ADK_PACKAGE_CURL
	prompt   "curl.............................. A client-side URL transfer tool"
	tristate
	default n
	depends on ADK_PACKAGE_LIBCURL
	help
	  http://curl.haxx.se/
```

## package/cutter/Config.in
```kconfig
config ADK_PACKAGE_CUTTER
	prompt "cutter............................ allows an user to abort TCP/IP connections"
	tristate
	default n
	help
		"Cutter" is an open source program that allows Linux firewall
		administrators to abort TCP/IP connections routed over the
		firewall or router on which it is run.

		http://www.lowth.com/cutter/
```
