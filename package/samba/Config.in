## package/sangam-atm/Config.in
```kconfig
config ADK_PACKAGE_KMOD_SANGAM_ATM
	prompt "kmod-sangam-atm.......................... Driver for TI AR7 DSL modem"
	tristate
	select ADK_KPACKAGE_KMOD_FW_LOADER
	default n
	help
	  ATM driver for AR7 DSL modem.

choice
prompt "Firmware type"
depends on ADK_PACKAGE_KMOD_SANGAM_ATM

config ADK_PACKAGE_SANGAM_ATM_ANNEX_A
	prompt "Annex A, ADSL over POTS"
	boolean
	help

config ADK_PACKAGE_SANGAM_ATM_ANNEX_B
	prompt "Annex B, ADSL over ISDN"
	boolean
	help

endchoice
```

## package/scanlogd/Config.in
```kconfig
config ADK_PACKAGE_SCANLOGD
	prompt "scanlogd.......................... a port scan detection tool"
	tristate
	select ADK_PACKAGE_LIBPCAP
	select ADK_PACKAGE_LIBNET
	select ADK_PACKAGE_LIBNIDS
	default n
	help
	  Scanlogd is a TCP port scan detection tool, originally designed 
	  to illustrate various attacks an IDS developer has to deal with.  
	  Thus, unlike some of the other port scan detection tools out there, 
	  scanlogd is designed to be totally safe to use.

	  http://www.openwall.com/scanlogd
```

## package/screen/Config.in
```kconfig
config ADK_PACKAGE_SCREEN
	prompt "screen............................ Full-screen terminal window manager"
	tristate
	default n
	select ADK_PACKAGE_LIBNCURSES
	help
	  Screen is a full-screen window manager that multiplexes a physical 
	  terminal between several processes, typically interactive shells.
	  
	  http://www.gnu.org/software/screen/
```

## package/scrnsaverproto/Config.in
```kconfig
config ADK_PACKAGE_SCRNSAVERPROTO
	prompt "scrnsaverproto............................. X protocol library"
	tristate
	default n
	help
         http://www.x.org
```

## package/scsi-spin/Config.in
```kconfig
config ADK_PACKAGE_SCSI_SPIN
	prompt "scsi-spin......................... Utility to spin down scsi disks"
	tristate
	default n
	help
	  Utility to spin down scsi disks
	  
	  This program is part of debian's scsitools package
```

## package/ser2net/Config.in
```kconfig
config ADK_PACKAGE_SER2NET
        prompt "ser2net........................... Serial port TCP/IP redirector"
        tristate
	default n
        help
	  This is ser2net, a program for allowing network connections to serial
	  ports. See the man page for information about using the program. Note 
          that ser2net supports RFC 2217 (remote control of serial port parameters),
          but you must have a complient client. 
```

## package/serdisplib/Config.in
```kconfig
config ADK_PACKAGE_SERDISPLIB
	prompt "serdisplib........................ a library for controlling displays"
	tristate
	default n
	help
	  serdisplib is a library to drive serial and parallel displays
	  with built-in controllers.
	  
	  http://serdisplib.sourceforge.net/
```

## package/setpwc/Config.in
```kconfig
config ADK_PACKAGE_SETPWC
	prompt "setpwc............................ Philips (and compatibles) WebCams (PWC) control utility"
	tristate
	default n
	help
	  Philips (and compatibles) WebCams (PWC) control utility.
	  
	  http://www.vanheusden.com/setpwc/
```

## package/shat/Config.in
```kconfig
config ADK_PACKAGE_SHAT
	prompt "shat.............................. Source Hardware Address Translation"
	tristate
	default n
	help
	  A tool which allows hosts with arbitrary IP configuration
	  to connect to the internet over a SHAT gateway.
	  
	  http://www.teddy-net.com/cvs/Maxina/128gw/service/arpcatch/shat/
```

## package/shorewall-common/Config.in
```kconfig
config ADK_PACKAGE_SHOREWALL
	prompt "shorewall......................... high-level netfilter configuration tool"
	tristate
	default n
	select ADK_PACKAGE_IPTABLES
	help
	  The Shoreline Firewall, more commonly known as "Shorewall", is a 
	  high-level tool for configuring Netfilter. You describe your 
	  firewall/gateway requirements using entries in a set of configuration 
	  files. Shorewall reads those configuration files and with the help 
	  of the iptables utility, Shorewall configures Netfilter to match 
	  your requirements.

	  http://www.shorewall.net/

config ADK_PACKAGE_SHOREWALL_STRIPCONF
	prompt "Strip shorewall configuration files"
	bool
	default n
	depends on ADK_PACKAGE_SHOREWALL
	help
	  To save space, all shorewall files in /etc/shorewall will get striped.
	  This means that all comments, empty lines etc. are removed.

	  By default this option is not enabled, because the comments
	  in the configfiles helps the user a lot to configure shorewall.

config ADK_PACKAGE_SHOREWALL_STRIPSHARED
	prompt "Strip shared shorewall files (macros & actions mainly)"
	bool
	default y
	depends on ADK_PACKAGE_SHOREWALL
	help
	  To save space, all shared shorewall files in /usr/share/shorewall
	  will get striped. This means that all comments, empty lines etc. 
	  are removed.

	  By default this option is enabled, because for normal usage the user
	  doesn't need to change files in /usr/share/shorewall. Comments in all
	  shared files just would waste disk space on most embedded devices.
```

## package/shorewall-shell/Config.in
```kconfig
config ADK_PACKAGE_SHOREWALL_SHELL
	prompt "shorewall-shell................. shorewall shell compiler"
	tristate
	depends on ADK_PACKAGE_SHOREWALL
	default y
	help
	  http://www.shorewall.net/
```

## package/siproxd/Config.in
```kconfig
config ADK_PACKAGE_SIPROXD
	prompt "siproxd........................... SIP (Session Initiation Protocol) proxy"
	tristate
	default n
	select ADK_PACKAGE_LIBOSIP2
	help
	  A SIP (Session Initiation Protocol) proxy
	  
	  http://siproxd.sourceforge.net/
	  
	  Depends: libosip2
```

## package/sipsak/Config.in
```kconfig
config ADK_PACKAGE_SIPSAK
	prompt "sipsak............................ SIP (Session Initiation Protocol) stress and diagnostics utility"
	tristate
	default n
	select ADK_PACKAGE_LIBOPENSSL
	help
	  A SIP (Session Initiation Protocol) stress and diagnostics utility
	  
	  http://www.sipsak.org/
	  
	  Depends: openssl
```

## package/sispmctl/Config.in
```kconfig
config ADK_PACKAGE_SISPMCTL
	prompt "sispmctl.......................... control application for power sockets"
	tristate
	default n
	select ADK_PACKAGE_LIBUSB
	help
	switch USB controlled outlets of Gembird Silver Shield PM.
  
	http://sispmctl.sourceforge.net/
```

## package/slurm/Config.in
```kconfig
config ADK_PACKAGE_SLURM
	prompt "slurm............................. A realtime network interface monitor"
	tristate
	default n
	help
	  A realtime network interface monitor with the following features:
	  
	    * realtime traffic statistics divided into incoming and outgoing
	    * optional combined view
	    * can monitor any kind of network interface
	    * shows detailed statistics about the interface.
	    * it's themeable
	  
	  http://www.wormulon.net/projects/slurm
```

## package/snort-wireless/Config.in
```kconfig
config ADK_PACKAGE_SNORT_WIRELESS
	prompt "snort-wireless.................... Ligthweight Wireless Network Intrusion Detection System (NIDS)"
	tristate
	select ADK_PACKAGE_LIBNET
	select ADK_PACKAGE_LIBPCAP
	select ADK_PACKAGE_LIBPCRE
	default n
	help
	  
	  A ligthweight Wireless Network Intrusion Detection System (NIDS)
	  
	  http://www.snort-wireless.org/
	  
	  Depends: 
	    - libnet
	    - libpcap
	    - libpcre
```

## package/snort/Config.in
```kconfig
config ADK_PACKAGE_SNORT
	prompt "snort............................. Ligthweight Network Intrusion Detection System (NIDS)"
	tristate
	default n
	select ADK_PACKAGE_LIBNET
	select ADK_PACKAGE_LIBPCAP
	select ADK_PACKAGE_LIBPCRE
	help
	  
	  A ligthweight Network Intrusion Detection System (NIDS)
	  
	  http://www.snort.org/
	  
	  Depends: 
	    - libnet
	    - libpcap
	    - libpcre
	
```

## package/socat/Config.in
```kconfig
config ADK_PACKAGE_SOCAT
	prompt "socat............................. A multipurpose relay (SOcket CAT)"
	tristate
	default n
	select ADK_PACKAGE_LIBOPENSSL
	select ADK_PACKAGE_LIBPTHREAD
	help
	  SoCat (for SOcket CAT) establishes two bidirectional byte streams and 
	  transfers data between them.
	  Data channels may be files, pipes, devices (terminal or modem, etc.), or 
	  sockets (Unix, IPv4, IPv6, raw, UDP, TCP, SSL). It provides forking, 
	  logging and tracing, different modes for interprocess communication and 
	  many more options.
	  
	  http://www.dest-unreach.org/socat/
	  
	  Depends: openssl
```

## package/speex/Config.in
```kconfig
config ADK_COMPILE_SPEEX
	tristate
	default n
	depends on ADK_CXX
	depends on ADK_PACKAGE_LIBSPEEX

config ADK_PACKAGE_LIBSPEEX
	prompt "libspeex.......................... Open source patent-free speech compression codec"
	tristate
	default n
	select ADK_COMPILE_SPEEX
	help
	  
	  Speex is an Open Source/Free Software patent-free audio compression 
	  format designed for speech. The Speex Project aims to lower the 
	  barrier of entry for voice applications by providing a free 
	  alternative to expensive proprietary speech codecs. Moreover, Speex 
	  is well-adapted to Internet applications and provides useful features 
	  that are not present in most other codecs.
	  
	  http://www.speex.org/
	  
	  This package contains the shared codec library, needed by other programs.
```

## package/squid/Config.in
```kconfig
config ADK_PACKAGE_SQUID
	prompt "squid............................. full-featured Web proxy cache"
	tristate
	default n
	depends on ADK_CXX
	select ADK_PACKAGE_LIBOPENSSL
	help
	  Squid is a high-performance proxy caching server for web clients, 
	  supporting FTP, gopher, and HTTP data objects. Unlike traditional 
	  caching software, Squid handles all requests in a single, 
	  non-blocking, I/O-driven process.

	  http://www.squid-cache.org

choice
prompt "C++ library to use"
depends on ADK_PACKAGE_SQUID
default ADK_COMPILE_SQUID_WITH_STDCXX if ADK_TARGET_LIB_GLIBC
default ADK_COMPILE_SQUID_WITH_UCLIBCXX if ADK_TARGET_LIB_UCLIBC

config ADK_COMPILE_SQUID_WITH_STDCXX
        bool "Standard C++ library"
        select ADK_PACKAGE_LIBSTDCXX
        help

config ADK_COMPILE_SQUID_WITH_UCLIBCXX
        bool "Embedded uClibc++ library"
        select ADK_PACKAGE_UCLIBCXX
        help

endchoice

menu "squid............................. proxy and web cache modules"

config ADK_PACKAGE_SQUID_MOD_BASIC_AUTH_GETPWNAM
	prompt "squid-mod-basic-auth-getpwnam....... getpwnam basic authentication helper"
	tristate
	depends on ADK_PACKAGE_SQUID
	help
	  Password basic authentication helper

config ADK_PACKAGE_SQUID_MOD_BASIC_AUTH_NCSA
	prompt "squid-mod-basic-auth-ncsa........... NCSA basic authentication helper"
	tristate
	depends on ADK_PACKAGE_SQUID
	help
	  NCSA basic authentication helper

config ADK_PACKAGE_SQUID_MOD_BASIC_AUTH_SMB
	prompt "squid-mod-basic-auth-smb............ Samba basic authentication helper"
	tristate
	depends on ADK_PACKAGE_SQUID
	help
	  Samba basic authentication helper

config ADK_PACKAGE_SQUID_MOD_DIGEST_AUTH_PASSWORD
	prompt "squid-mod-digest-auth-password...... Password digest authentication ehlper"
	tristate
	depends on ADK_PACKAGE_SQUID
	help
	  Password digest authentication helper

config ADK_PACKAGE_SQUID_MOD_EXTERNAL_ACL_IP_USER
	prompt "squid-mod-external-acl-ip_user...... IP user external ACL helper"
	tristate
	depends on ADK_PACKAGE_SQUID
	help
	  IP user external ACL helper

config ADK_PACKAGE_SQUID_MOD_EXTERNAL_ACL_UNIX_GROUP
	prompt "squid-mod-external-acl-unix-group... Unix group external ACL helper"
	tristate
	depends on ADK_PACKAGE_SQUID
	help
	  Unix group external ACL helper

config ADK_PACKAGE_SQUID_MOD_NTLM_AUTH_FAKEAUTH
	prompt "squid-mod-ntlm-auth-fakeauth........ Fakeauth NTLM authentication helper"
	tristate
	depends on ADK_PACKAGE_SQUID
	help
	  Fakeauth NTLM authentication helper

config ADK_PACKAGE_SQUID_MOD_NTLM_AUTH_SMB_AUTH
	prompt "squid-mod-ntlm-auth-smb-auth........ Samba NTLM authentication helper"
	tristate
	depends on ADK_PACKAGE_SQUID
	help
	  Samba NTLM authentication helper

endmenu
```

## package/srelay/Config.in
```kconfig
config ADK_PACKAGE_SRELAY
	prompt "srelay............................ A socks 4/5 proxy server"
	tristate
	default n
	help
	  A socks 4/5 protocol proxy server
	  
	  http://www.c-wind.com/srelay/
```

## package/ssltunnel/Config.in
```kconfig
config ADK_PACKAGE_SSLTUNNEL
	prompt "ssltunnel ........................ A PPP over SSL vpn tool"
	tristate
	default n
	select ADK_PACKAGE_LIBOPENSSL
	select ADK_PACKAGE_PPP
	help
	  A PPP over SSL vpn tool
	  
	  http://www.hsc.fr/ressources/outils/ssltunnel/index.html
	  
```

## package/stress/Config.in
```kconfig
config ADK_PACKAGE_STRESS
	prompt "stress............................ Stress your system"
	tristate
	default n
	help
	  Stress is a simple tool that imposes a configurable amount of CPU, 
	  memory, I/O, and disk stress on POSIX-compliant operating systems. 
	  It is written in portable ANSI C and uses the GNU Autotools to 
	  compile on most UNIX-like operating systems. It is free software, 
	  licensed under the GNU GPL
	  
	  http://weather.ou.edu/~apw/projects/stress/
```
