## package/openobex/Config.in
```kconfig
config ADK_PACKAGE_OPENOBEX
	prompt "openobex.......................... openobex library"
	tristate
	default n
	select ADK_PACKAGE_BLUEZ
	help
	  Open source implementation of the Object Exchange (OBEX) protocol.  
	  http://openobex.triq.net/
```

## package/opensc/Config.in
```kconfig
config ADK_PACKAGE_OPENSC
	prompt "opensc............................ opensc"
	tristate
	default n
	help
	 opensc
```

## package/opensips/Config.in
```kconfig
#menu "opensips........................... Configurable, free SIP server"

config ADK_PACKAGE_OPENSIPS
	prompt "opensips........................... Configurable, free SIP server"
	tristate
	default n
	select ADK_PACKAGE_LIBOPENSSL
	help
	 Open SIP Express Router (OpenSER) is a high-performance,
	 configurable, free SIP server.

config ADK_PACKAGE_OPENSIPS_MOD_ACCOUNTING
	prompt   "  opensips-mod-acc............... Accounting support"
	tristate
	default n
	depends ADK_PACKAGE_OPENSIPS
	help
	  Enable accounting support

config ADK_PACKAGE_OPENSIPS_MOD_AUTH
	prompt   "  opensips-mod-auth.............. Authentication support"
	tristate
	default n
	depends ADK_PACKAGE_OPENSIPS
	help
	  Enable authentication support

config ADK_PACKAGE_OPENSIPS_MOD_AUTH_DB
	prompt     "  opensips-mod-auth-db......... Authentication with database support"
	tristate
	default n
	depends ADK_PACKAGE_OPENSIPS_MOD_AUTH
	help
	  Enable authentication with database support

config ADK_PACKAGE_OPENSIPS_MOD_AVPOPS
	prompt   "  opensips-mod-avpops............ AVP options support"
	tristate
	default n
	depends ADK_PACKAGE_OPENSIPS
	help
	  Enable AVP options support

config ADK_PACKAGE_OPENSIPS_MOD_DISPATCHER
	prompt   "  opensips-mod-dispatcher........ dispatcher support"
	tristate
	default n
	depends ADK_PACKAGE_OPENSIPS
	help
	  Enable dispatcher options support

config ADK_PACKAGE_OPENSIPS_MOD_DIVERSION
	prompt   "  opensips-mod-diversion......... diversion support"
	tristate
	default n
	depends ADK_PACKAGE_OPENSIPS
	help
	  Enable diversion options support

config ADK_PACKAGE_OPENSIPS_MOD_FLATSTORE
	prompt   "  opensips-mod-flatstore......... flatstore support"
	tristate
	default n
	depends ADK_PACKAGE_OPENSIPS
	help
	  Enable flatstore support

config ADK_PACKAGE_OPENSIPS_MOD_GFLAGS
	prompt   "  opensips-mod-gflags............ gflags support"
	tristate
	default n
	depends ADK_PACKAGE_OPENSIPS
	help
	  Enable GFlags support

config ADK_PACKAGE_OPENSIPS_MOD_GROUP
	prompt   "  opensips-mod-group............. group support"
	tristate
	default n
	depends ADK_PACKAGE_OPENSIPS
	help
	  Enable group support

config ADK_PACKAGE_OPENSIPS_MOD_MEDIAPROXY
	prompt   "  opensips-mod-mediaproxy........ Mediaproxy support"
	tristate
	default n
	depends ADK_PACKAGE_OPENSIPS
	help
	  Enable mediaproxy support

config ADK_PACKAGE_OPENSIPS_MOD_MSILO
	prompt   "  opensips-mod-msilo............. MSilo support"
	tristate
	default n
	depends ADK_PACKAGE_OPENSIPS
	help
	  Enable msilo support

config ADK_PACKAGE_OPENSIPS_MOD_NATHELPER
	prompt   "  opensips-mod-nathelper......... NAT helper support"
	tristate
	default n
	depends ADK_PACKAGE_OPENSIPS
	help
	  NAT helper support

config ADK_PACKAGE_OPENSIPS_MOD_OPTIONS
	prompt   "  opensips-mod-options........... options support"
	tristate
	default n
	depends ADK_PACKAGE_OPENSIPS
	help
	  Enable options support

config ADK_PACKAGE_OPENSIPS_MOD_PDT
	prompt   "  opensips-mod-pdt............... PDT support"
	tristate
	default n
	depends ADK_PACKAGE_OPENSIPS
	help
	  Enable pdt support

config ADK_PACKAGE_OPENSIPS_MOD_PERMISSIONS
	prompt   "  opensips-mod-permissions....... Permissions support"
	tristate
	default n
	depends ADK_PACKAGE_OPENSIPS
	help
	  Enable permissions support

config ADK_PACKAGE_OPENSIPS_MOD_PIKE
	prompt   "  opensips-mod-pike.............. PIKE support"
	tristate
	default n
	depends ADK_PACKAGE_OPENSIPS
	help
	  Enable pike support

config ADK_PACKAGE_OPENSIPS_MOD_SMS
	prompt   "  opensips-mod-sms............... SMS support"
	tristate
	default n
	depends ADK_PACKAGE_OPENSIPS
	help
	  SMS support

config ADK_PACKAGE_OPENSIPS_MOD_SPEEDDIAL
	prompt   "  opensips-mod-speeddial......... Speed Dial support"
	tristate
	default n
	depends ADK_PACKAGE_OPENSIPS
	help
	  Speed Dial support

config ADK_PACKAGE_OPENSIPS_MOD_UAC
	prompt   "  opensips-mod-uac............... UAC support"
	tristate
	default n
	depends ADK_PACKAGE_OPENSIPS
	help
	  Enable UAC support

config ADK_PACKAGE_OPENSIPS_MOD_UAC_REDIRECT
	prompt   "  opensips-mod-uac............... UAC redirect support"
	tristate
	default n
	depends ADK_PACKAGE_OPENSIPS
	help
	  Enable UAC redirect support

config ADK_PACKAGE_OPENSIPS_MOD_URI
	prompt   "  opensips-mod-uri............... URI support"
	tristate
	default n
	depends ADK_PACKAGE_OPENSIPS
	help
	  Enable URI support

config ADK_PACKAGE_OPENSIPS_MOD_URI_DB
	prompt   "  opensips-mod-uri-db............ URI database support"
	tristate
	default n
	depends ADK_PACKAGE_OPENSIPS
	help
	  Enable URI database support

config ADK_PACKAGE_OPENSIPS_MOD_XLOG
	prompt   "  opensips-mod-xlog.............. Logging support"
	tristate
	default n
	depends ADK_PACKAGE_OPENSIPS
	help
	  Logging support

#endmenu
```

## package/openssh/Config.in
```kconfig
config ADK_COMPILE_OPENSSH
	prompt "openssh........................... OpenSSH software"
	bool
	default n

config ADK_COMPILE_OPENSSH_WITH_KERBEROS
	prompt "Enable Kerberos support"
	bool
	depends on ADK_COMPILE_OPENSSH

choice
prompt "Kerberos implementation"
depends on ADK_COMPILE_OPENSSH_WITH_KERBEROS
config ADK_COMPILE_OPENSSH_WITH_KRB5
	prompt "MIT"
	bool
	select ADK_PACKAGE_KRB5_LIBS
	help
	  Use MIT kerberos libraries.

config ADK_COMPILE_OPENSSH_WITH_HEIMDAL
	prompt "Heimdal"
	bool
	select ADK_COMPILE_HEIMDAL
	select ADK_PACKAGE_HEIMDAL_LIBS
	help 
	  Use heimdal kerberos libraries.

endchoice

config ADK_PACKAGE_OPENSSH_CLIENT
	prompt "openssh-client.................... OpenSSH clients"
	tristate
	default n
	select ADK_PACKAGE_LIBOPENSSL
	select ADK_PACKAGE_ZLIB
	depends on ADK_COMPILE_OPENSSH
	help
	  OpenSSH is a FREE version of the SSH protocol suite of network
	  connectivity tools that increasing numbers of people on the Internet
	  are coming to rely on. Many users of telnet, rlogin, ftp, and other
	  such programs might not realize that their password is transmitted
	  across the Internet unencrypted, but it is. OpenSSH encrypts all
	  traffic (including passwords) to effectively eliminate eavesdropping,
	  connection hijacking, and other network-level attacks. Additionally,
	  OpenSSH provides a myriad of secure tunneling capabilities, as well
	  as a variety of authentication methods.
	  
	  This package contains the ssh(1) client and the scp(1) client/server.
	  
	  http://www.openssh.com/

config ADK_PACKAGE_OPENSSH_CLIENT_UTILS
	prompt   "openssh-client-utils............ OpenSSH client utilities"
	tristate
	default n
	depends on ADK_PACKAGE_OPENSSH_CLIENT
	depends on ADK_COMPILE_OPENSSH
	help
	  OpenSSH is a FREE version of the SSH protocol suite of network
	  connectivity tools that increasing numbers of people on the Internet
	  are coming to rely on. Many users of telnet, rlogin, ftp, and other
	  such programs might not realize that their password is transmitted
	  across the Internet unencrypted, but it is. OpenSSH encrypts all
	  traffic (including passwords) to effectively eliminate eavesdropping,
	  connection hijacking, and other network-level attacks. Additionally,
	  OpenSSH provides a myriad of secure tunneling capabilities, as well
	  as a variety of authentication methods.
	  
	  This package contains ssh-agent and ssh-add as well as ssh-keyscan.
	  
	  http://www.openssh.com/

config ADK_PACKAGE_OPENSSH_SERVER
	prompt "openssh-server.................... OpenSSH server"
	tristate
	default n
	select ADK_PACKAGE_LIBOPENSSL
	select ADK_PACKAGE_ZLIB
	depends on ADK_COMPILE_OPENSSH
	help
	  OpenSSH is a FREE version of the SSH protocol suite of network
	  connectivity tools that increasing numbers of people on the Internet
	  are coming to rely on. Many users of telnet, rlogin, ftp, and other
	  such programs might not realize that their password is transmitted
	  across the Internet unencrypted, but it is. OpenSSH encrypts all
	  traffic (including passwords) to effectively eliminate eavesdropping,
	  connection hijacking, and other network-level attacks. Additionally,
	  OpenSSH provides a myriad of secure tunneling capabilities, as well
	  as a variety of authentication methods.
	  
	  This package contains sshd(8) and ssh-keygen(8), but not scp(1),
	  which is needed for SCP server support.
	  
	  http://www.openssh.com/


config ADK_PACKAGE_OPENSSH_SFTP_CLIENT
	prompt "openssh-sftp-client............... OpenSSH SFTP client"
	tristate
	default n
	select ADK_PACKAGE_LIBOPENSSL
	select ADK_PACKAGE_ZLIB
	depends on ADK_COMPILE_OPENSSH
	help
	  OpenSSH is a FREE version of the SSH protocol suite of network
	  connectivity tools that increasing numbers of people on the Internet
	  are coming to rely on. Many users of telnet, rlogin, ftp, and other
	  such programs might not realize that their password is transmitted
	  across the Internet unencrypted, but it is. OpenSSH encrypts all
	  traffic (including passwords) to effectively eliminate eavesdropping,
	  connection hijacking, and other network-level attacks. Additionally,
	  OpenSSH provides a myriad of secure tunneling capabilities, as well
	  as a variety of authentication methods.
	  
	  This package contains the /usr/bin/sftp client utility.
	  
	  http://www.openssh.com/

config ADK_PACKAGE_OPENSSH_SFTP_SERVER
	prompt "openssh-sftp-server............... OpenSSH SFTP server"
	tristate
	default n
	select ADK_PACKAGE_LIBOPENSSL
	select ADK_PACKAGE_ZLIB
	depends on ADK_COMPILE_OPENSSH
	help
	  OpenSSH is a FREE version of the SSH protocol suite of network
	  connectivity tools that increasing numbers of people on the Internet
	  are coming to rely on. Many users of telnet, rlogin, ftp, and other
	  such programs might not realize that their password is transmitted
	  across the Internet unencrypted, but it is. OpenSSH encrypts all
	  traffic (including passwords) to effectively eliminate eavesdropping,
	  connection hijacking, and other network-level attacks. Additionally,
	  OpenSSH provides a myriad of secure tunneling capabilities, as well
	  as a variety of authentication methods.
	  
	  This package contains the SFTP server helper programme.
	  
	  http://www.openssh.com/
```

## package/openssl-pkcs11/Config.in
```kconfig
config ADK_PACKAGE_OPENSSL_PKCS11
	prompt "openssl-pkcs11.................... openssl pkcs11 engine"
	tristate
	default n
	select ADK_PACKAGE_LIBP11
	help
	  openssl pkcs11 engine
```

## package/openssl/Config.in
```kconfig
config ADK_COMPILE_OPENSSL
	tristate
	default n
	depends on ADK_PACKAGE_LIBOPENSSL
	
config ADK_PACKAGE_LIBOPENSSL
	prompt "openssl........................... Open source SSL (Secure Socket Layer) libraries"
	tristate
	default n
	select ADK_COMPILE_OPENSSL
	select ADK_PACKAGE_ZLIB
	help
	  The OpenSSL Project is a collaborative effort to develop a robust, 
	  commercial-grade, full-featured, and Open Source toolkit implementing 
	  the Secure Sockets Layer (SSL v2/v3) and Transport Layer Security (TLS v1) 
	  protocols as well as a full-strength general purpose cryptography library.
	  
	  http://www.openssl.org/
	  
	  This package contains the shared SSL libraries, needed by other programs.

config ADK_PACKAGE_LIBOPENSSL_DEV
	prompt "libopenssl-dev.................... SSL development files"
	tristate
	default n
	select ADK_COMPILE_OPENSSL
	depends on ADK_PACKAGE_LIBOPENSSL
	help
	  http://www.openssl.org/

config ADK_PACKAGE_OPENSSL_UTIL
	prompt   "openssl-util.................... OpenSSL command line tool"
	tristate
	default n
	depends on ADK_PACKAGE_LIBOPENSSL
	help
	  The OpenSSL Project is a collaborative effort to develop a robust, 
	  commercial-grade, full-featured, and Open Source toolkit implementing 
	  the Secure Sockets Layer (SSL v2/v3) and Transport Layer Security (TLS v1) 
	  protocols as well as a full-strength general purpose cryptography library.
	  
	  http://www.openssl.org/
	  
	  This package contains the multi-purpose OpenSSL binary tool.
```

## package/openswan/Config.in
```kconfig
config ADK_PACKAGE_OPENSWAN
	prompt "openswan.......................... VPN solution using IPsec"
	tristate
	default n
	select ADK_PACKAGE_IP
	select ADK_PACKAGE_LIBGMP
	help
	  Openswan is an implementation of IPsec for Linux.
	  
	  http://www.openswan.org/

choice
prompt "IPSec stack to use"
depends on ADK_PACKAGE_OPENSWAN
config ADK_COMPILE_OPENSWAN_WITH_NETKEY
	prompt "NETKEY - use Linux integrated IPSec Stack"
	select ADK_KPACKAGE_KMOD_NET_KEY
	select ADK_KPACKAGE_KMOD_INET_XFRM_MODE_TUNNEL
	select ADK_KPACKAGE_KMOD_INET_XFRM_MODE_TRANSPORT
	select ADK_KPACKAGE_KMOD_INET_ESP
	select ADK_KPACKAGE_KMOD_INET_AH
	bool
	help

config ADK_COMPILE_OPENSWAN_WITH_KLIPS
	prompt "KLIPS - use OpenS/WAN IPSec Stack"
	bool
	help

endchoice
```

## package/openvpn/Config.in
```kconfig
config ADK_PACKAGE_OPENVPN
	prompt "openvpn........................... Open source VPN solution using SSL"
	tristate
	default n
	select ADK_KPACKAGE_KMOD_TUN
	help
	  Open Source VPN solution using SSL
	  
	  http://openvpn.net/
	  
	  Depends: kmod-tun, libpthread

config ADK_COMPILE_OPENVPN_WITH_SERVER
	prompt "server support.................. enable to use OpenVPN as server"
	bool
	default y
	depends ADK_PACKAGE_OPENVPN

config ADK_COMPILE_OPENVPN_WITH_HTTP
	prompt "enable http proxy support....... allow tunneling through http-proxy"
	bool
	default y
	depends ADK_PACKAGE_OPENVPN

config ADK_COMPILE_OPENVPN_WITH_OPENSSL
	prompt "enable openssl.................. encryption support"
	bool
	default y
	depends ADK_PACKAGE_OPENVPN
	select ADK_PACKAGE_LIBOPENSSL
	help
	  if unsure say "y" you really want that!

config ADK_COMPILE_OPENVPN_WITH_LZO
	prompt "enable lzo...................... Enable transparent compression"
	bool
	default y
	depends ADK_PACKAGE_OPENVPN
	select ADK_PACKAGE_LIBLZO

config ADK_COMPILE_OPENVPN_WITH_PASSWORD_SAVE
	prompt "Enable password saving.......... allow to read passwords for PKCS12 from file"
	bool
	default y
	depends ADK_PACKAGE_OPENVPN

config ADK_COMPILE_OPENVPN_WITH_SMALL
	prompt "Reduce executable size.......... disable OCC, usage message, and verb 4 parm list"
	bool
	default n
	depends ADK_PACKAGE_OPENVPN

config ADK_PACKAGE_OPENVPN_EASY_RSA
	prompt "openvpn-easy-rsa................ simple shell scripts to manage a Certificate Authority"
	tristate
	default n
	select ADK_PACKAGE_OPENSSL_UTIL
	depends ADK_PACKAGE_OPENVPN
	help
	  collection of shell scripts to manage a simple CA infrastructure

	  Depends: openpvn, openssl-util
```

## package/oprofile/Config.in
```kconfig
config ADK_PACKAGE_OPROFILE
	prompt "oprofile.......................... a system-wide profiler"
	tristate
	select ADK_PACKAGE_LIBPOPT
	default n
	help
	  http://oprofile.sourceforge.net
```

## package/osiris/Config.in
```kconfig
config ADK_COMPILE_OSIRIS
	tristate
	default n
	depends ADK_PACKAGE_OSIRISD

config ADK_PACKAGE_OSIRISD
	prompt "osirisd........................... Host integrity monitoring system (scanning agent)"
	tristate
	default n
	select ADK_COMPILE_OSIRIS
	select ADK_PACKAGE_LIBOPENSSL
	help
	  An host integrity monitoring system (scanning agent)
	  
	  http://www.hostintegrity.com/osiris/
	  
	  Depends: openssl
```

## package/owfs/Config.in
```kconfig
config ADK_PACKAGE_OWFS
	prompt "owfs.............................. 1-wire filesystem to map sensors to a directory"
	tristate
	default n
	select ADK_PACKAGE_FUSE_UTILS
	select ADK_PACKAGE_LIBUSB
	help
	  1-Wire technology by Dallas Semiconductors is a simple bus for different kind of devices
	  like tempereatur, humidity, pressure, voltage, etc.
	  owfs maps the devices to a dirctory utilizing fuse.
	  
	  http://www.owfs.org/
```
