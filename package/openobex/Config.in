## package/palantir/Config.in
```kconfig
config ADK_PACKAGE_PALANTIR
	prompt "palantir.......................... A multichannel interactive streaming solution"
	tristate
	default n
	select ADK_PACKAGE_LIBJPEG
	help
	  Palantir is a Linux-based streaming system designed to transmit live 
	  video, audio and data over a TCP/IP network, as well as to control 
	  remote devices.
	  
	  http://www.fastpath.it/products/palantir/
```

## package/pango/Config.in
```kconfig
config ADK_PACKAGE_PANGO
	prompt "pango............................. Pango library"
	tristate
	default n
	help
```

## package/parprouted/Config.in
```kconfig
config ADK_PACKAGE_PARPROUTED
	prompt "parprouted........................ Proxy ARP daemon"
	tristate
	default n
	help
	  parprouted is a daemon for transparent IP (Layer 3) proxy ARP bridging.
	  This is useful for creation of transparent firewalls and bridging networks 
	  with different MAC protocols. Also, unlike standard bridging, proxy ARP 
	  bridging allows to bridge Ethernet networks behind wireless nodes without 
	  using WDS or layer 2 bridging.
	  
	  http://www.hazard.maks.net/
```

## package/parted/Config.in
```kconfig
config ADK_PACKAGE_PARTED
	prompt "parted............................ GNU parted"
	tristate
	default n
	select ADK_PACKAGE_LIBUUID
	select ADK_PACKAGE_DEVICE_MAPPER
	select ADK_PACKAGE_LIBREADLINE
	help
	  GNU parted.
```

## package/patch/Config.in
```kconfig
config ADK_PACKAGE_PATCH
	prompt "patch............................. patch"
	tristate
	default n
	help
	  patch
```

## package/pciutils/Config.in
```kconfig
config ADK_PACKAGE_PCIUTILS
	prompt "pciutils.......................... Linux PCI Utilities"
	tristate
	select ADK_PACKAGE_ZLIB
	default n
	help
	  This package contains various utilities for inspecting and setting of
	  devices connected to the PCI bus.
```

## package/pcre/Config.in
```kconfig
config ADK_COMPILE_PCRE
	tristate
	default n
	depends on ADK_PACKAGE_LIBPCRE

config ADK_PACKAGE_LIBPCRE
	prompt "libpcre........................... A Perl Compatible Regular Expression library"
	tristate
	default n
	select ADK_COMPILE_PCRE
	help
	  A Perl Compatible Regular Expression library
	  
	  http://www.pcre.org/
```

## package/perl/Config.in
```kconfig
config ADK_PACKAGE_PERL
	prompt "perl.............................. A full blown perl"
	tristate
	depends on ADK_NATIVE
	default n
	help
	  Complete Perl.
```

## package/php/Config.in
```kconfig
menu "php.............................. PHP Hypertext preprocessor"

config ADK_COMPILE_PHP
	prompt "php.............................. PHP Hypertext preprocessor"
	bool
	default n
	 
choice
prompt "PHP Mode"
default ADK_PACKAGE_PHP_FASTCGI
depends on ADK_COMPILE_PHP
config ADK_PACKAGE_PHP_FASTCGI
	prompt "PHP built for FastCGI"
	bool 
	select ADK_PACKAGE_LIBOPENSSL
	select ADK_PACKAGE_ZLIB
	help
	 PHP is a widely-used general-purpose scripting language that is especially 
	 suited for Web development and can be embedded into HTML.
	 
	 http://www.php.net/

endchoice

config ADK_PACKAGE_PHP_MOD_CURL
	prompt "php-mod-curl..................... cURL module"
	tristate 
	default n
	depends ADK_COMPILE_PHP
	select ADK_PACKAGE_LIBCURL

config ADK_PACKAGE_PHP_MOD_FTP
	prompt "php-mod-ftp...................... FTP module"
	tristate 
	default n
	depends ADK_COMPILE_PHP

config ADK_PACKAGE_PHP_MOD_GD
	prompt "php-mod-gd....................... GD graphics library module"
	tristate 
	default n
	depends ADK_COMPILE_PHP
	select ADK_PACKAGE_LIBGD
	select ADK_PACKAGE_LIBPNG

config ADK_PACKAGE_PHP_MOD_GMP
	prompt "php-mod-gmp...................... GMP module"
	tristate 
	default n
	depends ADK_COMPILE_PHP
	select ADK_PACKAGE_LIBGMP

config ADK_PACKAGE_PHP_MOD_LDAP
	prompt "php-mod-ldap..................... LDAP module"
	tristate 
	default n
	depends ADK_COMPILE_PHP
	select ADK_PACKAGE_LIBOPENLDAP

config ADK_PACKAGE_PHP_MOD_MYSQL
	prompt "php-mod-mysql.................... MySQL module"
	tristate 
	default n
	depends ADK_CXX
	depends ADK_COMPILE_PHP
	select ADK_PACKAGE_LIBMYSQLCLIENT

config ADK_PACKAGE_PHP_MOD_OPENSSL
	prompt "php-mod-openssl.................. OpenSSL module"
	tristate 
	default n
	depends ADK_COMPILE_PHP
	select ADK_PACKAGE_LIBOPENSSL

config ADK_PACKAGE_PHP_MOD_PCRE
	prompt "php-mod-pcre..................... PCRE module"
	tristate 
	default n
	depends ADK_COMPILE_PHP
	select ADK_PACKAGE_LIBPCRE

config ADK_PACKAGE_PHP_MOD_PGSQL
	prompt "php-mod-pgsql.................... PostgreSQL module"
	tristate 
	default n
	depends ADK_COMPILE_PHP
	select ADK_PACKAGE_LIBPQ

config ADK_PACKAGE_PHP_MOD_SESSION
	prompt "php-mod-session.................. Sessions module"
	tristate 
	default n
	depends ADK_COMPILE_PHP

config ADK_PACKAGE_PHP_MOD_SQLITE
	prompt "php-mod-sqlite................... SQLite module"
	tristate 
	default n
	depends ADK_COMPILE_PHP
	select ADK_PACKAGE_LIBSQLITE

config ADK_PACKAGE_PHP_MOD_SOCKETS
	prompt "php-mod-sockets.................. Sockets module"
	tristate 
	default n
	depends ADK_COMPILE_PHP

config ADK_PACKAGE_PHP_MOD_XML
	prompt "php-mod-xml...................... XML module"
	tristate 
	default n
	depends ADK_COMPILE_PHP
	select ADK_PACKAGE_LIBEXPAT

endmenu
```

## package/pipacs/Config.in
```kconfig
config ADK_PACKAGE_PIPACS
	prompt "pipacs............................ UNIX socket accounting/wiewer program"
	tristate
	default n
	help
	  An UNIX socket accounting/wiewer program.
	  This is version 2.
```

## package/pixman/Config.in
```kconfig
config ADK_PACKAGE_PIXMAN
	prompt "pixman.............................. pixman library"
	tristate
	default n
	help
	  http://www.cairographics.org/
```

## package/pmacct/Config.in
```kconfig
config ADK_COMPILE_PMACCT
	tristate
	default n
	depends ADK_PACKAGE_PMACCTD || ADK_PACKAGE_PMACCT_CLIENT || ADK_PACKAGE_SFACCTD || ADK_PACKAGE_NFACCTD

config ADK_PACKAGE_PMACCTD
	prompt     "pmacctd....................... IP accounting daemon (libpcap based)"
	tristate
	default n
	help
	  An IPv4/IPv6 libpcap-based accounting and aggregation daemon

config ADK_PACKAGE_NFACCTD
	prompt     "nfacctd....................... Netflow accounting and aggregation daemon"
	tristate
	select ADK_PACKAGE_LIBPCAP
	help
	  An IPv4/IPv6 libpcap-based accounting and aggregation daemon

config ADK_PACKAGE_SFACCTD
	prompt     "sfacctd....................... sFlow accounting and aggregation daemon"
	tristate
	select ADK_PACKAGE_LIBPCAP
	help
	  An IPv4/IPv6 libpcap-based accounting and aggregation daemon

config ADK_PACKAGE_PMACCT_CLIENT
	prompt   "pmacct-client................... Command-line client to gather data from the IMT plugin"
	tristate
	default n
	help
```

## package/popt/Config.in
```kconfig
config ADK_COMPILE_POPT
	tristate
	depends ADK_PACKAGE_LIBPOPT

config ADK_PACKAGE_LIBPOPT
	prompt "libpopt........................... Command line option parsing library"
	tristate
	default n
	select ADK_COMPILE_POPT
	help
	  A command line option parsing library
	  
	  ftp://ftp.rpm.org/pub/rpm/dist/rpm-4.1.x/
```

## package/portmap/Config.in
```kconfig
config ADK_PACKAGE_PORTMAP
	prompt "portmap........................... RPC Portmapper"
	tristate
	default n
	help
	  Portmap is a server that converts RPC (Remote Procedure Call) program
	  numbers into DARPA protocol port numbers.  It must be running in order
	  to make RPC calls.  Services that use RPC include NFS and NIS.

config ADK_PACKAGE_PORTMAP_LIBWRAP
	bool "  Use tcp_wrappers"
	default n
	depends on ADK_PACKAGE_PORTMAP
	select ADK_PACKAGE_LIBWRAP
```
