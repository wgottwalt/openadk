## package/libnl/Config.in
```kconfig
config ADK_PACKAGE_LIBNL
	prompt "libnl........................... netlink library"
	tristate
	default n
	help
	  Netlink library.
```

## package/libosip2/Config.in
```kconfig
config ADK_PACKAGE_LIBOSIP2
	prompt "libosip2.......................... The GNU oSIP library"
	tristate
	default n
	select ADK_PACKAGE_LIBPTHREAD
	help
	  GNU oSIP library, a Session Initiation Protocol (SIP) implementation
	  
	  http://www.gnu.org/software/osip/
```

## package/libowfat/Config.in
```kconfig
config ADK_COMPILE_LIBOWFAT
	prompt "libowfat.......................... fefe's version of libdjb"
	tristate
	default n
```

## package/libp11/Config.in
```kconfig
config ADK_PACKAGE_LIBP11
	prompt "libp11............................ libp11"
	tristate
	default n
	select ADK_PACKAGE_LIBOPENSSL
	select ADK_PACKAGE_LIBLTDL
	help
	 libp11
```

## package/libpcap/Config.in
```kconfig
config ADK_PACKAGE_LIBPCAP
	prompt "libpcap........................... Low-level packet capture library"
	tristate
	default n
	help
	  A system-independent library for user-level network packet capture.
	  
	  http://www.tcpdump.org/
```

## package/libpciaccess/Config.in
```kconfig
config ADK_PACKAGE_LIBPCIACCESS
	prompt "libpciaccess.......................... PCI access library"
	tristate
	default n
	help
	  http://www.x.org
```

## package/libpng/Config.in
```kconfig
config ADK_PACKAGE_LIBPNG
	prompt "libpng............................ PNG (Portable Network Graphics) format files handling library"
	tristate
	default n
	select ADK_PACKAGE_ZLIB
	help
	  A library for reading/writing PNG files
	  
	  http://www.libpng.org/pub/png/libpng.html
```

## package/libpthread/Config.in
```kconfig
config ADK_PACKAGE_LIBPTHREAD
	prompt "libpthread........................ POSIX threads library"
	tristate
	default n
	help
	  POSIX threads library
```

## package/librpcsecgss/Config.in
```kconfig
config ADK_PACKAGE_LIBRPCSECGSS
	prompt "librpcsecgss...................... NFSv4 library"
	tristate
	default n
	help
```

## package/libshout/Config.in
```kconfig
config ADK_COMPILE_LIBSHOUT
	tristate
	default n
	depends on ADK_PACKAGE_LIBSHOUT

config ADK_PACKAGE_LIBSHOUT
	prompt "libshout.......................... Streaming library"
	tristate
	default n
	select ADK_COMPILE_LIBSHOUT
	select ADK_PACKAGE_LIBVORBIS
	select ADK_PACKAGE_LIBOGG
	help
	  Shoutcast streaming library.

	  http://www.icecast.org/
```

## package/libsigc++/Config.in
```kconfig
config ADK_PACKAGE_LIBSIGCXX
	prompt "libsigc++......................... Callback framework for C++"
	tristate
	depends on ADK_CXX
	default n
	help
	  Callback framework for C++

choice
prompt "C++ library to use"
depends on ADK_PACKAGE_LIBSIGCXX
default ADK_COMPILE_LIBSIGCXX_WITH_STDCXX if ADK_TARGET_LIB_GLIBC
default ADK_COMPILE_LIBSIGCXX_WITH_UCLIBCXX if ADK_TARGET_LIB_UCLIBC

config ADK_COMPILE_LIBSIGCXX_WITH_STDCXX
	bool "Standard C++ library"
	select ADK_PACKAGE_LIBSTDCXX
	help

config ADK_COMPILE_LIBSIGCXX_WITH_UCLIBCXX
	bool "Embedded uClibc++ library"
	select ADK_PACKAGE_UCLIBCXX
	depends on ADK_BROKEN
	help

endchoice
```

## package/libstdcxx/Config.in
```kconfig
config ADK_PACKAGE_LIBSTDCXX
	prompt "libstdc++......................... C++ support library"
	tristate
	default n
	help
	  C++ support library
```

## package/libtasn1/Config.in
```kconfig
config ADK_PACKAGE_LIBTASN1
	prompt "libtasn1.......................... An ASN.1 and DER structures manipulation library"
	tristate
	default n
	help
	  This is a library for Abstract Syntax Notation One (ASN.1) and
	  Distinguish Encoding Rules (DER) manipulation.

	  ftp://ftp.gnutls.org/pub/gnutls/libtasn1/
```

## package/libthread_db/Config.in
```kconfig
config ADK_PACKAGE_LIBTHREAD_DB
	prompt "libthread_db...................... POSIX threads library for Debugging"
	tristate
	default n
	help
	  POSIX threads library
```

## package/libtiff/Config.in
```kconfig
config ADK_PACKAGE_LIBTIFF
	prompt "libtiff........................... TIFF format files handling library"
	tristate
	default n
	help
	  A library for reading/writing TIFF files
	  
	  http://www.libtiff.org/
```

## package/libtirpc/Config.in
```kconfig
config ADK_PACKAGE_LIBTIRPC
	prompt "libtirpc.......................... A transport independent RPC library"
	tristate
	default n
	help
	  A transport independent RPC library
	  
	  http://libtirpc.sourceforge.net/
```

## package/libtool/Config.in
```kconfig
config ADK_COMPILE_LIBTOOL
	tristate
	depends on ADK_PACKAGE_LIBLTDL

config ADK_PACKAGE_LIBLTDL
	prompt "libltdl........................... A generic dynamic object loading library"
	tristate
	default n
	select ADK_COMPILE_LIBTOOL
	help
	  A generic dynamic object loading library.
	  
	  http://www.gnu.org/software/libtool/

config ADK_PACKAGE_LIBTOOL
	prompt "libtool........................... Libtool"
	tristate
	default n
	select ADK_COMPILE_LIBTOOL
	help
	  http://www.gnu.org/software/libtool/
```

## package/libtorrent/Config.in
```kconfig
config ADK_PACKAGE_LIBTORRENT
	prompt "libtorrent........................ bittorrent library"
	tristate
	default n
	select ADK_PACKAGE_LIBOPENSSL
	select ADK_PACKAGE_LIBSIGCXX
	help
	  http://libtorrent.rakshasa.no/

choice
prompt "C++ library to use"
depends on ADK_PACKAGE_LIBTORRENT
default ADK_COMPILE_LIBTORRENT_WITH_STDCXX if ADK_TARGET_LIB_GLIBC || ADK_TARGET_LIB_EGLIBC
default ADK_COMPILE_LIBTORRENT_WITH_UCLIBCXX if ADK_TARGET_LIB_UCLIBC

config ADK_COMPILE_LIBTORRENT_WITH_STDCXX
	bool "Standard C++ library"
	select ADK_PACKAGE_LIBSTDCXX
	help

config ADK_COMPILE_LIBTORRENT_WITH_UCLIBCXX
	bool "Embedded uClibc++ library"
	select ADK_PACKAGE_UCLIBCXX
	depends on ADK_BROKEN
	help

endchoice
```

## package/libupnp/Config.in
```kconfig
config ADK_PACKAGE_LIBUPNP
	prompt "libupnp........................... Universal Plug and Play (UPnP) SDK library"
	tristate
	default n
	help
	  The Universal Plug and Play (UPnP) SDK for Linux provides support 
	  for building UPnP-compliant control points, devices, and bridges 
	  on Linux.
	  
	  http://upnp.sourceforge.net/
	  
	  Depends: libpthread
```

## package/libusb-compat/Config.in
```kconfig
config ADK_PACKAGE_LIBUSB_COMPAT
	prompt "libusb-compat...................... A library for accessing Linux USB devices"
	tristate
	default n
	help
	  A library for accessing Linux USB devices
	  
	  http://libusb.sourceforge.net/
```

## package/libusb/Config.in
```kconfig
config ADK_PACKAGE_LIBUSB
	prompt "libusb............................ A library for accessing Linux USB devices"
	tristate
	default n
	select ADK_PACKAGE_LIBUSB_COMPAT
	help
	  A library for accessing Linux USB devices
	  
	  http://libusb.sourceforge.net/
```

## package/libvirt/Config.in
```kconfig
config ADK_PACKAGE_LIBVIRT
	prompt "libvirt........................... virtualization API"
	tristate
	select ADK_PACKAGE_PYTHON
	select ADK_PACKAGE_LIBXML2
	select ADK_PACKAGE_LIBGNUTLS
	select ADK_PACKAGE_BRIDGE_UTILS
	depends on !ADK_HOST_FREEBSD
	default n
	help
	  http://www.libvirt.org
```

## package/libvorbis/Config.in
```kconfig
config ADK_PACKAGE_LIBVORBIS
	prompt "libvorbis......................... The Vorbis General Audio Compression Codec library"
	tristate
	default n
	select ADK_PACKAGE_LIBOGG
	help
	  The Vorbis General Audio Compression Codec library.
	  
	  http://www.vorbis.com/

config ADK_PACKAGE_LIBVORBISENC
	prompt "libvorbisenc...................... The Vorbis General Audio Compression Codec library"
	tristate
	default n
	select ADK_PACKAGE_LIBVORBIS
	help
	  The Vorbis General Audio Compression Codec library.
	  This is the encoding part, needed f.e. for mpd shout support. 
	  http://www.vorbis.com/
```

## package/libvorbisidec/Config.in
```kconfig
config ADK_PACKAGE_LIBVORBISIDEC
	prompt "libvorbisidec..................... A fixed-point implementation (Tremor) of libogg/libvorbis"
	tristate
	default n
	help
	  libvorbisidec is "tremor", a fixed-point implementation of libvorbis.
	  It also has libogg built-in. It is suitable as a replacement for 
	  libvorbis and libogg in tremor-aware applications.
	  Tremor is a decoder only.
	  
	  http://http://wiki.xiph.org/index.php/Tremor
```

## package/libxkbfile/Config.in
```kconfig
config ADK_PACKAGE_LIBXKBFILE
	prompt "libxkbfile........................... X keyboard library"
	tristate
	default n
	help
         http://www.x.org
```
