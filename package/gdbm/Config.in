## package/gdbm/Config.in
```kconfig
config ADK_PACKAGE_LIBGDBM
	prompt "libgdbm........................... The GNU database manager"
	tristate
	default n
	help
	  disk file format database which stores key/data-pairs in single files.  
	  
	  http://www.gnu.org
```

## package/gdbserver/Config.in
```kconfig
config ADK_PACKAGE_GDBSERVER
	prompt "gdbserver......................... Remote Server for the GNU Debugger"
	tristate
	select ADK_PACKAGE_LIBTHREAD_DB
	default n
	help
	  GDBSERVER is a program that allows you to run GDB on a different machine
	  than the one which is running the program being debugged.
```

## package/gettext/Config.in
```kconfig
config ADK_PACKAGE_GETTEXT
	prompt "gettext........................... internationalisation library"
	tristate
	default n
	help 
	  GNU gettext
```

## package/git/Config.in
```kconfig
config ADK_PACKAGE_GIT
	prompt "git............................... fast version control system"
	tristate
	select ADK_PACKAGE_LIBOPENSSL
	select ADK_PACKAGE_LIBCURL
	select ADK_PACKAGE_LIBEXPAT
	default n
	help
	  Fast version control system.
```

## package/gkrellmd/Config.in
```kconfig
config ADK_PACKAGE_GKRELLMD
	prompt "gkrellmd.......................... The GNU Krell Monitors Server"
	tristate
	default n
	select ADK_PACKAGE_GLIB2
	help
	  Gkrellmd Listens for connections from gkrellm clients. When a gkrellm
	  client connects to a gkrellmd server all builtin monitors collect
	  their data from the server.
```

## package/glib/Config.in
```kconfig
config ADK_PACKAGE_GLIB
	prompt "glib.............................. low-level core library that forms the basis of GTK+"
	tristate
	select ADK_PACKAGE_LIBPTHREAD
	select ADK_PACKAGE_LIBICONV
	select ADK_PACKAGE_GETTEXT
	default n
	help
```

## package/glib2/Config.in
```kconfig
config ADK_PACKAGE_GLIB2
	prompt "glib2............................. some broken toolkit"
	tristate
	default n
	select ADK_PACKAGE_LIBPTHREAD
	select ADK_PACKAGE_LIBICONV
	select ADK_PACKAGE_GETTEXT
```

## package/glibc/Config.in
```kconfig
config ADK_PACKAGE_GLIBC
	prompt "glibc............................... GNU C library"
	bool
	default y if ADK_TARGET_LIB_GLIBC
	default n
	depends on ADK_TARGET_LIB_GLIBC
	help
	  GNU C library.

config ADK_PACKAGE_GLIBC_DEV
	prompt "glibc-dev........................... development files"
	bool
	default n
	depends on ADK_TARGET_LIB_GLIBC
	help
	  GNU C library header files.
```

## package/gmediaserver/Config.in
```kconfig
config ADK_PACKAGE_GMEDIASERVER
	prompt "gmediaserver...................... An UPnP music media server"
	tristate
	default n
	depends on ADK_CXX
	select ADK_PACKAGE_ID3LIB
	select ADK_PACKAGE_LIBUPNP
	help
	  An UPnP music media server.

	  http://www.nongnu.org/gmediaserver/

	  Depends: id3lib, libupnp
```

## package/gmp/Config.in
```kconfig
config ADK_COMPILE_GMP
	tristate
	default n
	depends ADK_PACKAGE_LIBGMP

config ADK_PACKAGE_LIBGMP
	prompt "libgmp............................ GNU multiprecision arithmetic library"
	tristate
	default n
	select ADK_COMPILE_GMP
	help
	  GNU multiprecision arithmetic library

	  http://www.swox.com/gmp/
```

## package/gnutls/Config.in
```kconfig
config ADK_COMPILE_GNUTLS
	tristate
	default n
	depends on ADK_PACKAGE_LIBGNUTLS

config ADK_PACKAGE_LIBGNUTLS
	prompt "libgnutls......................... The GNU TLS library"
	tristate
	default n
	select ADK_COMPILE_GNUTLS
	select ADK_PACKAGE_LIBGCRYPT
	select ADK_PACKAGE_LIBTASN1
	select ADK_PACKAGE_ZLIB
	help
	  GnuTLS is a project that aims to develop a library which provides a
	  secure layer, over a reliable transport layer. Currently the GnuTLS
	  library implements the proposed standards by the IETF's TLS working
	  group.

	  Quoting from RFC2246 - the TLS 1.0 protocol specification:

	  "The TLS protocol provides communications privacy over the Internet.
	   The protocol allows client/server applications to communicate in a
	   way that is designed to prevent eavesdropping, tampering, or message
	   forgery."

	  Features
	    * Support for TLS 1.1 and SSL 3.0 protocols
	    * Support for TLS extensions
	    * Support for authentication using the SRP protocol
	    * Support for authentication using both X.509 certificates
	    * and OpenPGP keys Support for X.509 and OpenPGP certificate handling.
	    * Supports all the strong encryption algorithms

	  http://www.gnu.org/software/gnutls/

	  This packages contains the core GnuTLS shared library,
	  needed by other programs.

config ADK_PACKAGE_LIBGNUTLS_EXTRA
	prompt "libgnutls-extra................... The GNU TLS extra library"
	tristate
	default n
	depends on ADK_PACKAGE_LIBGNUTLS
	select ADK_PACKAGE_LIBOPENCDK
	select ADK_PACKAGE_LIBLZO
	help
	  GnuTLS is a project that aims to develop a library which provides a
	  secure layer, over a reliable transport layer. Currently the GnuTLS
	  library implements the proposed standards by the IETF's TLS working
	  group.

	  This packages contains the optional "extra" GnuTLS shared
	  library, needed by other programs, which contains OpenPGP,
	  TLS/IA and LZO2 compression.

config ADK_PACKAGE_LIBGNUTLS_OPENSSL
	prompt "libgnutls-openssl................. The GNU TLS OpenSSL compatibility layer library"
	tristate
	default n
	depends on ADK_PACKAGE_LIBGNUTLS
	help
	  GnuTLS is a project that aims to develop a library which provides a
	  secure layer, over a reliable transport layer. Currently the GnuTLS
	  library implements the proposed standards by the IETF's TLS working
	  group.

	  This packages contains the GnuTLS OpenSSL compatibility
	  layer shared library.

config ADK_PACKAGE_GNUTLS_UTILS
	prompt "gnutls-utils...................... The GNU TLS utilities"
	tristate
	default n
	depends on ADK_PACKAGE_LIBGNUTLS
	select ADK_PACKAGE_LIBGNUTLS_EXTRA
	help
	  GnuTLS is a project that aims to develop a library which provides a
	  secure layer, over a reliable transport layer. Currently the GnuTLS
	  library implements the proposed standards by the IETF's TLS working
	  group.

	  This packages contains some GnuTLS command line utilities.
```

## package/gperf/Config.in
```kconfig
config ADK_PACKAGE_GPERF
	prompt "gperf............................. perfect hash function generator"
	tristate
	default n
	select ADK_PACKAGE_LIBSTDCXX
	help
	  http://www.gnu.org/software/gperf/
```

## package/gpg/Config.in
```kconfig
config ADK_PACKAGE_GPG
	prompt "gpg .............................. Gnu Privacy Guard"
	tristate
	default n
        select ADK_PACKAGE_LIBREADLINE
	help
	  GPG is an encryption program

	  http://www.gnupg.org
```

## package/gpm/Config.in
```kconfig
config ADK_PACKAGE_GPM
	prompt "gpm .............................. GPM"
	tristate
	default n
	help
	  http://unix.schottelius.org/gpm/
```

## package/gpsd/Config.in
```kconfig
config ADK_PACKAGE_GPSD
	prompt "gpsd.............................. An interface daemon for GPS receivers"
	tristate
	default n
	depends on ADK_CXX
	select ADK_PACKAGE_LIBPTHREAD
	help
	  gpsd is a monitor daemon that watches a TCP/IP port (2947 by default),
	  waiting for applications to request information from GPSes or
	  differential-GPS radios attached to the host machine. Each GPS or
	  radio is expected to be direct-connected to the host via a USB or
	  RS232C serial port. The port may be specified to gpsd at startup, or
	  it may be set via a command shipped down a local control socket (e.g.
	  by a USB hotplug script). Given a GPS device by either means, gpsd
	  discovers the correct port speed and protocol for it.

	  http://gpsd.berlios.de/

config ADK_PACKAGE_GPSD_CLIENTS
	prompt   "gpsd-clients.................... cgps and gpxlogger"
	tristate
	default y
	depends on ADK_PACKAGE_GPSD
	help
	  This enables the command-line GPS client "cgps" and
	  the "gpxlogger" tool for outputting standard GPX files.

choice
prompt "C++ library to use"
depends on ADK_PACKAGE_GPSD
default ADK_COMPILE_GPSD_WITH_STDCXX if ADK_TARGET_LIB_GLIBC
default ADK_COMPILE_GPSD_WITH_UCLIBCXX if ADK_TARGET_LIB_UCLIBC

config ADK_COMPILE_GPSD_WITH_STDCXX
	bool "Standard C++ library"
	select ADK_PACKAGE_LIBSTDCXX
	help

config ADK_COMPILE_GPSD_WITH_UCLIBCXX
	bool "Embedded uClibc++ library"
	select ADK_PACKAGE_UCLIBCXX
	help

endchoice
```

## package/grub-bin/Config.in
```kconfig
config ADK_PACKAGE_GRUB_BIN
	prompt "grub-bin............................. GRUB 2 bootloader (binary)"
	tristate
	depends on \
		ADK_LINUX_X86_64_SHUTTLE || \
		ADK_LINUX_X86_WRAP || \
		ADK_LINUX_X86_ALIX1C || \
		ADK_LINUX_X86_ALIX2D
	select BUSYBOX_FEATURE_STAT_FORMAT
	default y if ADK_LINUX_X86_64_SHUTTLE
	default y if ADK_LINUX_X86_ALIX1C
	default y if ADK_LINUX_X86_ALIX2D
	default y if ADK_LINUX_X86_WRAP
	help
```

## package/grub/Config.in
```kconfig
config ADK_PACKAGE_GRUB
	prompt "grub................................. GRUB"
	tristate
	default n
	help
	  http://www.grub.org
```

## package/gtk+/Config.in
```kconfig
config ADK_PACKAGE_GTK
	prompt "gtk+.............................. GTK+ library"
	tristate
	select ADK_PACKAGE_GLIB
	default n
	help
```

## package/haserl/Config.in
```kconfig
config ADK_PACKAGE_HASERL
	prompt "haserl............................ A CGI wrapper to embed shell scripts in HTML documents"
	tristate
	default n
	help
	  A CGI wrapper to embed shell scripts in HTML documents.
	  
	  http://haserl.sourceforge.net/
```

## package/hdparm/Config.in
```kconfig
config ADK_PACKAGE_HDPARM
	prompt "hdparm............................ get/set ATA drive parameters"
	tristate
	default n
	help

	  tune hard disk parameters for high performance
	  Get/set hard disk parameters for Linux IDE drives.
	  Primary use is for enabling irq-unmasking and IDE multiplemode.

	  The original website:
	  http://sourceforge.net/projects/hdparm/
```

## package/heimdal/Config.in
```kconfig
config ADK_COMPILE_HEIMDAL
	prompt "heimdal........................... Heimdal kerberos software"
	bool
	default n

config ADK_COMPILE_HEIMDAL_WITH_PKINIT
	prompt "Enable PK-INIT"
	bool
	depends on ADK_COMPILE_HEIMDAL
	default n

config ADK_PACKAGE_HEIMDAL_SERVER
	prompt "heimdal-server.................... heimdal kerberos server"
	tristate
	depends on ADK_COMPILE_HEIMDAL
	select ADK_PACKAGE_LIBCOM_ERR
	select ADK_PACKAGE_LIBPTHREAD
	select ADK_PACKAGE_LIBOPENSSL
	select ADK_PACKAGE_LIBNCURSES
	select ADK_PACKAGE_HEIMDAL_LIBS
	select ADK_PACKAGE_HEIMDAL_CLIENT_LIBS
	default n
	help
	  http://www.h5l.org

choice
prompt "Database backend"
depends on ADK_PACKAGE_HEIMDAL_SERVER
default ADK_COMPILE_HEIMDAL_WITH_DB_BDB

config ADK_COMPILE_HEIMDAL_WITH_DB_BDB
	bool "Berkeley DB backend"
	select ADK_PACKAGE_LIBDB
	help
	  Use Oracle Berkeley DB as kerberos database backend.

config ADK_COMPILE_HEIMDAL_WITH_DB_LDAP
	bool "LDAP backend"
	select ADK_PACKAGE_LIBOPENLDAP
	help
	  Use OpenLDAP as kerberos database backend.
	  (Useful for SSO setup)

endchoice

config ADK_PACKAGE_HEIMDAL_LIBS
	prompt "heimdal-libs...................... heimdal kerberos libraries"
	tristate
	depends on ADK_COMPILE_HEIMDAL
	select ADK_PACKAGE_LIBPTHREAD
	select ADK_PACKAGE_LIBOPENSSL
	default n
	help
	  http://www.h5l.org

config ADK_PACKAGE_HEIMDAL_CLIENT_LIBS
	prompt "heimdal-client-libs............... heimdal kerberos client libraries"
	tristate
	depends on ADK_COMPILE_HEIMDAL
	select ADK_PACKAGE_LIBPTHREAD
	select ADK_PACKAGE_LIBOPENSSL
	default n
	help
	  http://www.h5l.org
```

## package/heyu/Config.in
```kconfig
config ADK_PACKAGE_HEYU
	prompt "heyu.............................. X10 home automation control using a CM11A"
	tristate
	default n
	help
	  X10 home automation control using the CM11A serial device.

          See http://heyu.tanj.com/heyu2/ for details.
```

## package/hostapd/Config.in
```kconfig
config ADK_COMPILE_HOSTAPD
	tristate
	default n
	depends on ADK_PACKAGE_HOSTAPD || ADK_PACKAGE_HOSTAPD_UTILS

config ADK_PACKAGE_HOSTAPD
	prompt "hostapd........................... An IEEE 802.11 AP, IEEE 802.1x/WPA/WPA2/EAP/RADIUS Authenticator"
	tristate
	default n
	select ADK_COMPILE_HOSTAPD
	select ADK_PACKAGE_LIBOPENSSL
	select ADK_PACKAGE_LIBNL
	help

	  hostapd is a user space daemon for access point and
	  authentication servers. It implements IEEE 802.11 access point
	  management, IEEE 802.1X/WPA/WPA2/EAP Authenticators, RADIUS
	  client, EAP server, and RADIUS authentication server.

	  http://hostap.epitest.fi/hostapd/

	  Includes:
	   - hostapd

config ADK_PACKAGE_HOSTAPD_UTILS
	prompt "hostapd-utils..................... An IEEE 802.11 AP, IEEE 802.1x/WPA/WPA2/EAP/RADIUS Authenticator (CLI utility)"
	tristate
	default n
	select ADK_COMPILE_HOSTAPD
	depends on ADK_PACKAGE_HOSTAPD
	help

	  hostapd is a user space daemon for access point and
	  authentication servers. It implements IEEE 802.11 access point
	  management, IEEE 802.1X/WPA/WPA2/EAP Authenticators, RADIUS
	  client, EAP server, and RADIUS authentication server.

	  http://hostap.epitest.fi/hostapd/

	  Includes:
	   - hostapd_cli
```

## package/htpdate/Config.in
```kconfig
config ADK_PACKAGE_HTPDATE
	prompt "htpdate........................... HTP (Hypertext Time Protocol) implementation"
	tristate
	default n
	help
	  An HTP (Hypertext Time Protocol) implementation

	  http://www.clevervest.com/htp/
```

## package/httping/Config.in
```kconfig
config ADK_PACKAGE_HTTPING
	prompt "httping........................... Httping is like 'ping' but for http-requests."
	tristate
	default n
	help
		Httping is like 'ping' but for http-requests.
		Give it an url, and it'll show you how long it takes to connect, send a
		request and retrieve the reply (only the headers). Be aware that the
		transmission across the network also takes time!

		http://www.vanheusden.com/httping/
```
