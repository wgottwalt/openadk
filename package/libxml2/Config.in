## package/libxml2/Config.in
```kconfig
config ADK_PACKAGE_LIBXML2
	prompt "libxml2........................... Gnome XML library"
	tristate
	default n
	select ADK_PACKAGE_LIBPTHREAD
	select ADK_PACKAGE_ZLIB
	help
	  A library for manipulating XML and HTML resources.
	  
	  http://xmlsoft.org/
```

## package/libxslt/Config.in
```kconfig
config ADK_PACKAGE_LIBXSLT
	prompt "libxslt........................... Gnome XSLT library"
	tristate
	default n
	select ADK_PACKAGE_LIBXML2
	help
	  A library for XML transformation using XSLT.
	  
	  http://xmlsoft.org/XSLT/
```

## package/lighttpd/Config.in
```kconfig
config ADK_PACKAGE_LIGHTTPD
	prompt "lighttpd.......................... Flexible and lightweight web server"
	tristate
	default n
	select ADK_PACKAGE_LIBPCRE
	select ADK_COMPILE_SQLITE
	select ADK_PACKAGE_LIBXML2
	help
	  A flexible and lightweight web server.
	  
	  http://www.lighttpd.net/

config ADK_COMPILE_LIGHTTPD_WITH_OPENSSL
	bool "  Use OpenSSL for https support"
	default y
	depends on ADK_PACKAGE_LIGHTTPD
	select ADK_PACKAGE_LIBOPENSSL

config ADK_PACKAGE_LIGHTTPD_MOD_ACCESSLOG
	prompt   "  lighttpd-mod-accesslog........ Access logging module"
	tristate
	default n
	depends on ADK_PACKAGE_LIGHTTPD

config ADK_PACKAGE_LIGHTTPD_MOD_ALIAS
	prompt   "  lighttpd-mod-alias............ Directory alias module"
	tristate
	default n
	depends on ADK_PACKAGE_LIGHTTPD

config ADK_PACKAGE_LIGHTTPD_MOD_AUTH
	prompt   "  lighttpd-mod-auth............. Authentication module"
	tristate
	default n
	depends on ADK_PACKAGE_LIGHTTPD

config ADK_PACKAGE_LIGHTTPD_MOD_CGI
	prompt   "  lighttpd-mod-cgi.............. CGI module"
	tristate
	default n
	depends on ADK_PACKAGE_LIGHTTPD

config ADK_PACKAGE_LIGHTTPD_MOD_EVASIVE
	prompt   "  lighttpd-mod-evasive.......... Evasive module"
	tristate
	default n
	depends on ADK_PACKAGE_LIGHTTPD

config ADK_PACKAGE_LIGHTTPD_MOD_EXPIRE
	prompt   "  lighttpd-mod-expire........... Expire module"
	tristate
	default n
	depends on ADK_PACKAGE_LIGHTTPD

config ADK_PACKAGE_LIGHTTPD_MOD_FASTCGI
	prompt   "  lighttpd-mod-fastcgi.......... FastCGI module"
	tristate
	default n
	depends on ADK_PACKAGE_LIGHTTPD

config ADK_PACKAGE_LIGHTTPD_MOD_PROXY
	prompt   "  lighttpd-mod-proxy............ Proxy module"
	tristate
	default n
	depends on ADK_PACKAGE_LIGHTTPD

config ADK_PACKAGE_LIGHTTPD_MOD_REDIRECT
	prompt   "  lighttpd-mod-redirect......... URL redirection module"
	tristate
	default n
	depends on ADK_PACKAGE_LIGHTTPD

config ADK_PACKAGE_LIGHTTPD_MOD_REWRITE
	prompt   "  lighttpd-mod-rewrite.......... URL rewriting module"
	tristate
	default n
	depends on ADK_PACKAGE_LIGHTTPD

config ADK_PACKAGE_LIGHTTPD_MOD_SETENV
	prompt   "  lighttpd-mod-setenv........... Environment variable setting module"
	tristate
	default n
	depends on ADK_PACKAGE_LIGHTTPD

config ADK_PACKAGE_LIGHTTPD_MOD_SIMPLE_VHOST
	prompt   "  lighttpd-mod-simple-vhost..... Simple virtual hosting module"
	tristate
	default n
	depends on ADK_PACKAGE_LIGHTTPD

config ADK_PACKAGE_LIGHTTPD_MOD_SSI
	prompt   "  lighttpd-mod-ssi.............. SSI module"
	tristate
	default n
	depends on ADK_PACKAGE_LIGHTTPD

config ADK_PACKAGE_LIGHTTPD_MOD_STATUS
	prompt   "  lighttpd-mod-status........... Server status display module"
	tristate
	default n
	depends on ADK_PACKAGE_LIGHTTPD

config ADK_PACKAGE_LIGHTTPD_MOD_USERTRACK
	prompt   "  lighttpd-mod-usertrack........ User tracking module"
	tristate
	default n
	depends on ADK_PACKAGE_LIGHTTPD

config ADK_PACKAGE_LIGHTTPD_MOD_WEBDAV
	prompt   "  lighttpd-mod-webdav........... webdav module"
	tristate
	default n
	depends on ADK_PACKAGE_LIGHTTPD
```

## package/links/Config.in
```kconfig
config ADK_PACKAGE_LINKS
	prompt "links............................. web browser for console"
	tristate
	select ADK_PACKAGE_LIBJPEG
	select ADK_PACKAGE_LIBPNG
	select ADK_PACKAGE_LIBOPENSSL
	select ADK_PACKAGE_GPM
	default n
	help
	  http://links.twibright.com/
```

## package/linux-atm/Config.in
```kconfig
config ADK_COMPILE_LINUX_ATM
	bool
	default n
	help
	  
config ADK_PACKAGE_BR2684CTL
	prompt "br2684ctl......................... RFC2684 bridging utility"
	tristate
	default n
	select ADK_PACKAGE_LIBATM
	select ADK_KPACKAGE_KMOD_ATM_BR2684
	select ADK_COMPILE_LINUX_ATM
	depends on !ADK_HOST_FREEBSD
	help
	  Utility for setting up ATM RFC2684 bridging mode.
	  (Useful for PPPoE)
```

## package/lrzsz/Config.in
```kconfig
config ADK_PACKAGE_LRZSZ	
	prompt "lrsz.............................. X,Y and Z-modem protocols"
	tristate
	default n
	help
		Transfer files in your login sessions.
		Very leightweight ans straight forward.
		You just need a terminal client that can do 
		either X, Y or Z-modem file transfers.

		http://www.ohse.de/uwe/software/lrzsz.html
```

## package/ltp/Config.in
```kconfig
config ADK_PACKAGE_LTP
	prompt "ltp............................... The Linux Test Project Suite (BEWARE: HUGE!!)"
	tristate
	default n
	help
	  The Linux Test Project is a joint project started by SGI and 
	  maintained by IBM, that has a goal to deliver test suites to 
	  the open source community that validate the reliability, 
	  robustness, and stability of Linux. The LTP testsuite contains 
	  a collection of tools for testing the Linux kernel and related 
	  features.

	  BEWARE: this is a very huge package, and therefore merely usable
	          from an embedded system. It will consume about 150MB!
	  
	  http://ltp.sourceforge.net/
```

## package/lvm/Config.in
```kconfig
config ADK_COMPILE_LVM
	bool
	default n
	help

config ADK_PACKAGE_LVM
	prompt "lvm............................... logical volume management"
	tristate
	select ADK_COMPILE_LVM
	default n
	help

config ADK_PACKAGE_DEVICE_MAPPER
	prompt "device-mapper..................... device-mapper"
	tristate
	select ADK_COMPILE_LVM
	default n
	help
```

## package/lynx/Config.in
```kconfig
config ADK_PACKAGE_LYNX
	prompt "lynx.............................. Standard text browser"
	tristate
	default n
	select ADK_PACKAGE_LIBNCURSES
	select ADK_PACKAGE_LIBOPENSSL
	select ADK_PACKAGE_CA_CERTS
	help
	  The standard text-based world wide web browser.
	  
	  http://lynx.isc.org/current/
```

## package/m4/Config.in
```kconfig
config ADK_PACKAGE_M4
	prompt "m4.............................. macro processor"
	tristate
	default n
	help
	  http://www.gnu.org/software/m4/
```

## package/mac80211/Config.in
```kconfig
config ADK_PACKAGE_KMOD_MAC80211
	prompt "kmod-mac80211................... mac80211 softmac (development)"
	tristate
	select ADK_MOD_KERNEL_MAC80211
	depends on !ADK_KPACKAGE_KMOD_MAC80211
	default n
	help
	  http://linuxwireless.org/

config ADK_PACKAGE_KMOD_MAC80211_ATH5K
	prompt "kmod-mac80211-ath5k............. Atheros 5xxx wireless driver"
	tristate
	depends on ADK_PACKAGE_KMOD_MAC80211
	default n
	help
	  http://linuxwireless.org/

config ADK_PACKAGE_KMOD_MAC80211_RT61
	prompt "kmod-mac80211-rt61.............. Ralink rt2501/rt61 wireless driver"
	tristate
	default n
	select ADK_KPACKAGE_KMOD_CRC_ITU_T
	select ADK_PACKAGE_WIRELESS_FIRMWARE_RT61
	depends on ADK_PACKAGE_KMOD_MAC80211
	help
	  This adds support for rt2501 wireless chipset family.
	  Supported chips: RT2561, RT2561S & RT2661.
```

## package/madplay/Config.in
```kconfig
config ADK_PACKAGE_MADPLAY
       tristate "madplay........................... MPEG audio player in fixed point"
       default n
       select ADK_PACKAGE_LIBID3TAG 
       select ADK_PACKAGE_LIBMAD
       help
         MAD is an MPEG audio decoder. It currently only supports the MPEG 1
         standard, but fully implements all three audio layers (Layer I, Layer II,
         and Layer III, the latter often colloquially known as MP3.).  There is also
         full support for ID3 tags.
```

## package/make/Config.in
```kconfig
config ADK_PACKAGE_MAKE
	prompt "make.............................. GNU make"
	tristate
	default n
	help
	  GNU make
```

## package/maradns/Config.in
```kconfig
config ADK_PACKAGE_MARADNS
	prompt "maradns........................... Small and secure DNS Server"
	tristate
	default n
	select ADK_PACKAGE_LIBPTHREAD
	help
	  A small and secure DNS server
	  
	  http://www.maradns.org/
```

## package/mc/Config.in
```kconfig
config ADK_PACKAGE_MC
	prompt "mc................................ The Midnight Commander (CUI filemanager)"
	tristate
	default n
	select ADK_PACKAGE_GLIB
	select ADK_PACKAGE_LIBNCURSES
	help
	  Clone of the widely known Norton/Volkov Commander for DOS;
	  console-mode UI file manager with many extended functions
```

## package/mdadm/Config.in
```kconfig
config ADK_PACKAGE_MDADM
	prompt "mdadm............................. tool for managing Linux Software RAID arrays"
	tristate
	default n
	help
 	  http://neil.brown.name/blog/mdadm
```

## package/mgetty/Config.in
```kconfig
config ADK_PACKAGE_MGETTY
	prompt "mgetty+sendfax.................... the data/fax solution for your analog modem"
	tristate
	default n
	help
	 mgetty now includes sendfax (and AutoPPP)
	 using pppd for data and doing fax/login by itself.
```

## package/miax/Config.in
```kconfig
config ADK_PACKAGE_MIAX
	prompt "miax.............................. A console iax (asterisk) client"
	tristate
	default n
	select ADK_PACKAGE_BLUEZ
	select ADK_PACKAGE_LIBPTHREAD
	help
	  miax is a console iax (asterisk) client, it can work with
	  a soundcard as a normal voip phone, taking input/output from
	  keyboard, analog/gsm/isdn modem or bluetooth phones.
	  
	  http://www.eja.it/?l=gpl&testo=miax
```

## package/microperl/Config.in
```kconfig
config ADK_PACKAGE_MICROPERL
	prompt "microperl......................... A really minimal perl"
	tristate
	default n
	help
	  Perl without operating-specific functions such as readdir.
```

## package/mini_httpd/Config.in
```kconfig
config ADK_COMPILE_MINI_HTTPD
	tristate
	default n
	depends ADK_PACKAGE_MINI_HTTPD || ADK_PACKAGE_MINI_HTTPD_OPENSSL

config ADK_PACKAGE_MINI_HTTPD
	prompt "mini-httpd........................ A small web server"
	tristate
	default n
	select ADK_COMPILE_MINI_HTTPD
	help
	  mini_httpd is a small HTTP server. Its performance is not great, but for
	  low or medium traffic sites it's quite adequate. It implements all the
	  basic features of an HTTP server, including:
	  
	     * GET, HEAD, and POST methods.
	     * CGI.
	     * Basic authentication.
	     * Security against ".." filename snooping.
	     * The common MIME types.
	     * Trailing-slash redirection.
	     * index.html, index.htm, index.cgi
	     * Directory listings.
	     * Multihoming / virtual hosting.
	     * Standard logging.
	     * Custom error pages.
	  
	  It can also be configured to do IPv6.
	  
	  http://www.acme.com/software/mini_httpd/

config ADK_PACKAGE_MINI_HTTPD_HTPASSWD
	prompt "mini-httpd-htpasswd............... Utility to generate HTTP access files"
	tristate
	default n
	select ADK_PACKAGE_MINI_HTTPD
	help
		This file generates .htaccess/.htpasswd files to use HTTP access		authentication


config ADK_PACKAGE_MINI_HTTPD_OPENSSL
	prompt "mini-httpd-openssl................ A small web server, built with SSL support using OpenSSL"
	tristate
	default n
	select ADK_COMPILE_MINI_HTTPD
	select ADK_PACKAGE_LIBOPENSSL
	help
	  mini_httpd is a small HTTP server. Its performance is not great, but for
	  low or medium traffic sites it's quite adequate. It implements all the
	  basic features of an HTTP server, including:
	  
	     * GET, HEAD, and POST methods.
	     * CGI.
	     * Basic authentication.
	     * Security against ".." filename snooping.
	     * The common MIME types.
	     * Trailing-slash redirection.
	     * index.html, index.htm, index.cgi
	     * Directory listings.
	     * Multihoming / virtual hosting.
	     * Standard logging.
	     * Custom error pages.
	  
	  It can also be configured to do SSL/HTTPS and IPv6.
	  
	  http://www.acme.com/software/mini_httpd/
```

## package/miredo/Config.in
```kconfig
config ADK_COMPILE_MIREDO
	tristate
	default n
	depends on ADK_PACKAGE_MIREDO || ADK_PACKAGE_MIREDO_SERVER

config ADK_PACKAGE_MIREDO
	prompt "miredo............................ Teredo (IPv6 tunneling over UDP through NAT) client and relay daemon"
	tristate
	default n
	select ADK_COMPILE_MIREDO
	select ADK_KPACKAGE_KMOD_IPV6
	select ADK_KPACKAGE_KMOD_TUN
	select ADK_PACKAGE_LIBPTHREAD
	help
	  A Teredo (IPv6 tunneling over UDP through NAT) client and relay daemon.
	  http://www.simphalempin.com/dev/miredo/

config ADK_PACKAGE_MIREDO_SERVER
	prompt "miredo-server..................... Teredo (IPv6 tunneling over UDP through NAT) server daemon"
	tristate
	default n
	select ADK_COMPILE_MIREDO
	select ADK_KPACKAGE_KMOD_IPV6
	select ADK_KPACKAGE_KMOD_TUN
	select ADK_PACKAGE_LIBPTHREAD
	help
	  A Teredo (IPv6 tunneling over UDP through NAT) server daemon.
	  
	  http://www.simphalempin.com/dev/miredo/
```

## package/mksh/Config.in
```kconfig
config ADK_PACKAGE_MKSH
	prompt "mksh................................. The MirBSD enhanced Korn Shell"
	tristate
	default n
	help
	  mksh is the MirBSD enhanced version of the Public Domain Korn
	  shell (pdksh), a bourne-compatible shell which is largely si-
	  milar to the original AT&T Korn shell.  It includes bug fixes
	  and feature improvements in order to produce a modern, robust
	  shell good for interactive and especially script use.  It has
	  UTF-8 support in the emacs command line editing mode; corres-
	  ponds to OpenBSD 4.4-beta ksh without GNU bash-like $PS1; the
	  build environment requirements are autoconfigured; throughout
	  code simplification/bugfix/enhancement has been done, and the
	  shell has extended compatibility to other modern shells.

	  This package also installs mksh as /bin/ash and /bin/sh (i.e.
	  the default Bourne/POSIX shell) and creates a ~/.mkshrc file,
	  which can be used to further customise the look and feel.

	  http://mirbsd.de/mksh

config ADK_PACKAGE_MKSH_FULL
	bool "  Include all features"
	depends ADK_PACKAGE_MKSH
	default y
	help
	  Disable this to remove a few functions from mksh to make it smaller.
	  Ideal for embedded systems. However, be aware you will lose some
	  functionality you'd otherwise expect, among these is the vi command
	  line editing mode.
```

## package/moc/Config.in
```kconfig
config ADK_PACKAGE_MOC
	tristate "moc................................ console audio player"
	default n
	select ADK_PACKAGE_LIBVORBIS
	select ADK_PACKAGE_LIBMAD
	select ADK_PACKAGE_LIBCURL
	select ADK_PACKAGE_LIBFLAC
	select ADK_PACKAGE_FFMPEG
	help
  	  console audio player
	  Supports mp3, ogg, wav, mp4, flac and stream audio formats.
	  http://moc.daper.net/   
```

## package/monit/Config.in
```kconfig
config ADK_PACKAGE_MONIT
	prompt "monit............................. System services monitoring utility"
	tristate
	select ADK_PACKAGE_LIBPTHREAD
	default n
	help
	  An utility for monitoring services on a Unix system
	  http://www.tildeslash.com/monit/

config ADK_COMPILE_MONIT_WITH_SSL
	prompt "Compile with SSL support"
	tristate
	select ADK_PACKAGE_LIBOPENSSL
	depends on ADK_PACKAGE_MONIT
	default n
	help
	  Enable SSL
```

## package/motion/Config.in
```kconfig
config ADK_PACKAGE_MOTION
	prompt "motion............................ webcam motion sensing and logging"
	tristate
	default n
	select ADK_PACKAGE_LIBJPEG
	select ADK_PACKAGE_LIBPTHREAD
	help
	  Motion is a software motion detector

	  http://www.lavrsen.dk/twiki/bin/view/Motion/WebHome
```
