## package/libXaw/Config.in
```kconfig
config ADK_PACKAGE_LIBXAW
	prompt "libXaw............................... X11 Athena Widget library"
	tristate
	default n
	help
         http://www.x.org
```

## package/libXdmcp/Config.in
```kconfig
config ADK_PACKAGE_LIBXDMCP
	prompt "libXdmcp............................. X11 display manager control protocol library"
	tristate
	default n
	help
         http://www.x.org
```

## package/libXext/Config.in
```kconfig
config ADK_PACKAGE_LIBXEXT
	prompt "libXext.............................. X client interface to extensions of the X protocol"
	tristate
	default n
	help
         http://www.x.org
```

## package/libXfont/Config.in
```kconfig
config ADK_PACKAGE_LIBXFONT
	prompt "libxfont................................ X font library"
	tristate
	default n
	select ADK_PACKAGE_LIBFREETYPE
	help
         http://www.x.org
```

## package/libXmu/Config.in
```kconfig
config ADK_PACKAGE_LIBXMU
	prompt "libXmu............................... miscellaneous utility functions for X libraries"
	tristate
	default n
	help
         http://www.x.org
```

## package/libXpm/Config.in
```kconfig
config ADK_PACKAGE_LIBXPM
	prompt "libXpm............................... common operation for the XPM pixmap format"
	tristate
	default n
	help
         http://www.x.org
```

## package/libXrender/Config.in
```kconfig
config ADK_PACKAGE_LIBXAU
	prompt "libXau............................... X11 authorisation library"
	tristate
	default n
	help
         http://www.x.org
```

## package/libXt/Config.in
```kconfig
config ADK_PACKAGE_LIBXT
	prompt "libXt................................ X Toolkit Intrinsics"
	tristate
	default n
	help
         http://www.x.org
```

## package/libXv/Config.in
```kconfig
config ADK_PACKAGE_LIBXV
	prompt "libXv................................ X11 Xvideo extensions"
	tristate
	default n
	help
         http://www.x.org
```

## package/libXxf86dga/Config.in
```kconfig
config ADK_PACKAGE_LIBXXF86DGA
	prompt "libXxf86dga.......................... client library for the XFree86-DGA extension"
	tristate
	default n
	help
         http://www.x.org
```

## package/libao/Config.in
```kconfig
config ADK_PACKAGE_LIBAO
	prompt "libao............................. A cross platform audio library"
	tristate
	default n
	help
	  Libao is a cross-platform audio library that allows programs to 
	  output audio using a simple API on a wide variety of platforms. 
	  
	  http://www.xiph.org/ao/
```

## package/libc/Config.in
```kconfig
config ADK_PACKAGE_LIBC
	prompt "libc............................... native C library"
	tristate
	default y if ADK_NATIVE
	default n
	depends on ADK_NATIVE
	help
	  C library.
```

## package/libdb/Config.in
```kconfig
config ADK_COMPILE_DB
	tristate
	default n
	depends ADK_PACKAGE_LIBDB

config ADK_PACKAGE_LIBDB
	prompt "libdb............................. Berkeley DB"
	tristate
	default n
	select ADK_COMPILE_DB
	help
	  disk file format database which stores key/data-pairs in single files.  
	  
	  http://www.sleepycat.com/products/db.shtml
```

## package/libdnet/Config.in
```kconfig
config ADK_PACKAGE_LIBDNET
	prompt "libdnet........................... Low-level network library"
	tristate
	default n
	help
	  simplified, portable interface to several low-level networking routines
	  
	  http://sourceforge.net/projects/libdnet/
```

## package/libelf/Config.in
```kconfig
config ADK_PACKAGE_LIBELF
	prompt "libelf............................ ELF object file access library"
	tristate
	default n
	help
	  This is the public release of libelf-0.8.5, a free ELF object
	  file access library.
	  
	  http://www.stud.uni-hannover.de/~michael/software/
```

## package/libfontenc/Config.in
```kconfig
config ADK_PACKAGE_LIBFONTENC
	prompt "libfontenc.............................. X font encoding library"
	tristate
	select ADK_PACKAGE_XPROTO
	select ADK_PACKAGE_ZLIB
	default n
	help
         http://www.x.org
```

## package/libgd/Config.in
```kconfig
config ADK_PACKAGE_LIBGD
	prompt "libgd............................. The GD Graphics Library"
	tristate
	default n
	select ADK_PACKAGE_LIBJPEG
	select ADK_PACKAGE_LIBPNG
	help
	  The GD Graphics Library
	  
	  http://www.libgd.org/
```

## package/libgpg-error/Config.in
```kconfig
config ADK_PACKAGE_LIBGPG_ERROR
	prompt "libgpg-error...................... An helper library for common error codes and descriptions"
	tristate
	default n
	help
	  This is a library that defines common error values for all GnuPG
	  components.  Among these are GPG, GPGSM, GPGME, GPG-Agent, libgcrypt,
	  Libksba, DirMngr, Pinentry, SmartCard Daemon and possibly more in the
	  future.
	  
	  http://www.gnupg.org/related_software/libgpg-error/
```

## package/libgssglue/Config.in
```kconfig
config ADK_PACKAGE_LIBGSSGLUE
	prompt "libgssglue........................ NFSv4 GSSAPI helper library"
	tristate
	default n
	help
```

## package/libiconv/Config.in
```kconfig
config ADK_PACKAGE_LIBICONV
	prompt "libiconv.......................... character set conversion library"
	tristate
	default n
	help

	  This package contains a _very_ stripped down version of GNU Libiconv,
	  all charsets have been removed, except ASCII, various unicode charsets
	  and iso8896-1.
	  
	  The original website:
	  http://www.gnu.org/software/libiconv/
```

## package/liblzo/Config.in
```kconfig
config ADK_PACKAGE_LIBLZO
	prompt "liblzo............................ Real-time data compression library"
	tristate
	default n
	help
	  A real-time data compression library
	  
	  http://www.oberhumer.com/opensource/lzo/
```

## package/libmms/Config.in
```kconfig
config ADK_PACKAGE_LIBMMS
	prompt "libmms........................... common library for parsing mms:// and mmsh:// type network streams"
	tristate
	default n
	help
          http://launchpad.net/libmms/
```

## package/libnet/Config.in
```kconfig
config ADK_PACKAGE_LIBNET
	prompt "libnet............................ Low-level packet creation library"
	tristate
	default n
	select ADK_PACKAGE_LIBPCAP
	help
	  A low-level packet creation library.
	  
	  http://www.packetfactory.net/libnet/
	  
	  Depends: libpcap
```

## package/libnfsidmap/Config.in
```kconfig
config ADK_PACKAGE_LIBNFSIDMAP
	prompt "libnfsidmap....................... NFSv4 library"
	tristate
	default n
	help
```

## package/libnids/Config.in
```kconfig
config ADK_PACKAGE_LIBNIDS
	prompt "libnids........................... A network intrusion detection library"
	tristate
	select ADK_PACKAGE_LIBPCAP
	select ADK_PACKAGE_LIBNET
	default n
	help
	  An implementation of an E-component of Network Intrusion Detection System.
	  
	  http://www.packetfactory.net/projects/libnids/
```
