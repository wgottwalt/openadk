## package/cxxtools/Config.in
```kconfig
config ADK_PACKAGE_CXXTOOLS
	prompt "cxxtools.......................... cxxtools"
	tristate
	default n
	depends on ADK_CXX
	select ADK_PACKAGE_LIBICONV
	help
	  http://www.tntnet.org

choice
prompt "C++ library to use"
depends on ADK_PACKAGE_CXXTOOLS
default ADK_COMPILE_CXXTOOLS_WITH_STDCXX if ADK_TARGET_LIB_GLIBC || ADK_TARGET_LIB_EGLIBC
default ADK_COMPILE_CXXTOOLS_WITH_UCLIBCXX if ADK_TARGET_LIB_UCLIBC

config ADK_COMPILE_CXXTOOLS_WITH_STDCXX
	bool "Standard C++ library"
	select ADK_PACKAGE_LIBSTDCXX
	help

config ADK_COMPILE_CXXTOOLS_WITH_UCLIBCXX
	bool "Embedded uClibc++ library"
	select ADK_PACKAGE_UCLIBCXX
	help

endchoice
```

## package/cyrus-sasl/Config.in
```kconfig
config ADK_COMPILE_CYRUS_SASL
	tristate
	default n
	depends ADK_PACKAGE_LIBSASL2

config ADK_PACKAGE_LIBSASL2
	prompt "libsasl2.......................... General purpose authentication library"
	tristate
	default n
	select ADK_COMPILE_CYRUS_SASL
	help
	  A general purpose authentication library.

	  http://asg.web.cmu.edu/sasl/
```

## package/damageproto/Config.in
```kconfig
config ADK_PACKAGE_DAMAGEPROTO
	prompt "damageproto............................. X protocol library"
	tristate
	default n
	help
         http://www.x.org
```

## package/dansguardian/Config.in
```kconfig
config ADK_PACKAGE_DANSGUARDIAN
	prompt "dansguardian...................... web content filter proxy"
	tristate
	depends on ADK_CXX
	select ADK_PACKAGE_LIBPCRE
	select ADK_PACKAGE_ZLIB
	default n
	help
		http://dansguardian.org

choice
prompt "C++ library to use"
depends on ADK_PACKAGE_DANSGUARDIAN
default ADK_COMPILE_DANSGUARDIAN_WITH_STDCXX if ADK_TARGET_LIB_GLIBC
default ADK_COMPILE_DANSGUARDIAN_WITH_UCLIBCXX if ADK_TARGET_LIB_UCLIBC

config ADK_COMPILE_DANSGUARDIAN_WITH_STDCXX
        bool "Standard C++ library"
        select ADK_PACKAGE_LIBSTDCXX
        help

config ADK_COMPILE_DANSGUARDIAN_WITH_UCLIBCXX
        bool "Embedded uClibc++ library"
        select ADK_PACKAGE_UCLIBCXX
        help

endchoice
```

## package/davfs2/Config.in
```kconfig
config ADK_PACKAGE_DAVFS2
	prompt "davfs2............................ WebDAV filesystem"
	tristate
	default n
	select ADK_PACKAGE_LIBICONV
	select ADK_PACKAGE_NEON
	help
	  WebDAV is an extension to HTTP that allows remote collaborative
	  authoring of Web resources, defined in RFC 2518.
	  
	  davfs2 is a Linux file system driver that allows you to mount a
	  WebDAV server as a local file system, like a disk drive. This
	  way applications can access resources on a Web server without
	  knowing anything about HTTP or WebDAV.
	  
	  davfs2 runs as a daemon in userspace. It uses the kernel file
	  system coda or fuse. To connect to the WebDAV
	  server it makes use of the neon library. Neon supports TLS/SSL
	  (using OpenSSL or GnuTLS) and access via proxy server.
	  
	  davfs2 allows you to e.g.
	  * use a WebDAV server as workspace for a geographically
	    distributed work group.
	  * save documents on a WebDAV server and access and edit them
	    via internet from wherever you want.
	  * edit a web site in place, using your preferred development
	    tools.

choice
prompt "kernel filesystem interface"
depends on ADK_PACKAGE_DAVFS2

config ADK_PACKAGE_DAVFS2_FUSE
	bool "use the FUSE filesystem interface"
	select ADK_PACKAGE_FUSE_UTILS
config ADK_PACKAGE_DAVFS2_CODA
	bool "use the CODA filesystem interface"
	select ADK_KPACKAGE_KMOD_CODA_FS
config ADK_PACKAGE_DAVFS2_BOTH
	bool "use both filesystem interfaces"
	select ADK_PACKAGE_FUSE_UTILS
	select ADK_KPACKAGE_KMOD_CODA_FS
endchoice
```

## package/dbus/Config.in
```kconfig
config ADK_PACKAGE_DBUS
	prompt "dbus.............................. DBUS library"
	tristate
	default n
	select ADK_PACKAGE_LIBEXPAT
	help
	  DBUS library. 
	  
	  http://www.freedesktop.org/wiki/Software/dbus
```

## package/deco/Config.in
```kconfig
config ADK_PACKAGE_DECO
	prompt "deco.............................. Text-based full featured file manager"
	tristate
	default n
	select ADK_PACKAGE_LIBNCURSES
	help
	  A clone of Norton Commander for Unix. Text-based, full featured
	  file manager.

	  http://deco.sourceforge.net/
```

## package/device-mapper/Config.in
```kconfig
config ADK_PACKAGE_DEVICE_MAPPER
	prompt "device-mapper..................... device mapper tool and lib"
	tristate
	default n
	help
         device mapper tool and libdevice mapper tool and lib
```

## package/dhcp-forwarder/Config.in
```kconfig
config ADK_PACKAGE_DHCP_FORWARDER
	prompt "dhcp-forwarder.................... DHCP relay agent"
	tristate
	default n
	help
	  A DHCP relay agent

	  http://www.nongnu.org/dhcp-fwd/
```

## package/dhcp/Config.in
```kconfig
config ADK_COMPILE_DHCP
	tristate
	default n
	depends ADK_PACKAGE_DHCP_RELAY || ADK_PACKAGE_DHCP_SERVER

config ADK_PACKAGE_DHCP_RELAY
	prompt "dhcp-relay........................ ISC DHCP relay"
	tristate
	default n
	select ADK_COMPILE_DHCP
	help
	  ISC (Internet Software Consortium) DHCP (Dynamic Host Configuration
	  Protocol) relay daemon.
	  http://www.isc.org/

config ADK_PACKAGE_DHCP_SERVER
	prompt "dhcp-server....................... ISC DHCP server"
	tristate
	default n
	select ADK_COMPILE_DHCP
	help
	  ISC (Internet Software Consortium) DHCP (Dynamic Host Configuration
	  Protocol) server daemon.
	  http://www.isc.org/
```

## package/dhcp6/Config.in
```kconfig
config ADK_PACKAGE_DHCP6
	prompt "dhcp6............................. IPv6 DHCP server and client"
	depends on ADK_IPV6
	tristate
	default n
	select ADK_PACKAGE_LIBNCURSES
	help
		This is the first ever open source implementation of Dynamic
		Host Configuration Protocol for IPv6 (DHCPv6) server and client
		on Linux Operating System. The server provides leases
		(durations or lifetimes) on IPv6 addresses to the clients who
		request for it
```

## package/dhcpv6/Config.in
```kconfig
config ADK_COMPILE_DHCPV6
	depends on ADK_IPV6
	depends ADK_PACKAGE_DHCPV6_SERVER
	tristate
	default n

config ADK_PACKAGE_DHCPV6_SERVER
	prompt "dhcpv6-server........................ IPv6 DHCP server"
	tristate
	default n
	select ADK_COMPILE_DHCPV6
	select ADK_PACKAGE_LIBNCURSES
	select ADK_PACKAGE_LIBNL
	help
	  IPv6 DHCP server
```

## package/diffutils/Config.in
```kconfig
config ADK_PACKAGE_DIFFUTILS
	prompt "diffutils......................... show differences between two files"
	tristate
	default n
	help
	  http://www.gnu.org/software/diffutils/
```

## package/dnsmasq/Config.in
```kconfig
config ADK_PACKAGE_DNSMASQ
	prompt "dnsmasq........................... Lightweight DNS and DHCP server"
	tristate
	default n
	help
	  A lightweight DNS and DHCP server. It is intended to
	  provide coupled DNS and DHCP service to a LAN. Dnsmasq
	  supports static and dynamic DHCP leases and BOOTP/TFTP for
	  network booting of diskless machines.

	  http://www.thekelleys.org.uk/dnsmasq/
```

## package/dosfstools/Config.in
```kconfig
config ADK_PACKAGE_DOSFSTOOLS
	prompt "dosfstools........................ Utilities to create and check MS-DOS FAT filesystems"
	tristate
	default n
	help
	  Utilities to create and check MS-DOS FAT filesystems.
```

## package/dropbear/Config.in
```kconfig
config ADK_PACKAGE_DROPBEAR
	prompt "dropbear.......................... Small SSH 2 client/server"
	tristate
	default y if !ADK_TOOLCHAIN_ONLY
	help
	  A small SSH 2 server/client designed for small memory environments.
	  
	  http://matt.ucc.asn.au/dropbear/

config ADK_PACKAGE_DBCONVERT
	prompt   "dropbearconvert................. Utility for converting SSH keys"
	tristate
	default n
	depends on ADK_PACKAGE_DROPBEAR
```

## package/dsniff/Config.in
```kconfig
config ADK_PACKAGE_DSNIFF
	prompt "dsniff............................ A collection of tools for betwork auditing and penetration testing"
	tristate
	select ADK_PACKAGE_LIBPCAP
	select ADK_PACKAGE_LIBNIDS
	select ADK_PACKAGE_LIBNET
	select ADK_PACKAGE_LIBOPENSSL
	select ADK_PACKAGE_LIBGDBM
	default n
	help
	  A collection of tools for network auditing and penetration testing

	  http://www.monkey.org/~dugsong/dsniff/
```

## package/e2fsprogs/Config.in
```kconfig
config ADK_PACKAGE_E2FSPROGS
	prompt "e2fsprogs......................... Ext2/3/4 filesystem utilities"
	tristate
	default n
	select ADK_PACKAGE_LIBUUID
	select ADK_PACKAGE_LIBCOM_ERR
	select ADK_PACKAGE_LIBSS
	select ADK_PACKAGE_LIBBLKID
	help
	  This package contains essential ext2 filesystem utilities which consists of
	  e2fsck, mke2fs, debugfs, dumpe2fs, tune2fs, and most of the other core ext2
	  filesystem utilities.

	  http://e2fsprogs.sourceforge.net/
```

## package/ebtables/Config.in
```kconfig
config ADK_PACKAGE_EBTABLES
	prompt "ebtables.......................... Ethernet bridging firewall tool"
	tristate
	default n
	help
	  http://ebtables.sourceforge.net/
```

## package/eglibc/Config.in
```kconfig
config ADK_PACKAGE_EGLIBC
	prompt "eglibc............................... embedded GNU C library"
	bool
	default y if ADK_TARGET_LIB_EGLIBC
	default n
	depends on ADK_TARGET_LIB_EGLIBC
	help
	  embedded GNU C library.

config ADK_PACKAGE_EGLIBC_DEV
	prompt "eglibc-dev........................... development files"
	bool
	default n
	depends on ADK_TARGET_LIB_EGLIBC
	help
	  embedded GNU C library header files.
```

## package/elinks/Config.in
```kconfig
config ADK_PACKAGE_ELINKS
	prompt "elinks............................ A text based web browser"
	tristate
	default n
	select ADK_PACKAGE_LIBOPENSSL
	help
	  An advanced text based web browser
	  
	  http://elinks.or.cz/
```

## package/em28xx/Config.in
```kconfig
config ADK_PACKAGE_KMOD_EM28XX
	prompt "kmod-em28xx...................... EM28xx driver"
	tristate
	default n
	select ADK_KPACKAGE_KMOD_VIDEO_DEV
	select ADK_KPACKAGE_KMOD_VIDEO_V4L1
	help
	  Driver for EM28xx based TV cards
	  
```

## package/esound/Config.in
```kconfig
config ADK_PACKAGE_ESOUND
	prompt "esound............................ Enlightened Sound Daemon"
	tristate
	default n
	select ADK_PACKAGE_LIBAUDIOFILE
	help
	 Sound daemon can be used to play music via the network. For example
	 with Amarok. You need to connect a sound card to your embedded device.

	 http://www.tux.org/~ricdude/download.html
```

## package/ether-wake/Config.in
```kconfig
config ADK_PACKAGE_ETHER_WAKE
	prompt "ether-wake........................ A Wake-On-LAN (WOL) client"
	tristate
	default n
	help
	  A Wake-On-LAN (WOL) client,
	  This program sends a magic packet to wake up sleeping networked machines.

	  http://www.scyld.com/wakeonlan.html
```

## package/ethtool/Config.in
```kconfig
config ADK_PACKAGE_ETHTOOL
	prompt "ethtool........................... Display or change ethernet card settings"
	tristate
	default n
	help
	  ethtool is used for querying settings of an ethernet device and changing them

	  http://sourceforge.net/projects/gkernel/
```
