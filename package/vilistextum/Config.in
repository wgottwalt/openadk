## package/vilistextum/Config.in
```kconfig
config ADK_PACKAGE_VILISTEXTUM
	prompt "vilistextum....................... A html to ascii-converter"
	tristate
	default n
	select ADK_PACKAGE_LIBICONV
	help
	  This is release 2.6.9 (22 October 2006) of Vilistextum.
	  Vilistextum is a html to text / ascii converter specifically
	  programmed to get the best out of incorrect html. It is released 
	  as free software under the terms of the GNU GPL Version 2.
	  Some features:
	    * small and fast
	    * understands HTML 3.2 upto 4.01 and XHTML 1.0
	    * creates footnotes for links
	    * can swallow multiple empty lines
	    * removes empty ALT attributes
	    * converts characters and entities between 128 and 159 from 
	      the windows1252 charset to meaningful strings in ISO-8859-1. 
	      E.g. 0x93 is converted to ".
	    * output can be optimized for ebook reading
	    * GUI-frontend using kaptain
	    * supports various multibyte encodings (e.g. Unicode, Shift_JIS)
```

## package/vim/Config.in
```kconfig
config ADK_PACKAGE_VIM
	prompt "vim............................... VI Improved"
	tristate
	default n
	select ADK_PACKAGE_LIBNCURSES
	help
	  An improved version of VI.
	  Note that compiling this on non-Linux may break some things.
	  The configure script is horrible.
	  
	  http://www.vim.org
```

## package/vnstat/Config.in
```kconfig
config ADK_PACKAGE_VNSTAT
	prompt "vnstat............................ Console-based network traffic monitor"
	tristate
	default n
	help
	  vnStat is a network traffic monitor for Linux that keeps a log of daily
	  network traffic for the selected interface(s). vnStat isn't a packet
	  sniffer. The traffic information is analyzed from the /proc -filesystem,
	  so vnStat can be used without root permissions.
	  .
	  http://humdi.net/vnstat/
```

## package/vpnc/Config.in
```kconfig
config ADK_PACKAGE_VPNC
	prompt "vpnc.............................. VPN client for Cisco 3000"
	tristate
	default n
	select ADK_KPACKAGE_KMOD_TUN
	select ADK_PACKAGE_LIBGPG_ERROR
	select ADK_PACKAGE_LIBGCRYPT
	help
		Client for cisco3000 VPN Concentrator.
```

## package/vrrpd/Config.in
```kconfig
config ADK_PACKAGE_VRRPD
        prompt "vrrpd............................. Virtual Router Redundancy Protocol daemon"
	tristate
	default n
	help
	  VRRPd is an implementation of Virtual Router Redundancy
	  Protocol as specified in rfc2338.  VRRPd is interoperable with
	  other RFC-based VRRP implementations, including Cisco and
	  Juniper, and is included as a standard feature on ImageStream
	  routers.
	  
	  http://www.sourceforge.net/projects/vrrpd
```

## package/vsftpd/Config.in
```kconfig
config ADK_PACKAGE_VSFTPD
	prompt "vsftpd............................ Fast and secure FTP server"
	tristate
	default n
	help
	  A fast and secure FTP server
	  
	  http://vsftpd.beasts.org/
```

## package/vtun/Config.in
```kconfig
config ADK_PACKAGE_VTUN
	prompt "vtun.............................. VPN tunneling daemon"
	tristate
	default n
	select ADK_PACKAGE_LIBLZO
	select ADK_PACKAGE_LIBOPENSSL
	select ADK_PACKAGE_ZLIB
	depends on !ADK_HOST_FREEBSD # flex problem
	help
	  A VPN tunneling daemon
	  
	  http://vtun.sourceforge.net
```

## package/watchdog/Config.in
```kconfig
config ADK_PACKAGE_WATCHDOG
	prompt "watchdog.......................... configurable watchdog"
	tristate
	default n
	help
	  watchdog
	  
```

## package/wccpd/Config.in
```kconfig
config ADK_PACKAGE_WCCPD
	prompt "wccpd............................. a Web Cache Coordination daemon"
	tristate
	default n
	help
		wccpd is a WCCP (Web Cache Coordination Protocol) server daemon
		It allows a router (running Linux) to redirect web traffic to a
		group of Squid servers using WCCP as the monitoring/controling 
		protocol.

		http://wccpd.sourceforge.net/
```

## package/wdfs/Config.in
```kconfig
config ADK_PACKAGE_WDFS
	prompt "wdfs.............................. WebDAV filesystem"
	tristate
	default n
	select ADK_PACKAGE_FUSE_UTILS
	select ADK_PACKAGE_NEON
	select ADK_PACKAGE_GLIB2
	help
	  WebDAV is an extension to HTTP that allows remote collaborative
	  authoring of Web resources, defined in RFC 2518.
	  
	  wdfs is a FUSE userland filesystem allowing to mount WebDAV
	  shares as local filesystems, with optional support of transparent
	  versioning with subversion (not yet included in this package).
```

## package/weechat/Config.in
```kconfig
#menu "weechat........................... Lightweight IRC client"

config ADK_PACKAGE_WEECHAT
	prompt "weechat........................... Lightweight IRC client"
	tristate
	default n
	select ADK_PACKAGE_LIBNCURSES
	select ADK_PACKAGE_LIBICONV
	help
	  Fast, light & extensible IRC client

	  http://weechat.flashtux.org

config ADK_COMPILE_WEECHAT_WITH_TLS
	prompt "  Enable TLS support"
	bool
	select ADK_PACKAGE_LIBGNUTLS
	depends on ADK_PACKAGE_WEECHAT

config ADK_COMPILE_WEECHAT_WITH_LUA
	prompt "  Enable LUA scripting"
	bool
	select ADK_PACKAGE_LIBLUA
	depends on ADK_PACKAGE_WEECHAT

#endmenu
```

## package/wget/Config.in
```kconfig
config ADK_PACKAGE_WGET
	prompt "wget.............................. retrieving files using HTTP, HTTPS and FTP"
	tristate
	default n
	help
 	  http://www.gnu.org/software/wget/
```

## package/wifidog/Config.in
```kconfig
config ADK_PACKAGE_WIFIDOG
	prompt "wifidog........................... A wireless captive portal solution"
	tristate
	default n
	select ADK_PACKAGE_IPTABLES
	help
	  The Wifidog project is a complete and embeddable captive
	  portal solution for wireless community groups or individuals
	  who wish to open a free Hotspot while still preventing abuse
	  of their Internet connection.
	  
	  http://www.wifidog.org/
```

## package/wireless-firmware/Config.in
```kconfig
config ADK_DOWNLOAD_WIRELESS_FIRMWARE
	boolean
	default n

config ADK_PACKAGE_WIRELESS_FIRMWARE_RT61
	prompt "wireless-firmware-rt61................ firmware rt61/rt2601 wireless cards"
	tristate
	default n
	select ADK_DOWNLOAD_WIRELESS_FIRMWARE
	help
```

## package/wireless-tools/Config.in
```kconfig
config ADK_PACKAGE_WIRELESS_TOOLS
	prompt "wireless-tools.................... Tools for manipulating Linux Wireless Extensions"
	tristate
	default n
	help
	  Tools for configuring Wireless Adapters implementing the "Wireless Extension"
```

## package/wondershaper/Config.in
```kconfig
config ADK_PACKAGE_WONDERSHAPER
	prompt "wondershaper...................... The Wonder Shaper"
	tristate
	default n
	select ADK_PACKAGE_TC
	help
	  WonderShaper is a tc based traffic shaping tool.
	  
	  Depends: tc
```

## package/wpa_supplicant/Config.in
```kconfig
config ADK_PACKAGE_WPA_SUPPLICANT
	prompt "wpa_supplicant.................... WPA Supplicant with support for WPA and WPA2"
	tristate
	default n
	select ADK_KPACKAGE_KMOD_CRYPTO_AES
	help
	  WPA Supplicant with support for WPA and WPA2 (IEEE 802.11i / RSN).
	  Supplicant is the IEEE 802.1X/WPA component that is used in the client
	  stations. It implements key negotiation with a WPA Authenticator and it
	  controls the roaming and IEEE 802.11 authentication/association.

	  http://hostap.epitest.fi/wpa_supplicant/

choice
prompt "SSL/TLS Configuration"
depends on ADK_PACKAGE_WPA_SUPPLICANT
default ADK_COMPILE_WPA_SUPPLICANT_WITH_OPENSSL

config ADK_COMPILE_WPA_SUPPLICANT_WITH_OPENSSL
	bool "enable openssl encryption support"
	depends ADK_PACKAGE_WPA_SUPPLICANT
	select ADK_PACKAGE_LIBOPENSSL
	help

config ADK_COMPILE_WPA_SUPPLICANT_WITH_INCLUDED
	bool "enable included encryption support"
	depends ADK_PACKAGE_WPA_SUPPLICANT
	help

endchoice
```

## package/wput/Config.in
```kconfig
config ADK_PACKAGE_WPUT
	prompt "wput.............................. A wget-like command-line FTP client"
	tristate
	default n
	help
	  A wget-like command-line FTP client.
	  
	  http://itooktheredpill.dyndns.org/wput/
```

## package/xcmiscproto/Config.in
```kconfig
config ADK_PACKAGE_XCMISCPROTO
	prompt "xcmiscproto............................ X protocol library"
	tristate
	default n
	help
         http://www.x.org
```

## package/xextproto/Config.in
```kconfig
config ADK_PACKAGE_XEXTPROTO
	prompt "xextproto.............................. Xextproto headers"
	tristate
	default n
	help
         http://www.x.org
```

## package/xf86-video-cirrus/Config.in
```kconfig
config ADK_PACKAGE_XF86_VIDEO_CIRRUS
	prompt "xf86-video-cirrus.......................... X11 driver for Cirrus chips"
	tristate
	default n
	depends on ADK_LINUX_X86_QEMU || ADK_LINUX_X86_64_QEMU
	select ADK_PACKAGE_XORG_SERVER
	help
         http://www.x.org
```

## package/xf86-video-geode/Config.in
```kconfig
config ADK_PACKAGE_XF86_VIDEO_GEODE
	prompt "xf86-video-geode........................... X11 driver for AMD Geode"
	tristate
	default n
	depends on ADK_LINUX_X86_ALIX1C
	select ADK_PACKAGE_XORG_SERVER
	help
         http://www.x.org
```

## package/xf86dga/Config.in
```kconfig
config ADK_PACKAGE_XF86DGA
	prompt "xf86dga.............................. X library"
	tristate
	default n
	help
         http://www.x.org
```

## package/xf86dgaproto/Config.in
```kconfig
config ADK_PACKAGE_XF86DGAPROTO
	prompt "xf86dgaproto................................. X protocol library"
	tristate
	default n
	help
         http://www.x.org
```

## package/xfsprogs/Config.in
```kconfig
config ADK_PACKAGE_XFSPROGS
	prompt "xfsprogs.......................... Utilities to create and check XFS filesystems"
	tristate
	select ADK_PACKAGE_LIBUUID
	select ADK_PACKAGE_LIBPTHREAD
	default n
	help
           Utilities to create and check XFS filesystems.
```
