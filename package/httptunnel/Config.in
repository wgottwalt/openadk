## package/httptunnel/Config.in
```kconfig
config ADK_PACKAGE_HTTPTUNNEL
	prompt "httptunnel........................ http tunneling software"
	tristate
	default n
	help
	  httptunnel creates a bidirectional virtual data connection tunnelled 
	  in HTTP requests.
	  
	  http://www.nocrew.org/software/httptunnel.html
```

## package/id3lib/Config.in
```kconfig
config ADK_PACKAGE_ID3LIB
	prompt "id3lib............................ An ID3v1/ID3v2 tagging library"
	tristate
	default n
	select ADK_PACKAGE_ZLIB
	select ADK_PACKAGE_LIBICONV
	help
	  An ID3v1/ID3v2 tagging library.
	  http://www.id3lib.org/

choice
prompt "C++ library to use"
depends on ADK_PACKAGE_ID3LIB
default ADK_COMPILE_ID3LIB_WITH_STDCXX if ADK_TARGET_LIB_GLIBC || ADK_TARGET_LIB_EGLIBC
default ADK_COMPILE_ID3LIB_WITH_UCLIBCXX if ADK_TARGET_LIB_UCLIBC

config ADK_COMPILE_ID3LIB_WITH_STDCXX
	bool "Standard C++ library"
	select ADK_PACKAGE_LIBSTDCXX
	help

config ADK_COMPILE_ID3LIB_WITH_UCLIBCXX
	bool "Embedded uClibc++ library"
	select ADK_PACKAGE_UCLIBCXX
	help

endchoice
```

## package/iftop/Config.in
```kconfig
config ADK_PACKAGE_IFTOP
	prompt "iftop............................. display bandwith usage on an interface"
	tristate
	default n
	select ADK_PACKAGE_LIBPCAP
	select ADK_PACKAGE_LIBNCURSES
	select ADK_PACKAGE_LIBPTHREAD
	help
	  iftop does for network usage what top(1) does for CPU usage. It
	  listens to network traffic on a named interface and displays a
	  table of current bandwidth usage by pairs of hosts. Handy for
	  answering the question "why is our ADSL link so slow?".

	  http://www.ex-parrot.com/~pdw/iftop/
```

## package/igmpproxy/Config.in
```kconfig
config ADK_PACKAGE_IGMPPROXY
	prompt "igmpproxy......................... Multicast Routing Daemon"
	tristate
	default n
	help
	  IGMPproxy is a simple dynamic Multicast Routing Daemon using 
	  only IGMP signalling (Internet Group Management Protocol).

	  http://sourceforge.net/projects/igmpproxy
```

## package/inputproto/Config.in
```kconfig
config ADK_PACKAGE_INPUTPROTO
	prompt "inputproto............................. X protocol library"
	tristate
	default n
	help
         http://www.x.org
```

## package/iperf/Config.in
```kconfig
config ADK_PACKAGE_IPERF
	prompt "iperf............................. Internet Protocol bandwidth measuring tool"
	tristate
	select ADK_PACKAGE_LIBPTHREAD
	default n
	help
	  Iperf is a modern alternative for measuring TCP and UDP bandwidth 
	  performance, allowing the tuning of various parameters and 
	  characteristics.
	  http://dast.nlanr.net/Projects/Iperf/

choice
prompt "C++ library to use"
depends on ADK_PACKAGE_IPERF
default ADK_COMPILE_IPERF_WITH_STDCXX if ADK_TARGET_LIB_GLIBC || ADK_TARGET_LIB_EGLIBC
default ADK_COMPILE_IPERF_WITH_UCLIBCXX if ADK_TARGET_LIB_UCLIBC

config ADK_COMPILE_IPERF_WITH_STDCXX
	bool "Standard C++ library"
	select ADK_PACKAGE_LIBSTDCXX
	help

config ADK_COMPILE_IPERF_WITH_UCLIBCXX
	bool "Embedded uClibc++ library"
	select ADK_PACKAGE_UCLIBCXX
	help

endchoice
```

## package/iproute2/Config.in
```kconfig
config ADK_COMPILE_IPROUTE2
	prompt   "iproute2.......................... iproute2 suite of networking utilities"
	tristate
	default n

config ADK_PACKAGE_IP
	prompt   "ip................................ ip utility"
	tristate
	default ADK_COMPILE_IPROUTE2
	depends on ADK_COMPILE_IPROUTE2
	help
	  IP routing control utility, well-known replacement for ifconfig and route.

config ADK_PACKAGE_TC
	prompt   "tc................................ tc utility"
	tristate
	default m
	depends on ADK_COMPILE_IPROUTE2
	help
	 Traffic shaping control utility. Please choose the kmod-sched-* modules
	 you need.

config ADK_PACKAGE_TC_ATM
	prompt   "atm support....................... atm support for tc"
	tristate
	default n
	depends on ADK_PACKAGE_TC && !ADK_HOST_FREEBSD
	select ADK_PACKAGE_LIBATM
	help
	  ATM traffic control support library.

# FIXME: WTF is this "genl" used for??
# "ifcfg" is lame, just a simple 'ip addr {add|del}' frontend

config ADK_PACKAGE_IFSTAT
	prompt   "ifstat............................ ifstat utility"
	tristate
	default m
	depends on ADK_COMPILE_IPROUTE2
	help
	  Interface statistics utility.

config ADK_PACKAGE_LNSTAT
	prompt   "lnstat............................ lnstat, ctstat, rtstat, nstat and rtacct utilities"
	tristate
	default m
	depends on ADK_COMPILE_IPROUTE2
	help
	  Unified linux networking statistics. Lnstat is a replacement for the
	  old rstat program, nstat and rtacct are simple tools to monitor
	  kernel snmp counters and network interface statistics.


config ADK_PACKAGE_ROUTEL
	prompt   "routel............................ routel/routef utilities"
	tristate
	default m
	depends on ADK_COMPILE_IPROUTE2
	help
	  List and flush routes.

config ADK_PACKAGE_RTMON
	prompt   "rtmon............................. RTnetlink monitor"
	tristate
	default m
	depends on ADK_COMPILE_IPROUTE2
	help
	  Listen to and monitor RTnetlink.

# "rtpr" converts back the output of 'ip -o' (quite useless I guess)

config ADK_PACKAGE_SS
	prompt   "ss................................ socket statistics utility"
	tristate
	default m
	depends on ADK_COMPILE_IPROUTE2
	help
	  A utility to investigate sockets, similar to netstat.
```

## package/ipsec-tools/Config.in
```kconfig
config ADK_PACKAGE_IPSEC_TOOLS
	prompt "ipsec-tools....................... IPsec management tools"
	tristate
	select ADK_PACKAGE_LIBOPENSSL
	default n
	help
	  IPsec management tools
	  
	  http://ipsec-tools.sourceforge.net/
```

## package/ipset/Config.in
```kconfig
config ADK_PACKAGE_IPSET
	prompt "ipset............................. Netfilter ip sets administration utility"
	tristate
	default n
	help
	  Netfilter ip sets administration utility
	  
	  http://ipset.netfilter.org/
```

## package/iptables-snmp/Config.in
```kconfig
config ADK_PACKAGE_IPTABLES_SNMP
	prompt "export iptables information via snmp"
	tristate
	select ADK_PACKAGE_IPTABLES
	depends on ADK_PACKAGE_SNMPD
	help
	  This is a library for the netkit snmp daemon, allowing it to export
	  various iptables information.

	  To use this, add the following line to snmpd.conf:
	  dlmod iptables /root/iptables-snmp-0.1/iptables-snmp.so
```

## package/iptables/Config.in
```kconfig
config ADK_COMPILE_IPTABLES
	bool
	default n
	depends on ADK_PACKAGE_IPTABLES || ADK_PACKAGE_IP6TABLES

config ADK_PACKAGE_IPTABLES
	prompt "iptables.......................... IPv4 firewall administration tool"
	tristate
	default n
	select ADK_COMPILE_IPTABLES
	select ADK_KPACKAGE_KMOD_IP_NF_IPTABLES
	select ADK_KPACKAGE_KMOD_NF_CONNTRACK
	select ADK_KPACKAGE_KMOD_IP_NF_FILTER
	select ADK_KPACKAGE_KMOD_IP_NF_TARGET_REJECT
	select ADK_KPACKAGE_KMOD_NF_NAT
	select ADK_KPACKAGE_KMOD_IP_NF_TARGET_MASQUERADE
	select ADK_KPACKAGE_KMOD_NF_CONNTRACK_IPV4
	help
	  IPv4 firewall, NAT, and packet mangling tools.
	  Automatically selects needed kernel modules for NAT and filtering.

	  http://www.iptables.org/

config ADK_PACKAGE_IP6TABLES
	prompt "ip6tables......................... IPv6 firewall administration tool"
	tristate
	default n
	select ADK_COMPILE_IPTABLES
	help
	  IPv6 firewall, NAT, and packet mangling tools.

	  http://www.iptables.org/
```

## package/iptraf/Config.in
```kconfig
config ADK_PACKAGE_IPTRAF
	prompt "iptraf............................ A console-based network monitoring program"
	tristate
	select ADK_PACKAGE_LIBNCURSES
	default n
	help
	  IPTraf is a console-based network statistics utility for Linux. It gathers 
	  a variety of figures such as TCP connection packet and byte counts, 
	  interface statistics and activity indicators, TCP/UDP traffic breakdowns, 
	  and LAN station packet and byte counts.
	  
	  http://iptraf.seul.org/
```

## package/irssi/Config.in
```kconfig
config ADK_PACKAGE_IRSSI
	prompt "irssi............................. console irc client"
	tristate
	default n
	select ADK_PACKAGE_GLIB
	select ADK_PACKAGE_LIBNCURSES
	help
	  IRC client for the text console
	
	  http://irssi.org

config ADK_PACKAGE_IRSSI_SSL
	bool "  Enable SSL/TLS support"
	depends ADK_PACKAGE_IRSSI
	select ADK_PACKAGE_LIBOPENSSL
	default n
	help
	  Enable this to be able to chat more securely.
```

## package/iw/Config.in
```kconfig
config ADK_PACKAGE_IW
	prompt "iw................................ Tools for manipulating Linux Wireless cards"
	tristate
	select ADK_PACKAGE_LIBNL
	default n
	help
	  Tools for configuring Wireless Adapters.
```

## package/jpeg/Config.in
```kconfig
config ADK_COMPILE_JPEG
	tristate
	default n
	depends ADK_PACKAGE_LIBJPEG

config ADK_PACKAGE_LIBJPEG
	prompt "libjpeg........................... The Independent JPEG Group's JPEG runtime library"
	tristate
	default n
	select ADK_COMPILE_JPEG
	help
	  The Independent JPEG Group's JPEG runtime library.
	  
	  http://www.ijg.org/
```

## package/kbproto/Config.in
```kconfig
config ADK_PACKAGE_KBPROTO
	prompt "kbproto................................ X protocol library"
	tristate
	default n
	help
         http://www.x.org
```

## package/kismet/Config.in
```kconfig
config ADK_COMPILE_KISMET
	tristate
	default n
	depends on ADK_PACKAGE_KISMET_CLIENT || ADK_PACKAGE_KISMET_DRONE || ADK_PACKAGE_KISMET_SERVER

config ADK_PACKAGE_KISMET_CLIENT
	prompt "kismet-client..................... The Kismet client"
	tristate
	default n
	depends on ADK_CXX
	select ADK_COMPILE_KISMET
	select ADK_PACKAGE_LIBNCURSES
	help
	  
	  An 802.11 layer2 wireless network detector, sniffer, and intrusion detection system.
	  
	  http://www.kismetwireless.net/
	  
	  This package contains the kismet text interface client.
	  
config ADK_PACKAGE_KISMET_DRONE
	prompt "kismet-drone...................... The Kismet drone"
	tristate
	default n
	depends on ADK_CXX
	select ADK_COMPILE_KISMET
	select ADK_PACKAGE_LIBPCAP
	help
	  
	  An 802.11 layer2 wireless network detector, sniffer, and intrusion detection system.
	  
	  http://www.kismetwireless.net/
	  
	  This package contains the kismet remote sniffing.and monitoring drone.
	  
config ADK_PACKAGE_KISMET_SERVER
	prompt "kismet-server..................... The Kismet server"
	tristate
	default n
	depends on ADK_CXX
	select ADK_COMPILE_KISMET
	select ADK_PACKAGE_LIBPCAP
	help
	  
	  An 802.11 layer2 wireless network detector, sniffer, and intrusion detection system.
	  
	  http://www.kismetwireless.net/
	  
	  This package contains the kismet server.

choice
prompt "C++ library to use"
depends on ADK_PACKAGE_KISMET_CLIENT || ADK_PACKAGE_KISMET_DRONE || ADK_PACKAGE_KISMET_SERVER
default ADK_COMPILE_KISMET_WITH_STDCXX if ADK_TARGET_LIB_GLIBC
default ADK_COMPILE_KISMET_WITH_UCLIBCXX if ADK_TARGET_LIB_UCLIBC

config ADK_COMPILE_KISMET_WITH_STDCXX
	bool "Standard C++ library"
	select ADK_PACKAGE_LIBSTDCXX
	help

config ADK_COMPILE_KISMET_WITH_UCLIBCXX
	bool "Embedded uClibc++ library"
	select ADK_PACKAGE_UCLIBCXX
	help

endchoice
```

## package/knock/Config.in
```kconfig
config ADK_COMPILE_KNOCK
	tristate
	default n
	depends on ADK_PACKAGE_KNOCK || ADK_PACKAGE_KNOCKD

config ADK_PACKAGE_KNOCK
	prompt "knock............................. A port-knocking client"
	tristate
	default n 
	select ADK_COMPILE_KNOCK
	help
	  It listens to all traffic on an ethernet (or PPP) interface, 
	  looking for special "knock" sequences of port-hits. A client 
	  makes these port-hits by sending a TCP (or UDP) packet to a 
	  port on the server. This port need not be open -- since 
	  knockd listens at the link-layer level, it sees all traffic 
	  even if it's destined for a closed port. When the server 
	  detects a specific sequence of port-hits, it runs a command 
	  defined in its configuration file. This can be used to open 
	  up holes in a firewall for quick access.
	  
	  http://www.zeroflux.org/cgi-bin/cvstrac/knock/wiki

config ADK_PACKAGE_KNOCKD
	prompt "knockd............................ A port-knocking server"
	tristate
	default n 
	select ADK_COMPILE_KNOCK
	help
	  It listens to all traffic on an ethernet (or PPP) interface, 
	  looking for special "knock" sequences of port-hits. A client 
	  makes these port-hits by sending a TCP (or UDP) packet to a 
	  port on the server. This port need not be open -- since 
	  knockd listens at the link-layer level, it sees all traffic 
	  even if it's destined for a closed port. When the server 
	  detects a specific sequence of port-hits, it runs a command 
	  defined in its configuration file. This can be used to open 
	  up holes in a firewall for quick access.
	  
	  http://www.zeroflux.org/cgi-bin/cvstrac/knock/wiki
```

## package/krb5/Config.in
```kconfig
config ADK_COMPILE_KRB5
	prompt "kerberos5......................... MIT kerberos software"
	bool
	select ADK_PACKAGE_LIBNCURSES
	default n

config ADK_PACKAGE_KRB5_SERVER
	prompt "krb5-server....................... MIT kerberos server"
	tristate
	depends on ADK_COMPILE_KRB5
	depends on !ADK_COMPILE_HEIMDAL
	select ADK_PACKAGE_LIBPTHREAD
	select ADK_PACKAGE_KRB5_LIBS
	default n
	help
	  http://web.mit.edu/kerberos

#choice
##prompt "Database backend"
#depends on ADK_PACKAGE_HEIMDAL_SERVER
#default ADK_COMPILE_HEIMDAL_WITH_DB_BDB
#
#config ADK_COMPILE_HEIMDAL_WITH_DB_BDB
#	bool "Berkeley DB backend"
#	select ADK_PACKAGE_LIBDB
#	help
#	  Use Oracle Berkeley DB as kerberos database backend.
#
#config ADK_COMPILE_HEIMDAL_WITH_DB_LDAP
#	bool "LDAP backend"
#	select ADK_PACKAGE_LIBOPENLDAP
#	help
#	  Use OpenLDAP as kerberos database backend.
#	  (Useful for SSO setup)
#
#endchoice

config ADK_PACKAGE_KRB5_LIBS
	prompt "krb5-libs......................... MIT kerberos libraries"
	tristate
	depends on ADK_COMPILE_KRB5
	select ADK_PACKAGE_LIBPTHREAD
	default n
	help
	  http://web.mit.edu/kerberos
```

## package/lame/Config.in
```kconfig
config ADK_COMPILE_LAME
	boolean
	default n
	help

config ADK_PACKAGE_LAME
	prompt "lame.............................. MP3 encoder"
	tristate
	default n
	select ADK_COMPILE_LAME
	help
	  http://lame.sourceforge.net
```

## package/less/Config.in
```kconfig
config ADK_PACKAGE_LESS
	prompt "less.............................. A text file viewer."
	tristate
	default n
	select ADK_PACKAGE_LIBNCURSES
	help
	  less - less is a pager. A pager usually displays text files.
	  
	  http://www.greenwoodsoftware.com/less/
```

## package/libICE/Config.in
```kconfig
config ADK_PACKAGE_LIBICE
	prompt "libICE............................... Inter-Client Exchange library"
	tristate
	default n
	help
         http://www.x.org
```

## package/libSM/Config.in
```kconfig
config ADK_PACKAGE_LIBSM
	prompt "libSM................................ X11 Session Management library"
	tristate
	default n
	select ADK_PACKAGE_LIBUUID
	help
         http://www.x.org
```

## package/libX11/Config.in
```kconfig
config ADK_PACKAGE_LIBX11
	prompt "libX11............................... X11 client-side library"
	tristate
	select ADK_PACKAGE_LIBXDMCP
	default n
	help
         http://www.x.org
```

## package/libXau/Config.in
```kconfig
config ADK_PACKAGE_LIBXAU
	prompt "libXau................................. X library"
	tristate
	default n
	help
         http://www.x.org
```
