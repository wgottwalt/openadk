## Config.in
```kconfig
# This file is part of the OpenADK project. OpenADK is copyrighted
# material, please see the LICENCE file in the top-level directory.

mainmenu "OpenADK Configuration"

# enable tristate
config ADK_MODULES
	bool
	option modules
	default y

config ADK_HAVE_DOT_CONFIG
	bool
	default y

source "target/config/Config.in"
source "target/config/Config.in.os"
source "target/config/Config.in.hardware"
source "target/config/Config.in.boards"
source "target/config/Config.in.kernelfmt"

menu "Hardware configuration"
source "target/config/Config.in.arch"
source "target/config/Config.in.system"
source "target/config/Config.in.subsystem"
source "target/config/Config.in.qemuopts"
source "target/config/Config.in.endian"
source "target/config/Config.in.mmu"
source "target/config/Config.in.cpu"
source "target/config/Config.in.addons"
endmenu

menu "C Library configuration"
	visible if (ADK_TARGET_OS_LINUX || ADK_TARGET_OS_WALDUX) && !ADK_APPLIANCE_TOOLCHAIN && !ADK_TARGET_CHOOSE_ARCH
source "target/config/Config.in.libc"
source "target/config/Config.in.threads"
source "target/config/Config.in.binfmt"
source "target/config/Config.in.instructions"
source "target/config/Config.in.fpu"
source "target/config/Config.in.float"
source "target/config/Config.in.abi"
source "target/config/Config.in.libs"
source "target/config/Config.in.uclibc-ng"
endmenu

comment "After you saved your configuration once, you shouldn't change anything above"
	depends on (ADK_TARGET_OS_LINUX || ADK_TARGET_OS_WALDUX) && !ADK_APPLIANCE_TOOLCHAIN && !ADK_TARGET_CHOOSE_ARCH

source "target/config/Config.in.tasks"

menu "Firmware configuration"
	visible if (ADK_TARGET_OS_LINUX || ADK_TARGET_OS_WALDUX) && !ADK_APPLIANCE_TOOLCHAIN && !ADK_TARGET_CHOOSE_ARCH
source "target/config/Config.in.rootfs"
endmenu

menu "Package selection"
	visible if (ADK_TARGET_OS_LINUX || ADK_TARGET_OS_WALDUX) && !ADK_APPLIANCE_TOOLCHAIN && !ADK_TARGET_CHOOSE_ARCH
source "package/Config.in.auto.global"
source "package/Config.in"
menu "Package options"
source "package/Config.in.options"
endmenu
endmenu

menu "Runtime configuration"
	visible if (ADK_TARGET_OS_LINUX || ADK_TARGET_OS_WALDUX) && !ADK_APPLIANCE_TOOLCHAIN && !ADK_TARGET_CHOOSE_ARCH
source "target/config/Config.in.runtime"
endmenu

menu "Linux Kernel configuration"
	visible if ADK_TARGET_OS_LINUX && !ADK_TARGET_CHOOSE_ARCH
source "target/linux/Config.in.kernelversion"
source "target/linux/Config.in.kernelcfg"
source "target/linux/config/Config.in.compression"
source "target/config/Config.in.cmdline"

menu "Advanced Linux Kernel configuration"
	visible if ADK_TARGET_OS_LINUX && ADK_TARGET_KERNEL_CUSTOMISING && !ADK_APPLIANCE_TOOLCHAIN && !ADK_TARGET_CHOOSE_ARCH && !ADK_TARGET_LINUX_KERNEL_USE_DEFCONFIG && !ADK_TARGET_LINUX_KERNEL_USE_CUSTOMCONFIG
source "target/linux/Config.in"
endmenu
endmenu

menu "Waldux Kernel configuration"
	visible if ADK_TARGET_OS_WALDUX && !ADK_TARGET_CHOOSE_ARCH
source "target/waldux/Config.in.kernelversion"
source "target/waldux/Config.in.kernelcfg"
source "target/waldux/config/Config.in.compression"
source "target/config/Config.in.cmdline"

menu "Advanced Waldux Kernel configuration"
	visible if ADK_TARGET_OS_WALDUX && ADK_TARGET_KERNEL_CUSTOMISING && !ADK_APPLIANCE_TOOLCHAIN && !ADK_TARGET_CHOOSE_ARCH && !ADK_TARGET_WALDUX_KERNEL_USE_DEFCONFIG && !ADK_TARGET_WALDUX_KERNEL_USE_CUSTOMCONFIG
source "target/waldux/Config.in"
endmenu
endmenu

menu "Frosted kernel configuration"
	visible if ADK_TARGET_OS_FROSTED && !ADK_TARGET_CHOOSE_ARCH
source "target/frosted/Config.in"
endmenu

menu "Frosted application configuration"
	visible if ADK_TARGET_OS_FROSTED && !ADK_TARGET_CHOOSE_ARCH
source "target/frosted/Config.in.apps"
endmenu

menu "Toolchain settings"
	visible if !ADK_TARGET_CHOOSE_ARCH

source "target/config/Config.in.binutils"
source "target/config/Config.in.compiler"
source "target/config/Config.in.gdb"
source "target/config/Config.in.toolchain"
endmenu

source "target/config/Config.in.adk"
```

## config/Config.in
```kconfig
#

config ADK_PACKAGE_CONFIG
	bool"config"
	default n
	help
	  Add help text here.
```
