## package/Config.in
```kconfig
# This file is part of the OpenADK project. OpenADK is copyrighted
# material, please see the LICENCE file in the top-level directory.

menu "Package selection"

menu "Basesystem"
source "package/base-files/Config.in"
source "package/busybox/Config.in.manual"
source "package/cfgfs/Config.in"
source "package/cfinstall/Config.in"
source "package/cryptinit/Config.in"
source "package/uclibc/Config.in.manual"
source "package/glibc/Config.in.manual"
source "package/eglibc/Config.in.manual"
source "package/libc/Config.in.manual"
source "package/rpm/Config.in"
source "package/grub/Config.in"
source "package/grub-bin/Config.in"
endmenu

menu "Bluetooth"
source "package/bluez-firmware/Config.in"
source "package/bluez/Config.in"
source "package/miax/Config.in"
source "package/obexftp/Config.in"
source "package/ussp-push/Config.in"
endmenu

menu "Browser / Editor / Pager"
source "package/less/Config.in"
source "package/nano/Config.in"
source "package/vim/Config.in"
source "package/links/Config.in"
source "package/elinks/Config.in"
source "package/lynx/Config.in"
endmenu

menu "Archivers / Compression"
source "package/bzip2/Config.in"
source "package/cpio/Config.in"
source "package/tar/Config.in"
source "package/xz/Config.in"
endmenu

menu "Debugging / Analyzing"
source "package/exmap/Config.in"
source "package/gdb/Config.in"
source "package/gdbserver/Config.in"
source "package/oprofile/Config.in"
source "package/strace/Config.in"
source "package/valgrind/Config.in"
endmenu

menu "Filesystem / Blockdevice utilities"
source "package/aufs2-util/Config.in"
source "package/dosfstools/Config.in"
source "package/e2fsprogs/Config.in"
source "package/fuse/Config.in"
source "package/mdadm/Config.in"
source "package/mtd/Config.in"
source "package/lvm/Config.in"
source "package/parted/Config.in"
source "package/util-linux-ng/Config.in"
source "package/wdfs/Config.in"
source "package/xfsprogs/Config.in"
endmenu

menu "Mail"
source "package/bogofilter/Config.in"
source "package/dovecot/Config.in"
source "package/fetchmail/Config.in"
source "package/mini_sendmail/Config.in"
source "package/mutt/Config.in"
source "package/procmail/Config.in"
source "package/ssmtp/Config.in"
source "package/vilistextum/Config.in"
endmenu

menu "Misc"
source "package/collectd/Config.in"
source "package/deco/Config.in"
source "package/dialog/Config.in"
source "package/digitemp/Config.in"
source "package/gpm/Config.in"
source "package/gpsd/Config.in"
source "package/logrotate/Config.in"
source "package/mc/Config.in"
source "package/mgetty/Config.in"
source "package/monit/Config.in"
source "package/motion/Config.in"
source "package/osiris/Config.in"
source "package/rrdtool/Config.in"
source "package/rrdcollect/Config.in"
source "package/sane-backends/Config.in"
source "package/screen/Config.in"
source "package/scsi-spin/Config.in"
source "package/ser2net/Config.in"
source "package/sqlite/Config.in"
source "package/syslog-ng/Config.in"
endmenu

menu "Multimedia"
source "package/alsa-utils/Config.in"
source "package/esound/Config.in"
source "package/ffmpeg/Config.in"
source "package/gmediaserver/Config.in"
source "package/icecast/Config.in"
source "package/lame/Config.in"
source "package/madplay/Config.in"
source "package/moc/Config.in"
source "package/mpd/Config.in"
source "package/mplayer/Config.in"
source "package/mt-daapd/Config.in"
source "package/palantir/Config.in"
source "package/setpwc/Config.in"
endmenu

menu "Shells"
source "package/bash/Config.in"
source "package/mksh/Config.in"
source "package/zsh/Config.in"
endmenu

menu "Security"
source "package/cryptsetup/Config.in"
source "package/gpg/Config.in"
source "package/heimdal/Config.in"
source "package/krb5/Config.in"
source "package/openct/Config.in"
source "package/opensc/Config.in"
source "package/openssl/Config.in"
source "package/openssl-pkcs11/Config.in"
source "package/rng-tools/Config.in"
endmenu

menu "Serial communications & terminal emulation"
source "package/heyu/Config.in"
source "package/lrzsz/Config.in"
source "package/picocom/Config.in"
source "package/serdisplib/Config.in"
source "package/setserial/Config.in"
endmenu

menu "Telephony"
source "package/asterisk/Config.in"
source "package/opensips/Config.in"
endmenu

menu "Utilities"
source "package/bc/Config.in"
source "package/comgt/Config.in"
source "package/cpufrequtils/Config.in"
source "package/fbset/Config.in"
source "package/file/Config.in"
source "package/findutils/Config.in"
source "package/hdparm/Config.in"
source "package/usbutils/Config.in"
source "package/patch/Config.in"
source "package/pciutils/Config.in"
source "package/procps/Config.in"
source "package/sispmctl/Config.in"
source "package/stress/Config.in"
source "package/sysstat/Config.in"
source "package/swconfig/Config.in"
#source "package/udev/Config.in"
source "package/watchdog/Config.in"
endmenu

menu "Programming / Languages"
source "package/autoconf/Config.in"
source "package/automake/Config.in"
source "package/binutils/Config.in"
source "package/bison/Config.in"
source "package/diffutils/Config.in"
source "package/flex/Config.in"
source "package/gawk/Config.in"
source "package/gcc/Config.in"
source "package/gperf/Config.in"
source "package/haserl/Config.in"
source "package/jamvm/Config.in"
source "package/lua/Config.in"
source "package/m4/Config.in"
source "package/make/Config.in"
source "package/microperl/Config.in"
source "package/perl/Config.in"
source "package/php/Config.in"
source "package/python/Config.in"
source "package/ruby/Config.in"
source "package/tcl/Config.in"
endmenu

menu "Network - Analyze / Debugging / Monitoring"
source "package/bwm/Config.in"
source "package/dsniff/Config.in"
source "package/ethtool/Config.in"
source "package/fping/Config.in"
source "package/fprobe/Config.in"
source "package/fprobe-ulog/Config.in"
source "package/httping/Config.in"
source "package/iftop/Config.in"
source "package/ipcad/Config.in"
source "package/iperf/Config.in"
source "package/iptraf/Config.in"
source "package/mtr/Config.in"
source "package/netperf/Config.in"
source "package/nmap/Config.in"
source "package/sipsak/Config.in"
source "package/tcpdump/Config.in"
source "package/tptest/Config.in"
#source "package/trafshow/Config.in"
source "package/ttcp/Config.in"
endmenu

menu "DNS / DHCP"
source "package/atftp/Config.in"
source "package/avahi/Config.in"
source "package/bind/Config.in"
source "package/dhcp/Config.in"
source "package/dhcp-forwarder/Config.in"
source "package/dnsmasq/Config.in"
source "package/ez-ipupdate/Config.in"
source "package/maradns/Config.in"
source "package/pdnsd/Config.in"
source "package/updatedd/Config.in"
endmenu

menu "HTTP / FTP"
source "package/curl/Config.in"
source "package/gatling/Config.in"
source "package/lighttpd/Config.in"
source "package/mini_httpd/Config.in"
source "package/tntnet/Config.in"
source "package/vsftpd/Config.in"
source "package/wget/Config.in"
source "package/wput/Config.in"
endmenu

menu "IPv6"
source "package/6tunnel/Config.in"
source "package/aiccu/Config.in"
source "package/miredo/Config.in"
source "package/mrd6/Config.in"
source "package/ndisc/Config.in"
source "package/radvd/Config.in"
endmenu

menu "IRC / ICQ / JABBER"
source "package/bitlbee/Config.in"
source "package/irssi/Config.in"
source "package/miau/Config.in"
source "package/reaim/Config.in"
source "package/tmsnc/Config.in"
endmenu

menu "Firewall / Routing / Bridging"
source "package/arpd/Config.in"
source "package/bridge-utils/Config.in"
source "package/linux-atm/Config.in"
source "package/cutter/Config.in"
source "package/ebtables/Config.in"
source "package/ether-wake/Config.in"
source "package/iproute2/Config.in"
source "package/ipset/Config.in"
source "package/iptables/Config.in"
source "package/knock/Config.in"
source "package/macchanger/Config.in"
source "package/netstat-nat/Config.in"
source "package/quagga/Config.in"
source "package/ulogd/Config.in"
source "package/shorewall-common/Config.in"
source "package/shorewall-shell/Config.in"
source "package/wol/Config.in"
source "package/wondershaper/Config.in"
source "package/vrrpd/Config.in"
endmenu

menu "Networking Misc"
source "package/cups/Config.in"
source "package/fakeidentd/Config.in"
source "package/gkrellmd/Config.in"
source "package/git/Config.in"
source "package/net-snmp/Config.in"
# intentionally inserted here, as it depends on the above
source "package/iptables-snmp/Config.in"
source "package/nut/Config.in"
source "package/openldap/Config.in"
source "package/p910nd/Config.in"
source "package/pipacs/Config.in"
#source "package/pmacct/Config.in"
source "package/portmap/Config.in"
source "package/rarpd/Config.in"
source "package/rrs/Config.in"
source "package/rsync/Config.in"
source "package/shat/Config.in"
source "package/socat/Config.in"
source "package/subversion/Config.in"
source "package/udp-broadcast-relay/Config.in"
source "package/vgp/Config.in"
source "package/vnstat/Config.in"
source "package/vtun/Config.in"
source "package/wccpd/Config.in"
source "package/xinetd/Config.in"
endmenu

menu "Network Filesystems"
source "package/davfs2/Config.in"
source "package/davfs2/Config.in.kernel"
source "package/nfs-utils/Config.in"
source "package/samba/Config.in"
endmenu

menu "NTP"
source "package/htpdate/Config.in"
source "package/ntpclient/Config.in"
source "package/openntpd/Config.in"
source "package/rdate/Config.in"
endmenu

menu "P2P"
source "package/cbtt/Config.in"
source "package/ctorrent/Config.in"
source "package/rtorrent/Config.in"
endmenu

menu "PPP / PPTP / RADIUS"
source "package/freeradius-client/Config.in"
source "package/freeradius-server/Config.in"
source "package/ppp/Config.in"
source "package/pptp/Config.in"
source "package/pptpd/Config.in"
source "package/rp-pppoe/Config.in"
source "package/raddump/Config.in"
endmenu

menu "Proxy"
source "package/dansguardian/Config.in"
source "package/frickin/Config.in"
source "package/igmpproxy/Config.in"
source "package/parprouted/Config.in"
source "package/privoxy/Config.in"
source "package/siproxd/Config.in"
source "package/squid/Config.in"
source "package/srelay/Config.in"
source "package/tinyproxy/Config.in"
source "package/tor/Config.in"
source "package/vnc-reflector/Config.in"
endmenu

menu "Networking Security"
source "package/arpwatch/Config.in"
source "package/autossh/Config.in"
source "package/axtls/Config.in"
source "package/ca-certificates/Config.in"
source "package/dropbear/Config.in"
source "package/httptunnel/Config.in"
source "package/ipsec-tools/Config.in"
source "package/l2tpns/Config.in"
source "package/openssh/Config.in"
source "package/openssh/Config.in.kerberos"
source "package/openswan/Config.in"
source "package/openvpn/Config.in"
source "package/portsentry/Config.in"
source "package/ptunnel/Config.in"
source "package/scanlogd/Config.in"
source "package/snort/Config.in"
source "package/ssltunnel/Config.in"
source "package/tinc/Config.in"
source "package/vpnc/Config.in"
endmenu

menu "Wireless"
source "package/aircrack-ng/Config.in"
source "package/chillispot/Config.in"
source "package/hostapd/Config.in"
source "package/iw/Config.in"
#source "package/kismet/Config.in"
source "package/olsrd/Config.in"
source "package/wifidog/Config.in"
source "package/wireless-firmware/Config.in"
source "package/wpa_supplicant/Config.in"
endmenu


menu "Libraries"
source "package/alsa-lib/Config.in"
source "package/apr/Config.in"
source "package/apr-util/Config.in"
source "package/atk/Config.in"
source "package/avahi/Config.in.lib"
source "package/axtls/Config.in.lib"
source "package/bind/Config.in.lib"
source "package/cairo/Config.in"
source "package/cgilib/Config.in"
source "package/curl/Config.in.lib"
source "package/cxxtools/Config.in"
source "package/dbus/Config.in"
source "package/e2fsprogs/Config.in.lib"
source "package/fontconfig/Config.in"
source "package/gettext/Config.in"
source "package/glib/Config.in"
source "package/gtk+/Config.in"
source "package/id3lib/Config.in"
source "package/libao/Config.in"
source "package/libao/Config.in.lib"
source "package/libaudiofile/Config.in"
source "package/libaudiofile/Config.in.lib"
source "package/libart/Config.in"
source "package/libart/Config.in.lib"
source "package/linux-atm/Config.in.lib"
source "package/libcli/Config.in"
source "package/libcli/Config.in.lib"
source "package/libdaemon/Config.in"
source "package/libdaemon/Config.in.lib"
source "package/libdb/Config.in"
source "package/libdb/Config.in.lib"
source "package/libdnet/Config.in"
source "package/libdnet/Config.in.lib"
source "package/libelf/Config.in"
source "package/libelf/Config.in.lib"
source "package/libevent/Config.in"
source "package/libevent/Config.in.lib"
source "package/libffi/Config.in"
source "package/libffi/Config.in.lib"
source "package/freeradius-client/Config.in.lib"
source "package/expat/Config.in"
source "package/expat/Config.in.lib"
source "package/faad2/Config.in" 
source "package/faad2/Config.in.lib" 
source "package/flac/Config.in"
source "package/flac/Config.in.lib"
source "package/freetype/Config.in"
source "package/freetype/Config.in.lib"
source "package/libgcrypt/Config.in"
source "package/libgcrypt/Config.in.lib"
source "package/libgd/Config.in"
source "package/libgd/Config.in.lib"
source "package/gdbm/Config.in"
source "package/gdbm/Config.in.lib"
source "package/libgssglue/Config.in"
source "package/libgssglue/Config.in.lib"
source "package/gmp/Config.in" 
source "package/gmp/Config.in.lib" 
source "package/gnutls/Config.in"
source "package/gnutls/Config.in.lib"
source "package/libgpg-error/Config.in"
source "package/libgpg-error/Config.in.lib"
source "package/gsm/Config.in"
source "package/gsm/Config.in.lib"
source "package/libiconv/Config.in"
source "package/libiconv/Config.in.lib"
source "package/libid3tag/Config.in"
source "package/libid3tag/Config.in.lib"
source "package/jpeg/Config.in"
source "package/jpeg/Config.in.lib"
source "package/lame/Config.in.lib"
source "package/mpfr/Config.in"
source "package/mysql/Config.in"
source "package/mysql/Config.in.lib"
source "package/nspr/Config.in"
source "package/nss/Config.in"
source "package/libtool/Config.in" 
source "package/openldap/Config.in.lib"
source "package/liblzo/Config.in"
source "package/liblzo/Config.in.lib"
source "package/libmad/Config.in"
source "package/libmad/Config.in.lib"
source "package/libmms/Config.in"
source "package/libmms/Config.in.lib"
source "package/ncurses/Config.in"  
source "package/ncurses/Config.in.lib" 
source "package/neon/Config.in"
source "package/libnet/Config.in"
source "package/libnet/Config.in.lib"
source "package/libnfsidmap/Config.in"
source "package/libnfnetlink/Config.in"
source "package/libnfnetlink/Config.in.lib"
source "package/libnids/Config.in"
source "package/libnl/Config.in"
source "package/libnl/Config.in.lib"
source "package/libogg/Config.in"
source "package/libogg/Config.in.lib"
source "package/libol/Config.in"
source "package/libol/Config.in.lib"
source "package/opencdk/Config.in"  
source "package/obexftp/Config.in.lib"
source "package/openobex/Config.in"
source "package/libosip2/Config.in"
source "package/libosip2/Config.in.lib"
source "package/libp11/Config.in"
source "package/libp11/Config.in.lib"
source "package/libpcap/Config.in"
source "package/libpcap/Config.in.lib"
source "package/libpri/Config.in"
source "package/libpri/Config.in.lib"
source "package/pango/Config.in"
source "package/pcre/Config.in"
source "package/pcre/Config.in.lib"
source "package/libpng/Config.in"
source "package/libpng/Config.in.lib"
source "package/popt/Config.in"
source "package/popt/Config.in.lib"
source "package/postgresql/Config.in"
source "package/postgresql/Config.in.lib"
source "package/libpthread/Config.in"
source "package/libpthread/Config.in.lib"
source "package/libthread_db/Config.in"
source "package/readline/Config.in"
source "package/cyrus-sasl/Config.in.lib"
source "package/sdl/Config.in"
source "package/sdl/Config.in.lib"
source "package/sdl-image/Config.in"
source "package/sdl-image/Config.in.lib"
source "package/speex/Config.in"
source "package/openssl/Config.in.lib"
source "package/sqlite/Config.in.lib"
source "package/librpcsecgss/Config.in"
source "package/librpcsecgss/Config.in.lib"
source "package/libshout/Config.in"
source "package/libshout/Config.in.lib"
source "package/libsigc++/Config.in"
source "package/libsigc++/Config.in.lib"
source "package/libstdcxx/Config.in"
source "package/libstdcxx/Config.in.lib"
source "package/libtasn1/Config.in"
source "package/libtasn1/Config.in.lib"
source "package/libtiff/Config.in"
source "package/libtiff/Config.in.lib"
source "package/libtirpc/Config.in"
source "package/libtirpc/Config.in.lib"
source "package/libtorrent/Config.in"
source "package/libtorrent/Config.in.lib"
source "package/libupnp/Config.in"
source "package/libusb/Config.in"
source "package/libusb/Config.in.lib"
source "package/libusb-compat/Config.in"
source "package/libusb-compat/Config.in.lib"
source "package/libvirt/Config.in"
source "package/libvirt/Config.in.lib"
source "package/libvorbis/Config.in"
source "package/libvorbis/Config.in.lib"
source "package/libvorbisidec/Config.in"
source "package/libvorbisidec/Config.in.lib"
source "package/tcp_wrappers/Config.in"
source "package/tslib/Config.in"
source "package/libxml2/Config.in"
source "package/libxml2/Config.in.lib"
source "package/libxslt/Config.in"
source "package/libxslt/Config.in.lib"
source "package/lua/Config.in.lib"
source "package/uclibc++/Config.in.manual"
source "package/ustl/Config.in"
source "package/zlib/Config.in"
endmenu

menu "X"
source "package/xorg-server/Config.in"
source "package/xf86-video-cirrus/Config.in"
source "package/xf86-video-geode/Config.in"
source "package/xf86-input-mouse/Config.in"
source "package/xf86-input-keyboard/Config.in"
source "package/xf86-input-evtouch/Config.in"

menu "X Libraries"
source "package/libICE/Config.in"
source "package/libICE/Config.in.lib"
source "package/libSM/Config.in"
source "package/libSM/Config.in.lib"
source "package/libX11/Config.in"
source "package/libX11/Config.in.lib"
source "package/libXv/Config.in"
source "package/libXv/Config.in.lib"
source "package/libXdmcp/Config.in"
source "package/libXdmcp/Config.in.lib"
source "package/libXext/Config.in"
source "package/libXext/Config.in.lib"
source "package/libXfont/Config.in"
source "package/libXfont/Config.in.lib"
source "package/libfontenc/Config.in"
source "package/libfontenc/Config.in.lib"
source "package/libpciaccess/Config.in"
source "package/libpciaccess/Config.in.lib"
source "package/libxkbfile/Config.in"
source "package/libxkbfile/Config.in.lib"
source "package/libXau/Config.in"
source "package/libXau/Config.in.lib"
source "package/libXaw/Config.in"
source "package/libXaw/Config.in.lib"
source "package/libXmu/Config.in"
source "package/libXmu/Config.in.lib"
source "package/libXpm/Config.in"
source "package/libXpm/Config.in.lib"
source "package/libXrender/Config.in"
source "package/libXrender/Config.in.lib"
source "package/libXt/Config.in"
source "package/libXt/Config.in.lib"
source "package/libXxf86dga/Config.in"
source "package/libXxf86dga/Config.in.lib"
source "package/pixman/Config.in"
#source "package/xf86dga/Config.in"
source "package/xkbcomp/Config.in"
source "package/xkeyboard-config/Config.in"
endmenu

endmenu

endmenu

menu "Kernel configuration"
source "target/linux/Config.in"
endmenu
```
