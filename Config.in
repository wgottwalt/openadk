## package/aiccu/Config.in
```kconfig
config ADK_PACKAGE_AICCU
	prompt "aiccu............................. SixXS Automatic IPv6 Connectivity Client Utility"
	depends on ADK_IPV6
	tristate
	default n
	select ADK_KPACKAGE_KMOD_IPV6
	select ADK_PACKAGE_LIBPTHREAD
	help
	  SixXS Automatic IPv6 Connectivity Client Utility
	  
	  For more information about SixXS check http://www.sixxs.net/
```

## package/aircrack-ng/Config.in
```kconfig
config ADK_PACKAGE_AIRCRACK_NG
	prompt "aircrack-ng....................... A set of tools for auditing wireless networks"
	tristate
	default n
	select ADK_PACKAGE_LIBPTHREAD
	select ADK_PACKAGE_LIBPCAP
	select ADK_PACKAGE_LIBOPENSSL
	help
	  aircrack-ng is a set of tools for auditing wireless networks:
	  
	  * aircrack-ng: a program that cracks WEP and WPA (bruteforce) keys
	  * airdecap-ng: decrypts WEP or WPA encrypted capture files with known key
	  * airmon-ng: responsible for placing different cards in monitor mode
	  * aireplay-ng: responsible for packet injection
	  * airodump-ng: places all air traffic into .cap file and shows information on networks
	  http://www.aircrack-ng.org
```

## package/alsa-lib/Config.in
```kconfig
config ADK_PACKAGE_ALSA_LIB
	prompt "alsa-lib............................ alsa library"
	tristate
	default n
	help
	  
	  http://www.alsa-project.org/
```

## package/alsa-utils/Config.in
```kconfig
config ADK_PACKAGE_ALSA_UTILS
	prompt "alsa-utils........................ ALSA utilities / mixer"
	tristate
	default n
	select ADK_PACKAGE_ALSA_LIB
	select ADK_PACKAGE_LIBPTHREAD
	help
	  http://www.alsa-project.org/
```

## package/apr-util/Config.in
```kconfig
config ADK_PACKAGE_APR_UTIL
	prompt "apr-util.......................... Apache Portable Runtime (utils)"
	tristate
	default n
	select ADK_PACKAGE_LIBEXPAT
	select ADK_PACKAGE_APR
	help
	  Apache Portable Runtime

	  http://apr.apache.org
```

## package/apr/Config.in
```kconfig
config ADK_PACKAGE_APR
	prompt "apr............................... Apache Portable Runtime"
	tristate
	default n
	help
	  Apache Portable Runtime

	  http://apr.apache.org

config ADK_PACKAGE_APR_THREADING
        prompt "Enable threading support"
        bool
        default n
        depends on ADK_PACKAGE_APR
        help
	  Enable threading support in APR.
```

## package/arpd/Config.in
```kconfig
config ADK_PACKAGE_ARPD
	prompt "arpd.............................. A daemon to fake ARP replies"
	tristate
	default n
	select ADK_PACKAGE_LIBPCAP
	select ADK_PACKAGE_LIBDNET
	select ADK_PACKAGE_LIBEVENT
	help
	  Generates ARP responses for (locally unused) IP addresses
	  
	  http://www.honeyd.org/tools.php
```

## package/arpwatch/Config.in
```kconfig
config ADK_PACKAGE_ARPWATCH
	prompt "arpwatch.......................... Ethernet station activity monitor"
	tristate
	default n
	help
	  Ethernet monitor program for keeping track of ethernet/ip address pairings
```

## package/asterisk/Config.in
```kconfig
config ADK_PACKAGE_ASTERISK
	bool "asterisk................... Telephony server"
        select ADK_PACKAGE_LIBCURL
	select ADK_PACKAGE_LIBNCURSES
	select ADK_PACKAGE_LIBPTHREAD
	default n

menu "asterisk-modules.................. Additional modules for Asterisk"
depends on ADK_PACKAGE_ASTERISK

config ADK_PACKAGE_ASTERISK_CHAN_MGCP
	prompt   "asterisk-chan-mgcp.............. Media Gateway Control Protocol implementation"
	tristate
	default n
	depends on ADK_PACKAGE_ASTERISK
	help
	  Media Gateway Control Protocol implementation for Asterisk

config ADK_PACKAGE_ASTERISK_CHAN_SKINNY
	prompt   "asterisk-chan-skinny............ Skinny Client Control Protocol implementation"
	tristate
	default n
	depends on ADK_PACKAGE_ASTERISK
	help
	  Skinny Client Control Protocol implementation for Asterisk

config ADK_PACKAGE_ASTERISK_CHAN_IAX2
	prompt   "asterisk-chan-iax2.............. Support for the Inter Asterisk Protocol"
	tristate
	default n
	depends on ADK_PACKAGE_ASTERISK
	help
	  IAX2 allows trunking communication channels together.

	  Contains:
	  * chan_iax2.so

config ADK_PACKAGE_ASTERISK_CODEC_SPEEX
	prompt   "asterisk-codec-speex............ Speex/PCM16 Codec Translator"
	tristate
	default n
	depends on ADK_PACKAGE_ASTERISK
	select ADK_PACKAGE_LIBSPEEX
	help
	  The Speex speech compression codec for Asterisk

config ADK_PACKAGE_ASTERISK_CODEC_GSM
	prompt   "asterisk-codec-gsm.............. GSM Codec"
	tristate
	default n
	depends on ADK_PACKAGE_ASTERISK
	help
	  The GSM codec for Asterisk

config ADK_PACKAGE_ASTERISK_PBX_DUNDI
	prompt   "asterisk-pbx-dundi.............. Distributed Universal Number Discovery (DUNDi) support"
	tristate
	default n
	depends on ADK_PACKAGE_ASTERISK
	help
	  Distributed Universal Number Discovery (DUNDi) support for Asterisk

config ADK_PACKAGE_ASTERISK_RES_AGI
	prompt   "asterisk-res-agi................ Asterisk Gateway Interface module"
	tristate
	default n
	depends on ADK_PACKAGE_ASTERISK
	help
	  Asterisk Gateway Interface module

config ADK_PACKAGE_ASTERISK_PGSQL
	prompt   "asterisk-pgsql.................. PostgreSQL modules"
	tristate
	default n
	depends on ADK_PACKAGE_ASTERISK
	select ADK_PACKAGE_LIBPQ
	help
	  PostgreSQL modules for Asterisk

config ADK_PACKAGE_ASTERISK_SOUNDS
	prompt   "asterisk-sounds................. Sound files"
	tristate
	default n
	depends on ADK_PACKAGE_ASTERISK
	help
	  Sound files for Asterisk

config ADK_PACKAGE_ASTERISK_VOICEMAIL
	prompt   "asterisk-voicemail.............. Voicemail support"
	tristate
	default n
	depends on ADK_PACKAGE_ASTERISK
	help
	  Voicemail related modules for Asterisk

endmenu
```

## package/atftp/Config.in
```kconfig
#menu "atftp............................. TFTP implementation"

config ADK_COMPILE_ATFTP
	tristate
	default n
	depends ADK_PACKAGE_ATFTP || ADK_PACKAGE_ATFTPD
	select ADK_PACKAGE_LIBREADLINE
	
config ADK_PACKAGE_ATFTP
	prompt "atftp............................. TFTP client"
	tristate
	default n
	select ADK_COMPILE_ATFTP
	help
	  TFTP client

config ADK_PACKAGE_ATFTPD
	prompt "atftpd............................ TFTP server"
	tristate
	default n
	select ADK_COMPILE_ATFTP
	help
	  TFTP server 

#endmenu
```

## package/atk/Config.in
```kconfig
config ADK_PACKAGE_ATK
	prompt "atk............................... ATK library"
	tristate
	default n
	help
```

## package/aufs2-util/Config.in
```kconfig
config ADK_PACKAGE_AUFS_UTIL
	prompt "aufs2-util........................ aufs2 utilities"
	tristate
	default n
	select ADK_KPACKAGE_KMOD_AUFS_FS
	depends on !ADK_HOST_FREEBSD
	help
	  Utilities for use with aufs2.
	  http://aufs.sf.net
```

## package/autoconf/Config.in
```kconfig
config ADK_PACKAGE_AUTOCONF
	prompt "autoconf.......................... Autoconf"
	tristate
	default n
	help
	  http://www.gnu.org/software/autoconf/
```

## package/automake/Config.in
```kconfig
config ADK_PACKAGE_AUTOMAKE
	prompt "automake.......................... Automake"
	tristate
	default n
	help
	  http://www.gnu.org/software/automake/
```

## package/avahi/Config.in
```kconfig
config ADK_COMPILE_AVAHI
	tristate
	default n
	depends ADK_PACKAGE_AVAHI_DAEMON || ADK_PACKAGE_AVAHI_DNSCONFD || ADK_PACKAGE_LIBAVAHI

config ADK_PACKAGE_AVAHI_DAEMON
	prompt   "avahi-daemon...................... An mDNS/DNS-SD (ZeroConf) implementation (daemon)"
	tristate
	default n
	select ADK_COMPILE_AVAHI
	select ADK_PACKAGE_LIBAVAHI
	select ADK_PACKAGE_LIBDAEMON
	select ADK_PACKAGE_GLIB
	help
	  Avahi is a system which facilitates service discovery on a local network --
	  this means that you can plug your laptop or computer into a network and
	  instantly be able to view other people who you can chat with, find printers
	  to print to or find files being shared. This kind of technology is already
	  found in MacOS X (branded 'Rendezvous', 'Bonjour' and sometimes 'ZeroConf')
	  and is very convenient.

	  http://www.freedesktop.org/Software/Avahi

	  This package contains an mDNS/DNS-SD daemon.

config ADK_PACKAGE_AVAHI_DNSCONFD
	prompt     "avahi-dnsconfd.................. Unicast DNS server from mDNS/DNS-SD config daemon"
	tristate
	default n
	select ADK_COMPILE_AVAHI
	depends ADK_PACKAGE_AVAHI_DAEMON
	help
	  Avahi is a system which facilitates service discovery on a local network --
	  this means that you can plug your laptop or computer into a network and
	  instantly be able to view other people who you can chat with, find printers
	  to print to or find files being shared. This kind of technology is already
	  found in MacOS X (branded 'Rendezvous', 'Bonjour' and sometimes 'ZeroConf')
	  and is very convenient.

	  http://www.freedesktop.org/Software/Avahi

	  This package contains an Unicast DNS server from mDNS/DNS-SD configuration
	  daemon, which may be used to configure conventional DNS servers using mDNS
	  in a DHCP-like fashion. Especially useful on IPv6.
```

## package/axtls/Config.in
```kconfig
config ADK_COMPILE_AXTLS
	tristate
	default n
	depends ADK_PACKAGE_LIBAXTLS || ADK_PACKAGE_AXHTTPD

config ADK_PACKAGE_AXHTTPD
	prompt   "axhttpd........................... small embedded webserver"
	tristate
	default n
	select ADK_COMPILE_AXTLS
	select ADK_PACKAGE_LIBAXTLS
	help
	  axhttpd is a small embedded web server using the axTLS library.

	  http://www.axtls.co.nr/
	  
```

## package/base-files/Config.in
```kconfig
config ADK_PACKAGE_BASE_FILES
	prompt "base-files........................... basic filesystem layout"
	bool
	default y if !ADK_TOOLCHAIN_ONLY
	help
	  Basic filesystem layout.

config ADK_PACKAGE_CONFIG_IN_ETC
	prompt ".config in /etc...................... include gzipped version of .config in image"
	bool
	default y if !ADK_TOOLCHAIN_ONLY
	help
	  Copy the configuration file (.config) to the image.  The
	  file will be found in /etc/adkconfig.gz. This takes about
	  7kBytes of file system space. From this file you can always rebuild
	  the image from source.
```

## package/bash/Config.in
```kconfig
config ADK_PACKAGE_BASH
	prompt "bash.............................. GNU Bourne-Again SHell"
	tristate
	default n
	help
	  GNU Bourne-Again SHell
	  
	  http://www.gnu.org/software/bash/
```

## package/bc/Config.in
```kconfig
config ADK_COMPILE_BC
	tristate
	depends ADK_PACKAGE_BC || ADK_PACKAGE_DC
	default n

config ADK_PACKAGE_BC
	prompt "bc................................ Arbitrary precision calculator language"
	tristate
	default n
	select ADK_COMPILE_BC
	help
      bc is a language that supports arbitrary precision numbers with
	  interactive execution of statements.

config ADK_PACKAGE_DC
	prompt "dc................................ Arbitrary precision calculator"
	tristate
	default n
	select ADK_COMPILE_BC
	help
	  dc is a reverse-polish desk calculator which supports unlimited
	  precision arithmetic.
```

## package/bigreqsproto/Config.in
```kconfig
config ADK_PACKAGE_BIGREQSPROTO
	prompt "bigreqsproto.......................... X protocol library"
	tristate
	default n
	help
         http://www.x.org
```

## package/bind/Config.in
```kconfig
config ADK_COMPILE_BIND
	tristate
	default n
	select ADK_PACKAGE_LIBOPENSSL

config ADK_DUMMY_BIND
	prompt "bind.............................. A DNS server implementation"
	tristate
	default n

config ADK_PACKAGE_BIND_RNDC
	prompt "bind-rndc......................... Bind administration tools (rndc & rndc-confgen only)"
	tristate
	default n
	depends ADK_DUMMY_BIND
	select ADK_COMPILE_BIND
	select ADK_PACKAGE_LIBBIND
	help
	  rndc, rndc-confgen
	  http://www.isc.org/sw/bind/

config ADK_PACKAGE_BIND_CHECK
	prompt "bind-check........................ Bind administration tools (named-checkconf & named-checkzone only)"
	tristate
	default n
	depends ADK_DUMMY_BIND
	select ADK_COMPILE_BIND
	select ADK_PACKAGE_LIBBIND
	help
	  named-checkconf, named-checkzone
	  http://www.isc.org/sw/bind/

config ADK_PACKAGE_BIND_DNSSEC
	prompt "bind-dnssec....................... Bind administration tools (dnssec-keygen & dnssec-signzone only)"
	tristate
	default n
	depends ADK_DUMMY_BIND
	select ADK_COMPILE_BIND
	select ADK_PACKAGE_LIBBIND
	help
	  dnssec-keygen, dnssec-signzone
	  http://www.isc.org/sw/bind/

config ADK_PACKAGE_BIND_HOST
	prompt "bind-host......................... A simple DNS client"
	tristate
	default n
	depends ADK_DUMMY_BIND
	select ADK_COMPILE_BIND
	select ADK_PACKAGE_LIBBIND
	help
	  host utility.
	  http://www.isc.org/sw/bind/


config ADK_PACKAGE_BIND_DIG
	prompt "bind-dig.......................... A DNS client"
	tristate
	default n
	depends ADK_DUMMY_BIND
	select ADK_COMPILE_BIND
	select ADK_PACKAGE_LIBBIND
	help
	  dig utility.
	  http://www.isc.org/sw/bind/


config ADK_PACKAGE_BIND_CLIENT
	prompt "bind-client....................... A dynamic DNS client"
	tristate
	default n
	depends ADK_DUMMY_BIND
	select ADK_COMPILE_BIND
	select ADK_PACKAGE_LIBBIND
	help
	  A DNS dynamic client (nsupdate)
	  http://www.isc.org/sw/bind/

config ADK_PACKAGE_BIND_SERVER
	prompt "bind-server....................... A DNS server"
	tristate
	default n
	depends ADK_DUMMY_BIND
	select ADK_COMPILE_BIND
	select ADK_PACKAGE_LIBBIND
	help
	  A DNS server (named)
	  http://www.isc.org/sw/bind/

config ADK_PACKAGE_LIBBIND
        prompt "libbind........................... Support library for the bind tools and dns server/client."
        tristate
        default n
        depends ADK_DUMMY_BIND
        select ADK_COMPILE_BIND
        help
          http://www.isc.org/sw/bind/
```

## package/binutils/Config.in
```kconfig
config ADK_PACKAGE_BINUTILS
	prompt "binutils.......................... binary utilities (assembler,strip,nm,..)"
	tristate
	default n
	help
	  binary utilities

	  http://www.gnu.org/binutils
```
